VERSION ""

NS_ :

BS_:

BU_:  Inverter  Battery  Charger  Host

BO_ 2571108352 BATT_eventMatrix_A_0: 8 Battery
 SG_ BATT_packModIdFault_0 : 8|1@1+ (1,0) [0|1] "" Host
 SG_ BATT_packModExitedFromBus_0 : 16|1@1+ (1,0) [0|1] "" Host
 SG_ BATT_packFetChgWelded_0 : 35|1@1+ (1,0) [0|1] "" Host
 SG_ BATT_packFetDsgWelded_0 : 36|1@1+ (1,0) [0|1] "" Host
 SG_ BATT_fetDsgShortedAux_0 : 63|1@1+ (1,0) [0|1] "" Host
 SG_ BATT_fetChgShortedAux_0 : 25|1@1+ (1,0) [0|1] "" Host
 SG_ BATT_prechargeFetFail_0 : 39|1@1+ (1,0) [0|1] "" Host
 SG_ BATT_abnormalResetReason_0 : 31|1@1+ (1,0) [0|1] "" Host
 SG_ BATT_prechargeTooSlow_0 : 49|1@1+ (1,0) [0|1] "" Host
 SG_ BATT_prechargeTooFast_0 : 50|1@1+ (1,0) [0|1] "" Host
 SG_ BATT_prechargeTimeout_0 : 51|1@1+ (1,0) [0|1] "" Host
 SG_ BATT_fetChgShorted_0 : 23|1@1+ (1,0) [0|1] "" Host
 SG_ BATT_fetChgFailToClose_0 : 22|1@1+ (1,0) [0|1] "" Host
 SG_ BATT_packModSelectFault_0 : 21|1@1+ (1,0) [0|1] "" Host
 SG_ BATT_packModConnectFault_0 : 20|1@1+ (1,0) [0|1] "" Host
 SG_ BATT_packModMIA_0 : 19|1@1+ (1,0) [0|1] "" Host
 SG_ BATT_packModImbalance_0 : 18|1@1+ (1,0) [0|1] "" Host
 SG_ BATT_afeFault_0 : 17|1@1+ (1,0) [0|1] "" Host
 SG_ BATT_chargerMIA_0 : 60|1@1+ (1,0) [0|1] "" Host
 SG_ BATT_chargerError_0 : 59|1@1+ (1,0) [0|1] "" Host
 SG_ BATT_vBrickUnderWar_0 : 58|1@1+ (1,0) [0|1] "" Host
 SG_ BATT_vBrickUnderSev_0 : 57|1@1+ (1,0) [0|1] "" Host
 SG_ BATT_vBrickUnderMod_0 : 56|1@1+ (1,0) [0|1] "" Host
 SG_ BATT_vBrickOverWar_0 : 55|1@1+ (1,0) [0|1] "" Host
 SG_ BATT_vBrickOverSev_0 : 54|1@1+ (1,0) [0|1] "" Host
 SG_ BATT_vBrickOverMod_0 : 53|1@1+ (1,0) [0|1] "" Host
 SG_ BATT_vBrickImbalance_0 : 52|1@1+ (1,0) [0|1] "" Host
 SG_ BATT_loggerAlmostFull_0 : 61|1@1+ (1,0) [0|1] "" Host
 SG_ BATT_tempModuleUnderWar_0 : 48|1@1+ (1,0) [0|1] "" Host
 SG_ BATT_tempModuleUnderSev_0 : 47|1@1+ (1,0) [0|1] "" Host
 SG_ BATT_tempModuleUnderMod_0 : 46|1@1+ (1,0) [0|1] "" Host
 SG_ BATT_tempModuleOverWar_0 : 45|1@1+ (1,0) [0|1] "" Host
 SG_ BATT_tempModuleOverSev_0 : 44|1@1+ (1,0) [0|1] "" Host
 SG_ BATT_tempModuleOverMod_0 : 43|1@1+ (1,0) [0|1] "" Host
 SG_ BATT_tempBrickImbalance_0 : 42|1@1+ (1,0) [0|1] "" Host
 SG_ BATT_taskLockupError_0 : 41|1@1+ (1,0) [0|1] "" Host
 SG_ BATT_tempAmbientOverWar_0 : 40|1@1+ (1,0) [0|1] "" Host
 SG_ BATT_tempAmbientOverSev_0 : 38|1@1+ (1,0) [0|1] "" Host
 SG_ BATT_tempAmbientOverMod_0 : 37|1@1+ (1,0) [0|1] "" Host
 SG_ BATT_sensePackVoltError_0 : 34|1@1+ (1,0) [0|1] "" Host
 SG_ BATT_senseLoadVoltError_0 : 33|1@1+ (1,0) [0|1] "" Host
 SG_ BATT_loggerFull_0 : 62|1@1+ (1,0) [0|1] "" Host
 SG_ BATT_senseCurrentError_0 : 32|1@1+ (1,0) [0|1] "" Host
 SG_ BATT_senseBrickTempError_0 : 30|1@1+ (1,0) [0|1] "" Host
 SG_ BATT_resPackHigh_0 : 29|1@1+ (1,0) [0|1] "" Host
 SG_ BATT_ramOverUtilError_0 : 28|1@1+ (1,0) [0|1] "" Host
 SG_ BATT_powerPackInsufficient_0 : 27|1@1+ (1,0) [0|1] "" Host
 SG_ BATT_packCellSoftShort_0 : 26|1@1+ (1,0) [0|1] "" Host
 SG_ BATT_iOverHardware_0 : 24|1@1+ (1,0) [0|1] "" Host
 SG_ BATT_fetOverTemp_0 : 15|1@1+ (1,0) [0|1] "" Host
 SG_ BATT_iOverDischarge_0 : 14|1@1+ (1,0) [0|1] "" Host
 SG_ BATT_iOverCharge_0 : 13|1@1+ (1,0) [0|1] "" Host
 SG_ BATT_inverterDriveMIA_0 : 12|1@1+ (1,0) [0|1] "" Host
 SG_ BATT_iUnderCharge_0 : 11|1@1+ (1,0) [0|1] "" Host
 SG_ BATT_hostMIA_0 : 10|1@1+ (1,0) [0|1] "" Host
 SG_ BATT_fetDsgShorted_0 : 7|1@1+ (1,0) [0|1] "" Host
 SG_ BATT_fetDsgFailToClose_0 : 6|1@1+ (1,0) [0|1] "" Host
 SG_ BATT_capLow_0 : 5|1@1+ (1,0) [0|1] "" Host
 SG_ BATT_brickOverDischarge_0 : 4|1@1+ (1,0) [0|1] "" Host
 SG_ BATT_brickOverCharge_0 : 3|1@1+ (1,0) [0|1] "" Host
 SG_ BATT_bmsProcessorError_0 : 2|1@1+ (1,0) [0|1] "" Host
 SG_ BATT_bmsMemoryError_0 : 1|1@1+ (1,0) [0|1] "" Host
 SG_ BATT_afeError_0 : 0|1@1+ (1,0) [0|1] "" Host

BO_ 2571108353 BATT_eventMatrix_A_1: 8 Battery
 SG_ BATT_packModIdFault_1 : 8|1@1+ (1,0) [0|1] "" Host
 SG_ BATT_packModExitedFromBus_1 : 16|1@1+ (1,0) [0|1] "" Host
 SG_ BATT_packFetChgWelded_1 : 35|1@1+ (1,0) [0|1] "" Host
 SG_ BATT_packFetDsgWelded_1 : 36|1@1+ (1,0) [0|1] "" Host
 SG_ BATT_fetDsgShortedAux_1 : 63|1@1+ (1,0) [0|1] "" Host
 SG_ BATT_fetChgShortedAux_1 : 25|1@1+ (1,0) [0|1] "" Host
 SG_ BATT_prechargeFetFail_1 : 39|1@1+ (1,0) [0|1] "" Host
 SG_ BATT_abnormalResetReason_1 : 31|1@1+ (1,0) [0|1] "" Host
 SG_ BATT_prechargeTooSlow_1 : 49|1@1+ (1,0) [0|1] "" Host
 SG_ BATT_prechargeTooFast_1 : 50|1@1+ (1,0) [0|1] "" Host
 SG_ BATT_prechargeTimeout_1 : 51|1@1+ (1,0) [0|1] "" Host
 SG_ BATT_fetChgShorted_1 : 23|1@1+ (1,0) [0|1] "" Host
 SG_ BATT_fetChgFailToClose_1 : 22|1@1+ (1,0) [0|1] "" Host
 SG_ BATT_packModSelectFault_1 : 21|1@1+ (1,0) [0|1] "" Host
 SG_ BATT_packModConnectFault_1 : 20|1@1+ (1,0) [0|1] "" Host
 SG_ BATT_packModMIA_1 : 19|1@1+ (1,0) [0|1] "" Host
 SG_ BATT_packModImbalance_1 : 18|1@1+ (1,0) [0|1] "" Host
 SG_ BATT_afeFault_1 : 17|1@1+ (1,0) [0|1] "" Host
 SG_ BATT_chargerMIA_1 : 60|1@1+ (1,0) [0|1] "" Host
 SG_ BATT_chargerError_1 : 59|1@1+ (1,0) [0|1] "" Host
 SG_ BATT_vBrickUnderWar_1 : 58|1@1+ (1,0) [0|1] "" Host
 SG_ BATT_vBrickUnderSev_1 : 57|1@1+ (1,0) [0|1] "" Host
 SG_ BATT_vBrickUnderMod_1 : 56|1@1+ (1,0) [0|1] "" Host
 SG_ BATT_vBrickOverWar_1 : 55|1@1+ (1,0) [0|1] "" Host
 SG_ BATT_vBrickOverSev_1 : 54|1@1+ (1,0) [0|1] "" Host
 SG_ BATT_vBrickOverMod_1 : 53|1@1+ (1,0) [0|1] "" Host
 SG_ BATT_vBrickImbalance_1 : 52|1@1+ (1,0) [0|1] "" Host
 SG_ BATT_loggerAlmostFull_1 : 61|1@1+ (1,0) [0|1] "" Host
 SG_ BATT_tempModuleUnderWar_1 : 48|1@1+ (1,0) [0|1] "" Host
 SG_ BATT_tempModuleUnderSev_1 : 47|1@1+ (1,0) [0|1] "" Host
 SG_ BATT_tempModuleUnderMod_1 : 46|1@1+ (1,0) [0|1] "" Host
 SG_ BATT_tempModuleOverWar_1 : 45|1@1+ (1,0) [0|1] "" Host
 SG_ BATT_tempModuleOverSev_1 : 44|1@1+ (1,0) [0|1] "" Host
 SG_ BATT_tempModuleOverMod_1 : 43|1@1+ (1,0) [0|1] "" Host
 SG_ BATT_tempBrickImbalance_1 : 42|1@1+ (1,0) [0|1] "" Host
 SG_ BATT_taskLockupError_1 : 41|1@1+ (1,0) [0|1] "" Host
 SG_ BATT_tempAmbientOverWar_1 : 40|1@1+ (1,0) [0|1] "" Host
 SG_ BATT_tempAmbientOverSev_1 : 38|1@1+ (1,0) [0|1] "" Host
 SG_ BATT_tempAmbientOverMod_1 : 37|1@1+ (1,0) [0|1] "" Host
 SG_ BATT_sensePackVoltError_1 : 34|1@1+ (1,0) [0|1] "" Host
 SG_ BATT_senseLoadVoltError_1 : 33|1@1+ (1,0) [0|1] "" Host
 SG_ BATT_loggerFull_1 : 62|1@1+ (1,0) [0|1] "" Host
 SG_ BATT_senseCurrentError_1 : 32|1@1+ (1,0) [0|1] "" Host
 SG_ BATT_senseBrickTempError_1 : 30|1@1+ (1,0) [0|1] "" Host
 SG_ BATT_resPackHigh_1 : 29|1@1+ (1,0) [0|1] "" Host
 SG_ BATT_ramOverUtilError_1 : 28|1@1+ (1,0) [0|1] "" Host
 SG_ BATT_powerPackInsufficient_1 : 27|1@1+ (1,0) [0|1] "" Host
 SG_ BATT_packCellSoftShort_1 : 26|1@1+ (1,0) [0|1] "" Host
 SG_ BATT_iOverHardware_1 : 24|1@1+ (1,0) [0|1] "" Host
 SG_ BATT_fetOverTemp_1 : 15|1@1+ (1,0) [0|1] "" Host
 SG_ BATT_iOverDischarge_1 : 14|1@1+ (1,0) [0|1] "" Host
 SG_ BATT_iOverCharge_1 : 13|1@1+ (1,0) [0|1] "" Host
 SG_ BATT_inverterDriveMIA_1 : 12|1@1+ (1,0) [0|1] "" Host
 SG_ BATT_iUnderCharge_1 : 11|1@1+ (1,0) [0|1] "" Host
 SG_ BATT_hostMIA_1 : 10|1@1+ (1,0) [0|1] "" Host
 SG_ BATT_fetDsgShorted_1 : 7|1@1+ (1,0) [0|1] "" Host
 SG_ BATT_fetDsgFailToClose_1 : 6|1@1+ (1,0) [0|1] "" Host
 SG_ BATT_capLow_1 : 5|1@1+ (1,0) [0|1] "" Host
 SG_ BATT_brickOverDischarge_1 : 4|1@1+ (1,0) [0|1] "" Host
 SG_ BATT_brickOverCharge_1 : 3|1@1+ (1,0) [0|1] "" Host
 SG_ BATT_bmsProcessorError_1 : 2|1@1+ (1,0) [0|1] "" Host
 SG_ BATT_bmsMemoryError_1 : 1|1@1+ (1,0) [0|1] "" Host
 SG_ BATT_afeError_1 : 0|1@1+ (1,0) [0|1] "" Host

BO_ 2571108354 BATT_eventMatrix_A_2: 8 Battery
 SG_ BATT_packModIdFault_2 : 8|1@1+ (1,0) [0|1] "" Host
 SG_ BATT_packModExitedFromBus_2 : 16|1@1+ (1,0) [0|1] "" Host
 SG_ BATT_packFetChgWelded_2 : 35|1@1+ (1,0) [0|1] "" Host
 SG_ BATT_packFetDsgWelded_2 : 36|1@1+ (1,0) [0|1] "" Host
 SG_ BATT_fetDsgShortedAux_2 : 63|1@1+ (1,0) [0|1] "" Host
 SG_ BATT_fetChgShortedAux_2 : 25|1@1+ (1,0) [0|1] "" Host
 SG_ BATT_prechargeFetFail_2 : 39|1@1+ (1,0) [0|1] "" Host
 SG_ BATT_abnormalResetReason_2 : 31|1@1+ (1,0) [0|1] "" Host
 SG_ BATT_prechargeTooSlow_2 : 49|1@1+ (1,0) [0|1] "" Host
 SG_ BATT_prechargeTooFast_2 : 50|1@1+ (1,0) [0|1] "" Host
 SG_ BATT_prechargeTimeout_2 : 51|1@1+ (1,0) [0|1] "" Host
 SG_ BATT_fetChgShorted_2 : 23|1@1+ (1,0) [0|1] "" Host
 SG_ BATT_fetChgFailToClose_2 : 22|1@1+ (1,0) [0|1] "" Host
 SG_ BATT_packModSelectFault_2 : 21|1@1+ (1,0) [0|1] "" Host
 SG_ BATT_packModConnectFault_2 : 20|1@1+ (1,0) [0|1] "" Host
 SG_ BATT_packModMIA_2 : 19|1@1+ (1,0) [0|1] "" Host
 SG_ BATT_packModImbalance_2 : 18|1@1+ (1,0) [0|1] "" Host
 SG_ BATT_afeFault_2 : 17|1@1+ (1,0) [0|1] "" Host
 SG_ BATT_chargerMIA_2 : 60|1@1+ (1,0) [0|1] "" Host
 SG_ BATT_chargerError_2 : 59|1@1+ (1,0) [0|1] "" Host
 SG_ BATT_vBrickUnderWar_2 : 58|1@1+ (1,0) [0|1] "" Host
 SG_ BATT_vBrickUnderSev_2 : 57|1@1+ (1,0) [0|1] "" Host
 SG_ BATT_vBrickUnderMod_2 : 56|1@1+ (1,0) [0|1] "" Host
 SG_ BATT_vBrickOverWar_2 : 55|1@1+ (1,0) [0|1] "" Host
 SG_ BATT_vBrickOverSev_2 : 54|1@1+ (1,0) [0|1] "" Host
 SG_ BATT_vBrickOverMod_2 : 53|1@1+ (1,0) [0|1] "" Host
 SG_ BATT_vBrickImbalance_2 : 52|1@1+ (1,0) [0|1] "" Host
 SG_ BATT_loggerAlmostFull_2 : 61|1@1+ (1,0) [0|1] "" Host
 SG_ BATT_tempModuleUnderWar_2 : 48|1@1+ (1,0) [0|1] "" Host
 SG_ BATT_tempModuleUnderSev_2 : 47|1@1+ (1,0) [0|1] "" Host
 SG_ BATT_tempModuleUnderMod_2 : 46|1@1+ (1,0) [0|1] "" Host
 SG_ BATT_tempModuleOverWar_2 : 45|1@1+ (1,0) [0|1] "" Host
 SG_ BATT_tempModuleOverSev_2 : 44|1@1+ (1,0) [0|1] "" Host
 SG_ BATT_tempModuleOverMod_2 : 43|1@1+ (1,0) [0|1] "" Host
 SG_ BATT_tempBrickImbalance_2 : 42|1@1+ (1,0) [0|1] "" Host
 SG_ BATT_taskLockupError_2 : 41|1@1+ (1,0) [0|1] "" Host
 SG_ BATT_tempAmbientOverWar_2 : 40|1@1+ (1,0) [0|1] "" Host
 SG_ BATT_tempAmbientOverSev_2 : 38|1@1+ (1,0) [0|1] "" Host
 SG_ BATT_tempAmbientOverMod_2 : 37|1@1+ (1,0) [0|1] "" Host
 SG_ BATT_sensePackVoltError_2 : 34|1@1+ (1,0) [0|1] "" Host
 SG_ BATT_senseLoadVoltError_2 : 33|1@1+ (1,0) [0|1] "" Host
 SG_ BATT_loggerFull_2 : 62|1@1+ (1,0) [0|1] "" Host
 SG_ BATT_senseCurrentError_2 : 32|1@1+ (1,0) [0|1] "" Host
 SG_ BATT_senseBrickTempError_2 : 30|1@1+ (1,0) [0|1] "" Host
 SG_ BATT_resPackHigh_2 : 29|1@1+ (1,0) [0|1] "" Host
 SG_ BATT_ramOverUtilError_2 : 28|1@1+ (1,0) [0|1] "" Host
 SG_ BATT_powerPackInsufficient_2 : 27|1@1+ (1,0) [0|1] "" Host
 SG_ BATT_packCellSoftShort_2 : 26|1@1+ (1,0) [0|1] "" Host
 SG_ BATT_iOverHardware_2 : 24|1@1+ (1,0) [0|1] "" Host
 SG_ BATT_fetOverTemp_2 : 15|1@1+ (1,0) [0|1] "" Host
 SG_ BATT_iOverDischarge_2 : 14|1@1+ (1,0) [0|1] "" Host
 SG_ BATT_iOverCharge_2 : 13|1@1+ (1,0) [0|1] "" Host
 SG_ BATT_inverterDriveMIA_2 : 12|1@1+ (1,0) [0|1] "" Host
 SG_ BATT_iUnderCharge_2 : 11|1@1+ (1,0) [0|1] "" Host
 SG_ BATT_hostMIA_2 : 10|1@1+ (1,0) [0|1] "" Host
 SG_ BATT_fetDsgShorted_2 : 7|1@1+ (1,0) [0|1] "" Host
 SG_ BATT_fetDsgFailToClose_2 : 6|1@1+ (1,0) [0|1] "" Host
 SG_ BATT_capLow_2 : 5|1@1+ (1,0) [0|1] "" Host
 SG_ BATT_brickOverDischarge_2 : 4|1@1+ (1,0) [0|1] "" Host
 SG_ BATT_brickOverCharge_2 : 3|1@1+ (1,0) [0|1] "" Host
 SG_ BATT_bmsProcessorError_2 : 2|1@1+ (1,0) [0|1] "" Host
 SG_ BATT_bmsMemoryError_2 : 1|1@1+ (1,0) [0|1] "" Host
 SG_ BATT_afeError_2 : 0|1@1+ (1,0) [0|1] "" Host

BO_ 2571108355 BATT_eventMatrix_A_3: 8 Battery
 SG_ BATT_packModIdFault_3 : 8|1@1+ (1,0) [0|1] "" Host
 SG_ BATT_packModExitedFromBus_3 : 16|1@1+ (1,0) [0|1] "" Host
 SG_ BATT_packFetChgWelded_3 : 35|1@1+ (1,0) [0|1] "" Host
 SG_ BATT_packFetDsgWelded_3 : 36|1@1+ (1,0) [0|1] "" Host
 SG_ BATT_fetDsgShortedAux_3 : 63|1@1+ (1,0) [0|1] "" Host
 SG_ BATT_fetChgShortedAux_3 : 25|1@1+ (1,0) [0|1] "" Host
 SG_ BATT_prechargeFetFail_3 : 39|1@1+ (1,0) [0|1] "" Host
 SG_ BATT_abnormalResetReason_3 : 31|1@1+ (1,0) [0|1] "" Host
 SG_ BATT_prechargeTooSlow_3 : 49|1@1+ (1,0) [0|1] "" Host
 SG_ BATT_prechargeTooFast_3 : 50|1@1+ (1,0) [0|1] "" Host
 SG_ BATT_prechargeTimeout_3 : 51|1@1+ (1,0) [0|1] "" Host
 SG_ BATT_fetChgShorted_3 : 23|1@1+ (1,0) [0|1] "" Host
 SG_ BATT_fetChgFailToClose_3 : 22|1@1+ (1,0) [0|1] "" Host
 SG_ BATT_packModSelectFault_3 : 21|1@1+ (1,0) [0|1] "" Host
 SG_ BATT_packModConnectFault_3 : 20|1@1+ (1,0) [0|1] "" Host
 SG_ BATT_packModMIA_3 : 19|1@1+ (1,0) [0|1] "" Host
 SG_ BATT_packModImbalance_3 : 18|1@1+ (1,0) [0|1] "" Host
 SG_ BATT_afeFault_3 : 17|1@1+ (1,0) [0|1] "" Host
 SG_ BATT_chargerMIA_3 : 60|1@1+ (1,0) [0|1] "" Host
 SG_ BATT_chargerError_3 : 59|1@1+ (1,0) [0|1] "" Host
 SG_ BATT_vBrickUnderWar_3 : 58|1@1+ (1,0) [0|1] "" Host
 SG_ BATT_vBrickUnderSev_3 : 57|1@1+ (1,0) [0|1] "" Host
 SG_ BATT_vBrickUnderMod_3 : 56|1@1+ (1,0) [0|1] "" Host
 SG_ BATT_vBrickOverWar_3 : 55|1@1+ (1,0) [0|1] "" Host
 SG_ BATT_vBrickOverSev_3 : 54|1@1+ (1,0) [0|1] "" Host
 SG_ BATT_vBrickOverMod_3 : 53|1@1+ (1,0) [0|1] "" Host
 SG_ BATT_vBrickImbalance_3 : 52|1@1+ (1,0) [0|1] "" Host
 SG_ BATT_loggerAlmostFull_3 : 61|1@1+ (1,0) [0|1] "" Host
 SG_ BATT_tempModuleUnderWar_3 : 48|1@1+ (1,0) [0|1] "" Host
 SG_ BATT_tempModuleUnderSev_3 : 47|1@1+ (1,0) [0|1] "" Host
 SG_ BATT_tempModuleUnderMod_3 : 46|1@1+ (1,0) [0|1] "" Host
 SG_ BATT_tempModuleOverWar_3 : 45|1@1+ (1,0) [0|1] "" Host
 SG_ BATT_tempModuleOverSev_3 : 44|1@1+ (1,0) [0|1] "" Host
 SG_ BATT_tempModuleOverMod_3 : 43|1@1+ (1,0) [0|1] "" Host
 SG_ BATT_tempBrickImbalance_3 : 42|1@1+ (1,0) [0|1] "" Host
 SG_ BATT_taskLockupError_3 : 41|1@1+ (1,0) [0|1] "" Host
 SG_ BATT_tempAmbientOverWar_3 : 40|1@1+ (1,0) [0|1] "" Host
 SG_ BATT_tempAmbientOverSev_3 : 38|1@1+ (1,0) [0|1] "" Host
 SG_ BATT_tempAmbientOverMod_3 : 37|1@1+ (1,0) [0|1] "" Host
 SG_ BATT_sensePackVoltError_3 : 34|1@1+ (1,0) [0|1] "" Host
 SG_ BATT_senseLoadVoltError_3 : 33|1@1+ (1,0) [0|1] "" Host
 SG_ BATT_loggerFull_3 : 62|1@1+ (1,0) [0|1] "" Host
 SG_ BATT_senseCurrentError_3 : 32|1@1+ (1,0) [0|1] "" Host
 SG_ BATT_senseBrickTempError_3 : 30|1@1+ (1,0) [0|1] "" Host
 SG_ BATT_resPackHigh_3 : 29|1@1+ (1,0) [0|1] "" Host
 SG_ BATT_ramOverUtilError_3 : 28|1@1+ (1,0) [0|1] "" Host
 SG_ BATT_powerPackInsufficient_3 : 27|1@1+ (1,0) [0|1] "" Host
 SG_ BATT_packCellSoftShort_3 : 26|1@1+ (1,0) [0|1] "" Host
 SG_ BATT_iOverHardware_3 : 24|1@1+ (1,0) [0|1] "" Host
 SG_ BATT_fetOverTemp_3 : 15|1@1+ (1,0) [0|1] "" Host
 SG_ BATT_iOverDischarge_3 : 14|1@1+ (1,0) [0|1] "" Host
 SG_ BATT_iOverCharge_3 : 13|1@1+ (1,0) [0|1] "" Host
 SG_ BATT_inverterDriveMIA_3 : 12|1@1+ (1,0) [0|1] "" Host
 SG_ BATT_iUnderCharge_3 : 11|1@1+ (1,0) [0|1] "" Host
 SG_ BATT_hostMIA_3 : 10|1@1+ (1,0) [0|1] "" Host
 SG_ BATT_fetDsgShorted_3 : 7|1@1+ (1,0) [0|1] "" Host
 SG_ BATT_fetDsgFailToClose_3 : 6|1@1+ (1,0) [0|1] "" Host
 SG_ BATT_capLow_3 : 5|1@1+ (1,0) [0|1] "" Host
 SG_ BATT_brickOverDischarge_3 : 4|1@1+ (1,0) [0|1] "" Host
 SG_ BATT_brickOverCharge_3 : 3|1@1+ (1,0) [0|1] "" Host
 SG_ BATT_bmsProcessorError_3 : 2|1@1+ (1,0) [0|1] "" Host
 SG_ BATT_bmsMemoryError_3 : 1|1@1+ (1,0) [0|1] "" Host
 SG_ BATT_afeError_3 : 0|1@1+ (1,0) [0|1] "" Host

BO_ 2571108356 BATT_eventMatrix_A_4: 8 Battery
 SG_ BATT_packModIdFault_4 : 8|1@1+ (1,0) [0|1] "" Host
 SG_ BATT_packModExitedFromBus_4 : 16|1@1+ (1,0) [0|1] "" Host
 SG_ BATT_packFetChgWelded_4 : 35|1@1+ (1,0) [0|1] "" Host
 SG_ BATT_packFetDsgWelded_4 : 36|1@1+ (1,0) [0|1] "" Host
 SG_ BATT_fetDsgShortedAux_4 : 63|1@1+ (1,0) [0|1] "" Host
 SG_ BATT_fetChgShortedAux_4 : 25|1@1+ (1,0) [0|1] "" Host
 SG_ BATT_prechargeFetFail_4 : 39|1@1+ (1,0) [0|1] "" Host
 SG_ BATT_abnormalResetReason_4 : 31|1@1+ (1,0) [0|1] "" Host
 SG_ BATT_prechargeTooSlow_4 : 49|1@1+ (1,0) [0|1] "" Host
 SG_ BATT_prechargeTooFast_4 : 50|1@1+ (1,0) [0|1] "" Host
 SG_ BATT_prechargeTimeout_4 : 51|1@1+ (1,0) [0|1] "" Host
 SG_ BATT_fetChgShorted_4 : 23|1@1+ (1,0) [0|1] "" Host
 SG_ BATT_fetChgFailToClose_4 : 22|1@1+ (1,0) [0|1] "" Host
 SG_ BATT_packModSelectFault_4 : 21|1@1+ (1,0) [0|1] "" Host
 SG_ BATT_packModConnectFault_4 : 20|1@1+ (1,0) [0|1] "" Host
 SG_ BATT_packModMIA_4 : 19|1@1+ (1,0) [0|1] "" Host
 SG_ BATT_packModImbalance_4 : 18|1@1+ (1,0) [0|1] "" Host
 SG_ BATT_afeFault_4 : 17|1@1+ (1,0) [0|1] "" Host
 SG_ BATT_chargerMIA_4 : 60|1@1+ (1,0) [0|1] "" Host
 SG_ BATT_chargerError_4 : 59|1@1+ (1,0) [0|1] "" Host
 SG_ BATT_vBrickUnderWar_4 : 58|1@1+ (1,0) [0|1] "" Host
 SG_ BATT_vBrickUnderSev_4 : 57|1@1+ (1,0) [0|1] "" Host
 SG_ BATT_vBrickUnderMod_4 : 56|1@1+ (1,0) [0|1] "" Host
 SG_ BATT_vBrickOverWar_4 : 55|1@1+ (1,0) [0|1] "" Host
 SG_ BATT_vBrickOverSev_4 : 54|1@1+ (1,0) [0|1] "" Host
 SG_ BATT_vBrickOverMod_4 : 53|1@1+ (1,0) [0|1] "" Host
 SG_ BATT_vBrickImbalance_4 : 52|1@1+ (1,0) [0|1] "" Host
 SG_ BATT_loggerAlmostFull_4 : 61|1@1+ (1,0) [0|1] "" Host
 SG_ BATT_tempModuleUnderWar_4 : 48|1@1+ (1,0) [0|1] "" Host
 SG_ BATT_tempModuleUnderSev_4 : 47|1@1+ (1,0) [0|1] "" Host
 SG_ BATT_tempModuleUnderMod_4 : 46|1@1+ (1,0) [0|1] "" Host
 SG_ BATT_tempModuleOverWar_4 : 45|1@1+ (1,0) [0|1] "" Host
 SG_ BATT_tempModuleOverSev_4 : 44|1@1+ (1,0) [0|1] "" Host
 SG_ BATT_tempModuleOverMod_4 : 43|1@1+ (1,0) [0|1] "" Host
 SG_ BATT_tempBrickImbalance_4 : 42|1@1+ (1,0) [0|1] "" Host
 SG_ BATT_taskLockupError_4 : 41|1@1+ (1,0) [0|1] "" Host
 SG_ BATT_tempAmbientOverWar_4 : 40|1@1+ (1,0) [0|1] "" Host
 SG_ BATT_tempAmbientOverSev_4 : 38|1@1+ (1,0) [0|1] "" Host
 SG_ BATT_tempAmbientOverMod_4 : 37|1@1+ (1,0) [0|1] "" Host
 SG_ BATT_sensePackVoltError_4 : 34|1@1+ (1,0) [0|1] "" Host
 SG_ BATT_senseLoadVoltError_4 : 33|1@1+ (1,0) [0|1] "" Host
 SG_ BATT_loggerFull_4 : 62|1@1+ (1,0) [0|1] "" Host
 SG_ BATT_senseCurrentError_4 : 32|1@1+ (1,0) [0|1] "" Host
 SG_ BATT_senseBrickTempError_4 : 30|1@1+ (1,0) [0|1] "" Host
 SG_ BATT_resPackHigh_4 : 29|1@1+ (1,0) [0|1] "" Host
 SG_ BATT_ramOverUtilError_4 : 28|1@1+ (1,0) [0|1] "" Host
 SG_ BATT_powerPackInsufficient_4 : 27|1@1+ (1,0) [0|1] "" Host
 SG_ BATT_packCellSoftShort_4 : 26|1@1+ (1,0) [0|1] "" Host
 SG_ BATT_iOverHardware_4 : 24|1@1+ (1,0) [0|1] "" Host
 SG_ BATT_fetOverTemp_4 : 15|1@1+ (1,0) [0|1] "" Host
 SG_ BATT_iOverDischarge_4 : 14|1@1+ (1,0) [0|1] "" Host
 SG_ BATT_iOverCharge_4 : 13|1@1+ (1,0) [0|1] "" Host
 SG_ BATT_inverterDriveMIA_4 : 12|1@1+ (1,0) [0|1] "" Host
 SG_ BATT_iUnderCharge_4 : 11|1@1+ (1,0) [0|1] "" Host
 SG_ BATT_hostMIA_4 : 10|1@1+ (1,0) [0|1] "" Host
 SG_ BATT_fetDsgShorted_4 : 7|1@1+ (1,0) [0|1] "" Host
 SG_ BATT_fetDsgFailToClose_4 : 6|1@1+ (1,0) [0|1] "" Host
 SG_ BATT_capLow_4 : 5|1@1+ (1,0) [0|1] "" Host
 SG_ BATT_brickOverDischarge_4 : 4|1@1+ (1,0) [0|1] "" Host
 SG_ BATT_brickOverCharge_4 : 3|1@1+ (1,0) [0|1] "" Host
 SG_ BATT_bmsProcessorError_4 : 2|1@1+ (1,0) [0|1] "" Host
 SG_ BATT_bmsMemoryError_4 : 1|1@1+ (1,0) [0|1] "" Host
 SG_ BATT_afeError_4 : 0|1@1+ (1,0) [0|1] "" Host

BO_ 2571108357 BATT_eventMatrix_A_5: 8 Battery
 SG_ BATT_packModIdFault_5 : 8|1@1+ (1,0) [0|1] "" Host
 SG_ BATT_packModExitedFromBus_5 : 16|1@1+ (1,0) [0|1] "" Host
 SG_ BATT_packFetChgWelded_5 : 35|1@1+ (1,0) [0|1] "" Host
 SG_ BATT_packFetDsgWelded_5 : 36|1@1+ (1,0) [0|1] "" Host
 SG_ BATT_fetDsgShortedAux_5 : 63|1@1+ (1,0) [0|1] "" Host
 SG_ BATT_fetChgShortedAux_5 : 25|1@1+ (1,0) [0|1] "" Host
 SG_ BATT_prechargeFetFail_5 : 39|1@1+ (1,0) [0|1] "" Host
 SG_ BATT_abnormalResetReason_5 : 31|1@1+ (1,0) [0|1] "" Host
 SG_ BATT_prechargeTooSlow_5 : 49|1@1+ (1,0) [0|1] "" Host
 SG_ BATT_prechargeTooFast_5 : 50|1@1+ (1,0) [0|1] "" Host
 SG_ BATT_prechargeTimeout_5 : 51|1@1+ (1,0) [0|1] "" Host
 SG_ BATT_fetChgShorted_5 : 23|1@1+ (1,0) [0|1] "" Host
 SG_ BATT_fetChgFailToClose_5 : 22|1@1+ (1,0) [0|1] "" Host
 SG_ BATT_packModSelectFault_5 : 21|1@1+ (1,0) [0|1] "" Host
 SG_ BATT_packModConnectFault_5 : 20|1@1+ (1,0) [0|1] "" Host
 SG_ BATT_packModMIA_5 : 19|1@1+ (1,0) [0|1] "" Host
 SG_ BATT_packModImbalance_5 : 18|1@1+ (1,0) [0|1] "" Host
 SG_ BATT_afeFault_5 : 17|1@1+ (1,0) [0|1] "" Host
 SG_ BATT_chargerMIA_5 : 60|1@1+ (1,0) [0|1] "" Host
 SG_ BATT_chargerError_5 : 59|1@1+ (1,0) [0|1] "" Host
 SG_ BATT_vBrickUnderWar_5 : 58|1@1+ (1,0) [0|1] "" Host
 SG_ BATT_vBrickUnderSev_5 : 57|1@1+ (1,0) [0|1] "" Host
 SG_ BATT_vBrickUnderMod_5 : 56|1@1+ (1,0) [0|1] "" Host
 SG_ BATT_vBrickOverWar_5 : 55|1@1+ (1,0) [0|1] "" Host
 SG_ BATT_vBrickOverSev_5 : 54|1@1+ (1,0) [0|1] "" Host
 SG_ BATT_vBrickOverMod_5 : 53|1@1+ (1,0) [0|1] "" Host
 SG_ BATT_vBrickImbalance_5 : 52|1@1+ (1,0) [0|1] "" Host
 SG_ BATT_loggerAlmostFull_5 : 61|1@1+ (1,0) [0|1] "" Host
 SG_ BATT_tempModuleUnderWar_5 : 48|1@1+ (1,0) [0|1] "" Host
 SG_ BATT_tempModuleUnderSev_5 : 47|1@1+ (1,0) [0|1] "" Host
 SG_ BATT_tempModuleUnderMod_5 : 46|1@1+ (1,0) [0|1] "" Host
 SG_ BATT_tempModuleOverWar_5 : 45|1@1+ (1,0) [0|1] "" Host
 SG_ BATT_tempModuleOverSev_5 : 44|1@1+ (1,0) [0|1] "" Host
 SG_ BATT_tempModuleOverMod_5 : 43|1@1+ (1,0) [0|1] "" Host
 SG_ BATT_tempBrickImbalance_5 : 42|1@1+ (1,0) [0|1] "" Host
 SG_ BATT_taskLockupError_5 : 41|1@1+ (1,0) [0|1] "" Host
 SG_ BATT_tempAmbientOverWar_5 : 40|1@1+ (1,0) [0|1] "" Host
 SG_ BATT_tempAmbientOverSev_5 : 38|1@1+ (1,0) [0|1] "" Host
 SG_ BATT_tempAmbientOverMod_5 : 37|1@1+ (1,0) [0|1] "" Host
 SG_ BATT_sensePackVoltError_5 : 34|1@1+ (1,0) [0|1] "" Host
 SG_ BATT_senseLoadVoltError_5 : 33|1@1+ (1,0) [0|1] "" Host
 SG_ BATT_loggerFull_5 : 62|1@1+ (1,0) [0|1] "" Host
 SG_ BATT_senseCurrentError_5 : 32|1@1+ (1,0) [0|1] "" Host
 SG_ BATT_senseBrickTempError_5 : 30|1@1+ (1,0) [0|1] "" Host
 SG_ BATT_resPackHigh_5 : 29|1@1+ (1,0) [0|1] "" Host
 SG_ BATT_ramOverUtilError_5 : 28|1@1+ (1,0) [0|1] "" Host
 SG_ BATT_powerPackInsufficient_5 : 27|1@1+ (1,0) [0|1] "" Host
 SG_ BATT_packCellSoftShort_5 : 26|1@1+ (1,0) [0|1] "" Host
 SG_ BATT_iOverHardware_5 : 24|1@1+ (1,0) [0|1] "" Host
 SG_ BATT_fetOverTemp_5 : 15|1@1+ (1,0) [0|1] "" Host
 SG_ BATT_iOverDischarge_5 : 14|1@1+ (1,0) [0|1] "" Host
 SG_ BATT_iOverCharge_5 : 13|1@1+ (1,0) [0|1] "" Host
 SG_ BATT_inverterDriveMIA_5 : 12|1@1+ (1,0) [0|1] "" Host
 SG_ BATT_iUnderCharge_5 : 11|1@1+ (1,0) [0|1] "" Host
 SG_ BATT_hostMIA_5 : 10|1@1+ (1,0) [0|1] "" Host
 SG_ BATT_fetDsgShorted_5 : 7|1@1+ (1,0) [0|1] "" Host
 SG_ BATT_fetDsgFailToClose_5 : 6|1@1+ (1,0) [0|1] "" Host
 SG_ BATT_capLow_5 : 5|1@1+ (1,0) [0|1] "" Host
 SG_ BATT_brickOverDischarge_5 : 4|1@1+ (1,0) [0|1] "" Host
 SG_ BATT_brickOverCharge_5 : 3|1@1+ (1,0) [0|1] "" Host
 SG_ BATT_bmsProcessorError_5 : 2|1@1+ (1,0) [0|1] "" Host
 SG_ BATT_bmsMemoryError_5 : 1|1@1+ (1,0) [0|1] "" Host
 SG_ BATT_afeError_5 : 0|1@1+ (1,0) [0|1] "" Host

BO_ 2571108358 BATT_eventMatrix_A_6: 8 Battery
 SG_ BATT_packModIdFault_6 : 8|1@1+ (1,0) [0|1] "" Host
 SG_ BATT_packModExitedFromBus_6 : 16|1@1+ (1,0) [0|1] "" Host
 SG_ BATT_packFetChgWelded_6 : 35|1@1+ (1,0) [0|1] "" Host
 SG_ BATT_packFetDsgWelded_6 : 36|1@1+ (1,0) [0|1] "" Host
 SG_ BATT_fetDsgShortedAux_6 : 63|1@1+ (1,0) [0|1] "" Host
 SG_ BATT_fetChgShortedAux_6 : 25|1@1+ (1,0) [0|1] "" Host
 SG_ BATT_prechargeFetFail_6 : 39|1@1+ (1,0) [0|1] "" Host
 SG_ BATT_abnormalResetReason_6 : 31|1@1+ (1,0) [0|1] "" Host
 SG_ BATT_prechargeTooSlow_6 : 49|1@1+ (1,0) [0|1] "" Host
 SG_ BATT_prechargeTooFast_6 : 50|1@1+ (1,0) [0|1] "" Host
 SG_ BATT_prechargeTimeout_6 : 51|1@1+ (1,0) [0|1] "" Host
 SG_ BATT_fetChgShorted_6 : 23|1@1+ (1,0) [0|1] "" Host
 SG_ BATT_fetChgFailToClose_6 : 22|1@1+ (1,0) [0|1] "" Host
 SG_ BATT_packModSelectFault_6 : 21|1@1+ (1,0) [0|1] "" Host
 SG_ BATT_packModConnectFault_6 : 20|1@1+ (1,0) [0|1] "" Host
 SG_ BATT_packModMIA_6 : 19|1@1+ (1,0) [0|1] "" Host
 SG_ BATT_packModImbalance_6 : 18|1@1+ (1,0) [0|1] "" Host
 SG_ BATT_afeFault_6 : 17|1@1+ (1,0) [0|1] "" Host
 SG_ BATT_chargerMIA_6 : 60|1@1+ (1,0) [0|1] "" Host
 SG_ BATT_chargerError_6 : 59|1@1+ (1,0) [0|1] "" Host
 SG_ BATT_vBrickUnderWar_6 : 58|1@1+ (1,0) [0|1] "" Host
 SG_ BATT_vBrickUnderSev_6 : 57|1@1+ (1,0) [0|1] "" Host
 SG_ BATT_vBrickUnderMod_6 : 56|1@1+ (1,0) [0|1] "" Host
 SG_ BATT_vBrickOverWar_6 : 55|1@1+ (1,0) [0|1] "" Host
 SG_ BATT_vBrickOverSev_6 : 54|1@1+ (1,0) [0|1] "" Host
 SG_ BATT_vBrickOverMod_6 : 53|1@1+ (1,0) [0|1] "" Host
 SG_ BATT_vBrickImbalance_6 : 52|1@1+ (1,0) [0|1] "" Host
 SG_ BATT_loggerAlmostFull_6 : 61|1@1+ (1,0) [0|1] "" Host
 SG_ BATT_tempModuleUnderWar_6 : 48|1@1+ (1,0) [0|1] "" Host
 SG_ BATT_tempModuleUnderSev_6 : 47|1@1+ (1,0) [0|1] "" Host
 SG_ BATT_tempModuleUnderMod_6 : 46|1@1+ (1,0) [0|1] "" Host
 SG_ BATT_tempModuleOverWar_6 : 45|1@1+ (1,0) [0|1] "" Host
 SG_ BATT_tempModuleOverSev_6 : 44|1@1+ (1,0) [0|1] "" Host
 SG_ BATT_tempModuleOverMod_6 : 43|1@1+ (1,0) [0|1] "" Host
 SG_ BATT_tempBrickImbalance_6 : 42|1@1+ (1,0) [0|1] "" Host
 SG_ BATT_taskLockupError_6 : 41|1@1+ (1,0) [0|1] "" Host
 SG_ BATT_tempAmbientOverWar_6 : 40|1@1+ (1,0) [0|1] "" Host
 SG_ BATT_tempAmbientOverSev_6 : 38|1@1+ (1,0) [0|1] "" Host
 SG_ BATT_tempAmbientOverMod_6 : 37|1@1+ (1,0) [0|1] "" Host
 SG_ BATT_sensePackVoltError_6 : 34|1@1+ (1,0) [0|1] "" Host
 SG_ BATT_senseLoadVoltError_6 : 33|1@1+ (1,0) [0|1] "" Host
 SG_ BATT_loggerFull_6 : 62|1@1+ (1,0) [0|1] "" Host
 SG_ BATT_senseCurrentError_6 : 32|1@1+ (1,0) [0|1] "" Host
 SG_ BATT_senseBrickTempError_6 : 30|1@1+ (1,0) [0|1] "" Host
 SG_ BATT_resPackHigh_6 : 29|1@1+ (1,0) [0|1] "" Host
 SG_ BATT_ramOverUtilError_6 : 28|1@1+ (1,0) [0|1] "" Host
 SG_ BATT_powerPackInsufficient_6 : 27|1@1+ (1,0) [0|1] "" Host
 SG_ BATT_packCellSoftShort_6 : 26|1@1+ (1,0) [0|1] "" Host
 SG_ BATT_iOverHardware_6 : 24|1@1+ (1,0) [0|1] "" Host
 SG_ BATT_fetOverTemp_6 : 15|1@1+ (1,0) [0|1] "" Host
 SG_ BATT_iOverDischarge_6 : 14|1@1+ (1,0) [0|1] "" Host
 SG_ BATT_iOverCharge_6 : 13|1@1+ (1,0) [0|1] "" Host
 SG_ BATT_inverterDriveMIA_6 : 12|1@1+ (1,0) [0|1] "" Host
 SG_ BATT_iUnderCharge_6 : 11|1@1+ (1,0) [0|1] "" Host
 SG_ BATT_hostMIA_6 : 10|1@1+ (1,0) [0|1] "" Host
 SG_ BATT_fetDsgShorted_6 : 7|1@1+ (1,0) [0|1] "" Host
 SG_ BATT_fetDsgFailToClose_6 : 6|1@1+ (1,0) [0|1] "" Host
 SG_ BATT_capLow_6 : 5|1@1+ (1,0) [0|1] "" Host
 SG_ BATT_brickOverDischarge_6 : 4|1@1+ (1,0) [0|1] "" Host
 SG_ BATT_brickOverCharge_6 : 3|1@1+ (1,0) [0|1] "" Host
 SG_ BATT_bmsProcessorError_6 : 2|1@1+ (1,0) [0|1] "" Host
 SG_ BATT_bmsMemoryError_6 : 1|1@1+ (1,0) [0|1] "" Host
 SG_ BATT_afeError_6 : 0|1@1+ (1,0) [0|1] "" Host

BO_ 2571108359 BATT_eventMatrix_A_7: 8 Battery
 SG_ BATT_packModIdFault_7 : 8|1@1+ (1,0) [0|1] "" Host
 SG_ BATT_packModExitedFromBus_7 : 16|1@1+ (1,0) [0|1] "" Host
 SG_ BATT_packFetChgWelded_7 : 35|1@1+ (1,0) [0|1] "" Host
 SG_ BATT_packFetDsgWelded_7 : 36|1@1+ (1,0) [0|1] "" Host
 SG_ BATT_fetDsgShortedAux_7 : 63|1@1+ (1,0) [0|1] "" Host
 SG_ BATT_fetChgShortedAux_7 : 25|1@1+ (1,0) [0|1] "" Host
 SG_ BATT_prechargeFetFail_7 : 39|1@1+ (1,0) [0|1] "" Host
 SG_ BATT_abnormalResetReason_7 : 31|1@1+ (1,0) [0|1] "" Host
 SG_ BATT_prechargeTooSlow_7 : 49|1@1+ (1,0) [0|1] "" Host
 SG_ BATT_prechargeTooFast_7 : 50|1@1+ (1,0) [0|1] "" Host
 SG_ BATT_prechargeTimeout_7 : 51|1@1+ (1,0) [0|1] "" Host
 SG_ BATT_fetChgShorted_7 : 23|1@1+ (1,0) [0|1] "" Host
 SG_ BATT_fetChgFailToClose_7 : 22|1@1+ (1,0) [0|1] "" Host
 SG_ BATT_packModSelectFault_7 : 21|1@1+ (1,0) [0|1] "" Host
 SG_ BATT_packModConnectFault_7 : 20|1@1+ (1,0) [0|1] "" Host
 SG_ BATT_packModMIA_7 : 19|1@1+ (1,0) [0|1] "" Host
 SG_ BATT_packModImbalance_7 : 18|1@1+ (1,0) [0|1] "" Host
 SG_ BATT_afeFault_7 : 17|1@1+ (1,0) [0|1] "" Host
 SG_ BATT_chargerMIA_7 : 60|1@1+ (1,0) [0|1] "" Host
 SG_ BATT_chargerError_7 : 59|1@1+ (1,0) [0|1] "" Host
 SG_ BATT_vBrickUnderWar_7 : 58|1@1+ (1,0) [0|1] "" Host
 SG_ BATT_vBrickUnderSev_7 : 57|1@1+ (1,0) [0|1] "" Host
 SG_ BATT_vBrickUnderMod_7 : 56|1@1+ (1,0) [0|1] "" Host
 SG_ BATT_vBrickOverWar_7 : 55|1@1+ (1,0) [0|1] "" Host
 SG_ BATT_vBrickOverSev_7 : 54|1@1+ (1,0) [0|1] "" Host
 SG_ BATT_vBrickOverMod_7 : 53|1@1+ (1,0) [0|1] "" Host
 SG_ BATT_vBrickImbalance_7 : 52|1@1+ (1,0) [0|1] "" Host
 SG_ BATT_loggerAlmostFull_7 : 61|1@1+ (1,0) [0|1] "" Host
 SG_ BATT_tempModuleUnderWar_7 : 48|1@1+ (1,0) [0|1] "" Host
 SG_ BATT_tempModuleUnderSev_7 : 47|1@1+ (1,0) [0|1] "" Host
 SG_ BATT_tempModuleUnderMod_7 : 46|1@1+ (1,0) [0|1] "" Host
 SG_ BATT_tempModuleOverWar_7 : 45|1@1+ (1,0) [0|1] "" Host
 SG_ BATT_tempModuleOverSev_7 : 44|1@1+ (1,0) [0|1] "" Host
 SG_ BATT_tempModuleOverMod_7 : 43|1@1+ (1,0) [0|1] "" Host
 SG_ BATT_tempBrickImbalance_7 : 42|1@1+ (1,0) [0|1] "" Host
 SG_ BATT_taskLockupError_7 : 41|1@1+ (1,0) [0|1] "" Host
 SG_ BATT_tempAmbientOverWar_7 : 40|1@1+ (1,0) [0|1] "" Host
 SG_ BATT_tempAmbientOverSev_7 : 38|1@1+ (1,0) [0|1] "" Host
 SG_ BATT_tempAmbientOverMod_7 : 37|1@1+ (1,0) [0|1] "" Host
 SG_ BATT_sensePackVoltError_7 : 34|1@1+ (1,0) [0|1] "" Host
 SG_ BATT_senseLoadVoltError_7 : 33|1@1+ (1,0) [0|1] "" Host
 SG_ BATT_loggerFull_7 : 62|1@1+ (1,0) [0|1] "" Host
 SG_ BATT_senseCurrentError_7 : 32|1@1+ (1,0) [0|1] "" Host
 SG_ BATT_senseBrickTempError_7 : 30|1@1+ (1,0) [0|1] "" Host
 SG_ BATT_resPackHigh_7 : 29|1@1+ (1,0) [0|1] "" Host
 SG_ BATT_ramOverUtilError_7 : 28|1@1+ (1,0) [0|1] "" Host
 SG_ BATT_powerPackInsufficient_7 : 27|1@1+ (1,0) [0|1] "" Host
 SG_ BATT_packCellSoftShort_7 : 26|1@1+ (1,0) [0|1] "" Host
 SG_ BATT_iOverHardware_7 : 24|1@1+ (1,0) [0|1] "" Host
 SG_ BATT_fetOverTemp_7 : 15|1@1+ (1,0) [0|1] "" Host
 SG_ BATT_iOverDischarge_7 : 14|1@1+ (1,0) [0|1] "" Host
 SG_ BATT_iOverCharge_7 : 13|1@1+ (1,0) [0|1] "" Host
 SG_ BATT_inverterDriveMIA_7 : 12|1@1+ (1,0) [0|1] "" Host
 SG_ BATT_iUnderCharge_7 : 11|1@1+ (1,0) [0|1] "" Host
 SG_ BATT_hostMIA_7 : 10|1@1+ (1,0) [0|1] "" Host
 SG_ BATT_fetDsgShorted_7 : 7|1@1+ (1,0) [0|1] "" Host
 SG_ BATT_fetDsgFailToClose_7 : 6|1@1+ (1,0) [0|1] "" Host
 SG_ BATT_capLow_7 : 5|1@1+ (1,0) [0|1] "" Host
 SG_ BATT_brickOverDischarge_7 : 4|1@1+ (1,0) [0|1] "" Host
 SG_ BATT_brickOverCharge_7 : 3|1@1+ (1,0) [0|1] "" Host
 SG_ BATT_bmsProcessorError_7 : 2|1@1+ (1,0) [0|1] "" Host
 SG_ BATT_bmsMemoryError_7 : 1|1@1+ (1,0) [0|1] "" Host
 SG_ BATT_afeError_7 : 0|1@1+ (1,0) [0|1] "" Host

BO_ 2571108360 BATT_eventMatrix_A_8: 8 Battery
 SG_ BATT_packModIdFault_8 : 8|1@1+ (1,0) [0|1] "" Host
 SG_ BATT_packModExitedFromBus_8 : 16|1@1+ (1,0) [0|1] "" Host
 SG_ BATT_packFetChgWelded_8 : 35|1@1+ (1,0) [0|1] "" Host
 SG_ BATT_packFetDsgWelded_8 : 36|1@1+ (1,0) [0|1] "" Host
 SG_ BATT_fetDsgShortedAux_8 : 63|1@1+ (1,0) [0|1] "" Host
 SG_ BATT_fetChgShortedAux_8 : 25|1@1+ (1,0) [0|1] "" Host
 SG_ BATT_prechargeFetFail_8 : 39|1@1+ (1,0) [0|1] "" Host
 SG_ BATT_abnormalResetReason_8 : 31|1@1+ (1,0) [0|1] "" Host
 SG_ BATT_prechargeTooSlow_8 : 49|1@1+ (1,0) [0|1] "" Host
 SG_ BATT_prechargeTooFast_8 : 50|1@1+ (1,0) [0|1] "" Host
 SG_ BATT_prechargeTimeout_8 : 51|1@1+ (1,0) [0|1] "" Host
 SG_ BATT_fetChgShorted_8 : 23|1@1+ (1,0) [0|1] "" Host
 SG_ BATT_fetChgFailToClose_8 : 22|1@1+ (1,0) [0|1] "" Host
 SG_ BATT_packModSelectFault_8 : 21|1@1+ (1,0) [0|1] "" Host
 SG_ BATT_packModConnectFault_8 : 20|1@1+ (1,0) [0|1] "" Host
 SG_ BATT_packModMIA_8 : 19|1@1+ (1,0) [0|1] "" Host
 SG_ BATT_packModImbalance_8 : 18|1@1+ (1,0) [0|1] "" Host
 SG_ BATT_afeFault_8 : 17|1@1+ (1,0) [0|1] "" Host
 SG_ BATT_chargerMIA_8 : 60|1@1+ (1,0) [0|1] "" Host
 SG_ BATT_chargerError_8 : 59|1@1+ (1,0) [0|1] "" Host
 SG_ BATT_vBrickUnderWar_8 : 58|1@1+ (1,0) [0|1] "" Host
 SG_ BATT_vBrickUnderSev_8 : 57|1@1+ (1,0) [0|1] "" Host
 SG_ BATT_vBrickUnderMod_8 : 56|1@1+ (1,0) [0|1] "" Host
 SG_ BATT_vBrickOverWar_8 : 55|1@1+ (1,0) [0|1] "" Host
 SG_ BATT_vBrickOverSev_8 : 54|1@1+ (1,0) [0|1] "" Host
 SG_ BATT_vBrickOverMod_8 : 53|1@1+ (1,0) [0|1] "" Host
 SG_ BATT_vBrickImbalance_8 : 52|1@1+ (1,0) [0|1] "" Host
 SG_ BATT_loggerAlmostFull_8 : 61|1@1+ (1,0) [0|1] "" Host
 SG_ BATT_tempModuleUnderWar_8 : 48|1@1+ (1,0) [0|1] "" Host
 SG_ BATT_tempModuleUnderSev_8 : 47|1@1+ (1,0) [0|1] "" Host
 SG_ BATT_tempModuleUnderMod_8 : 46|1@1+ (1,0) [0|1] "" Host
 SG_ BATT_tempModuleOverWar_8 : 45|1@1+ (1,0) [0|1] "" Host
 SG_ BATT_tempModuleOverSev_8 : 44|1@1+ (1,0) [0|1] "" Host
 SG_ BATT_tempModuleOverMod_8 : 43|1@1+ (1,0) [0|1] "" Host
 SG_ BATT_tempBrickImbalance_8 : 42|1@1+ (1,0) [0|1] "" Host
 SG_ BATT_taskLockupError_8 : 41|1@1+ (1,0) [0|1] "" Host
 SG_ BATT_tempAmbientOverWar_8 : 40|1@1+ (1,0) [0|1] "" Host
 SG_ BATT_tempAmbientOverSev_8 : 38|1@1+ (1,0) [0|1] "" Host
 SG_ BATT_tempAmbientOverMod_8 : 37|1@1+ (1,0) [0|1] "" Host
 SG_ BATT_sensePackVoltError_8 : 34|1@1+ (1,0) [0|1] "" Host
 SG_ BATT_senseLoadVoltError_8 : 33|1@1+ (1,0) [0|1] "" Host
 SG_ BATT_loggerFull_8 : 62|1@1+ (1,0) [0|1] "" Host
 SG_ BATT_senseCurrentError_8 : 32|1@1+ (1,0) [0|1] "" Host
 SG_ BATT_senseBrickTempError_8 : 30|1@1+ (1,0) [0|1] "" Host
 SG_ BATT_resPackHigh_8 : 29|1@1+ (1,0) [0|1] "" Host
 SG_ BATT_ramOverUtilError_8 : 28|1@1+ (1,0) [0|1] "" Host
 SG_ BATT_powerPackInsufficient_8 : 27|1@1+ (1,0) [0|1] "" Host
 SG_ BATT_packCellSoftShort_8 : 26|1@1+ (1,0) [0|1] "" Host
 SG_ BATT_iOverHardware_8 : 24|1@1+ (1,0) [0|1] "" Host
 SG_ BATT_fetOverTemp_8 : 15|1@1+ (1,0) [0|1] "" Host
 SG_ BATT_iOverDischarge_8 : 14|1@1+ (1,0) [0|1] "" Host
 SG_ BATT_iOverCharge_8 : 13|1@1+ (1,0) [0|1] "" Host
 SG_ BATT_inverterDriveMIA_8 : 12|1@1+ (1,0) [0|1] "" Host
 SG_ BATT_iUnderCharge_8 : 11|1@1+ (1,0) [0|1] "" Host
 SG_ BATT_hostMIA_8 : 10|1@1+ (1,0) [0|1] "" Host
 SG_ BATT_fetDsgShorted_8 : 7|1@1+ (1,0) [0|1] "" Host
 SG_ BATT_fetDsgFailToClose_8 : 6|1@1+ (1,0) [0|1] "" Host
 SG_ BATT_capLow_8 : 5|1@1+ (1,0) [0|1] "" Host
 SG_ BATT_brickOverDischarge_8 : 4|1@1+ (1,0) [0|1] "" Host
 SG_ BATT_brickOverCharge_8 : 3|1@1+ (1,0) [0|1] "" Host
 SG_ BATT_bmsProcessorError_8 : 2|1@1+ (1,0) [0|1] "" Host
 SG_ BATT_bmsMemoryError_8 : 1|1@1+ (1,0) [0|1] "" Host
 SG_ BATT_afeError_8 : 0|1@1+ (1,0) [0|1] "" Host

BO_ 2571108361 BATT_eventMatrix_A_9: 8 Battery
 SG_ BATT_packModIdFault_9 : 8|1@1+ (1,0) [0|1] "" Host
 SG_ BATT_packModExitedFromBus_9 : 16|1@1+ (1,0) [0|1] "" Host
 SG_ BATT_packFetChgWelded_9 : 35|1@1+ (1,0) [0|1] "" Host
 SG_ BATT_packFetDsgWelded_9 : 36|1@1+ (1,0) [0|1] "" Host
 SG_ BATT_fetDsgShortedAux_9 : 63|1@1+ (1,0) [0|1] "" Host
 SG_ BATT_fetChgShortedAux_9 : 25|1@1+ (1,0) [0|1] "" Host
 SG_ BATT_prechargeFetFail_9 : 39|1@1+ (1,0) [0|1] "" Host
 SG_ BATT_abnormalResetReason_9 : 31|1@1+ (1,0) [0|1] "" Host
 SG_ BATT_prechargeTooSlow_9 : 49|1@1+ (1,0) [0|1] "" Host
 SG_ BATT_prechargeTooFast_9 : 50|1@1+ (1,0) [0|1] "" Host
 SG_ BATT_prechargeTimeout_9 : 51|1@1+ (1,0) [0|1] "" Host
 SG_ BATT_fetChgShorted_9 : 23|1@1+ (1,0) [0|1] "" Host
 SG_ BATT_fetChgFailToClose_9 : 22|1@1+ (1,0) [0|1] "" Host
 SG_ BATT_packModSelectFault_9 : 21|1@1+ (1,0) [0|1] "" Host
 SG_ BATT_packModConnectFault_9 : 20|1@1+ (1,0) [0|1] "" Host
 SG_ BATT_packModMIA_9 : 19|1@1+ (1,0) [0|1] "" Host
 SG_ BATT_packModImbalance_9 : 18|1@1+ (1,0) [0|1] "" Host
 SG_ BATT_afeFault_9 : 17|1@1+ (1,0) [0|1] "" Host
 SG_ BATT_chargerMIA_9 : 60|1@1+ (1,0) [0|1] "" Host
 SG_ BATT_chargerError_9 : 59|1@1+ (1,0) [0|1] "" Host
 SG_ BATT_vBrickUnderWar_9 : 58|1@1+ (1,0) [0|1] "" Host
 SG_ BATT_vBrickUnderSev_9 : 57|1@1+ (1,0) [0|1] "" Host
 SG_ BATT_vBrickUnderMod_9 : 56|1@1+ (1,0) [0|1] "" Host
 SG_ BATT_vBrickOverWar_9 : 55|1@1+ (1,0) [0|1] "" Host
 SG_ BATT_vBrickOverSev_9 : 54|1@1+ (1,0) [0|1] "" Host
 SG_ BATT_vBrickOverMod_9 : 53|1@1+ (1,0) [0|1] "" Host
 SG_ BATT_vBrickImbalance_9 : 52|1@1+ (1,0) [0|1] "" Host
 SG_ BATT_loggerAlmostFull_9 : 61|1@1+ (1,0) [0|1] "" Host
 SG_ BATT_tempModuleUnderWar_9 : 48|1@1+ (1,0) [0|1] "" Host
 SG_ BATT_tempModuleUnderSev_9 : 47|1@1+ (1,0) [0|1] "" Host
 SG_ BATT_tempModuleUnderMod_9 : 46|1@1+ (1,0) [0|1] "" Host
 SG_ BATT_tempModuleOverWar_9 : 45|1@1+ (1,0) [0|1] "" Host
 SG_ BATT_tempModuleOverSev_9 : 44|1@1+ (1,0) [0|1] "" Host
 SG_ BATT_tempModuleOverMod_9 : 43|1@1+ (1,0) [0|1] "" Host
 SG_ BATT_tempBrickImbalance_9 : 42|1@1+ (1,0) [0|1] "" Host
 SG_ BATT_taskLockupError_9 : 41|1@1+ (1,0) [0|1] "" Host
 SG_ BATT_tempAmbientOverWar_9 : 40|1@1+ (1,0) [0|1] "" Host
 SG_ BATT_tempAmbientOverSev_9 : 38|1@1+ (1,0) [0|1] "" Host
 SG_ BATT_tempAmbientOverMod_9 : 37|1@1+ (1,0) [0|1] "" Host
 SG_ BATT_sensePackVoltError_9 : 34|1@1+ (1,0) [0|1] "" Host
 SG_ BATT_senseLoadVoltError_9 : 33|1@1+ (1,0) [0|1] "" Host
 SG_ BATT_loggerFull_9 : 62|1@1+ (1,0) [0|1] "" Host
 SG_ BATT_senseCurrentError_9 : 32|1@1+ (1,0) [0|1] "" Host
 SG_ BATT_senseBrickTempError_9 : 30|1@1+ (1,0) [0|1] "" Host
 SG_ BATT_resPackHigh_9 : 29|1@1+ (1,0) [0|1] "" Host
 SG_ BATT_ramOverUtilError_9 : 28|1@1+ (1,0) [0|1] "" Host
 SG_ BATT_powerPackInsufficient_9 : 27|1@1+ (1,0) [0|1] "" Host
 SG_ BATT_packCellSoftShort_9 : 26|1@1+ (1,0) [0|1] "" Host
 SG_ BATT_iOverHardware_9 : 24|1@1+ (1,0) [0|1] "" Host
 SG_ BATT_fetOverTemp_9 : 15|1@1+ (1,0) [0|1] "" Host
 SG_ BATT_iOverDischarge_9 : 14|1@1+ (1,0) [0|1] "" Host
 SG_ BATT_iOverCharge_9 : 13|1@1+ (1,0) [0|1] "" Host
 SG_ BATT_inverterDriveMIA_9 : 12|1@1+ (1,0) [0|1] "" Host
 SG_ BATT_iUnderCharge_9 : 11|1@1+ (1,0) [0|1] "" Host
 SG_ BATT_hostMIA_9 : 10|1@1+ (1,0) [0|1] "" Host
 SG_ BATT_fetDsgShorted_9 : 7|1@1+ (1,0) [0|1] "" Host
 SG_ BATT_fetDsgFailToClose_9 : 6|1@1+ (1,0) [0|1] "" Host
 SG_ BATT_capLow_9 : 5|1@1+ (1,0) [0|1] "" Host
 SG_ BATT_brickOverDischarge_9 : 4|1@1+ (1,0) [0|1] "" Host
 SG_ BATT_brickOverCharge_9 : 3|1@1+ (1,0) [0|1] "" Host
 SG_ BATT_bmsProcessorError_9 : 2|1@1+ (1,0) [0|1] "" Host
 SG_ BATT_bmsMemoryError_9 : 1|1@1+ (1,0) [0|1] "" Host
 SG_ BATT_afeError_9 : 0|1@1+ (1,0) [0|1] "" Host

BO_ 2571108362 BATT_eventMatrix_A_10: 8 Battery
 SG_ BATT_packModIdFault_10 : 8|1@1+ (1,0) [0|1] "" Host
 SG_ BATT_packModExitedFromBus_10 : 16|1@1+ (1,0) [0|1] "" Host
 SG_ BATT_packFetChgWelded_10 : 35|1@1+ (1,0) [0|1] "" Host
 SG_ BATT_packFetDsgWelded_10 : 36|1@1+ (1,0) [0|1] "" Host
 SG_ BATT_fetDsgShortedAux_10 : 63|1@1+ (1,0) [0|1] "" Host
 SG_ BATT_fetChgShortedAux_10 : 25|1@1+ (1,0) [0|1] "" Host
 SG_ BATT_prechargeFetFail_10 : 39|1@1+ (1,0) [0|1] "" Host
 SG_ BATT_abnormalResetReason_10 : 31|1@1+ (1,0) [0|1] "" Host
 SG_ BATT_prechargeTooSlow_10 : 49|1@1+ (1,0) [0|1] "" Host
 SG_ BATT_prechargeTooFast_10 : 50|1@1+ (1,0) [0|1] "" Host
 SG_ BATT_prechargeTimeout_10 : 51|1@1+ (1,0) [0|1] "" Host
 SG_ BATT_fetChgShorted_10 : 23|1@1+ (1,0) [0|1] "" Host
 SG_ BATT_fetChgFailToClose_10 : 22|1@1+ (1,0) [0|1] "" Host
 SG_ BATT_packModSelectFault_10 : 21|1@1+ (1,0) [0|1] "" Host
 SG_ BATT_packModConnectFault_10 : 20|1@1+ (1,0) [0|1] "" Host
 SG_ BATT_packModMIA_10 : 19|1@1+ (1,0) [0|1] "" Host
 SG_ BATT_packModImbalance_10 : 18|1@1+ (1,0) [0|1] "" Host
 SG_ BATT_afeFault_10 : 17|1@1+ (1,0) [0|1] "" Host
 SG_ BATT_chargerMIA_10 : 60|1@1+ (1,0) [0|1] "" Host
 SG_ BATT_chargerError_10 : 59|1@1+ (1,0) [0|1] "" Host
 SG_ BATT_vBrickUnderWar_10 : 58|1@1+ (1,0) [0|1] "" Host
 SG_ BATT_vBrickUnderSev_10 : 57|1@1+ (1,0) [0|1] "" Host
 SG_ BATT_vBrickUnderMod_10 : 56|1@1+ (1,0) [0|1] "" Host
 SG_ BATT_vBrickOverWar_10 : 55|1@1+ (1,0) [0|1] "" Host
 SG_ BATT_vBrickOverSev_10 : 54|1@1+ (1,0) [0|1] "" Host
 SG_ BATT_vBrickOverMod_10 : 53|1@1+ (1,0) [0|1] "" Host
 SG_ BATT_vBrickImbalance_10 : 52|1@1+ (1,0) [0|1] "" Host
 SG_ BATT_loggerAlmostFull_10 : 61|1@1+ (1,0) [0|1] "" Host
 SG_ BATT_tempModuleUnderWar_10 : 48|1@1+ (1,0) [0|1] "" Host
 SG_ BATT_tempModuleUnderSev_10 : 47|1@1+ (1,0) [0|1] "" Host
 SG_ BATT_tempModuleUnderMod_10 : 46|1@1+ (1,0) [0|1] "" Host
 SG_ BATT_tempModuleOverWar_10 : 45|1@1+ (1,0) [0|1] "" Host
 SG_ BATT_tempModuleOverSev_10 : 44|1@1+ (1,0) [0|1] "" Host
 SG_ BATT_tempModuleOverMod_10 : 43|1@1+ (1,0) [0|1] "" Host
 SG_ BATT_tempBrickImbalance_10 : 42|1@1+ (1,0) [0|1] "" Host
 SG_ BATT_taskLockupError_10 : 41|1@1+ (1,0) [0|1] "" Host
 SG_ BATT_tempAmbientOverWar_10 : 40|1@1+ (1,0) [0|1] "" Host
 SG_ BATT_tempAmbientOverSev_10 : 38|1@1+ (1,0) [0|1] "" Host
 SG_ BATT_tempAmbientOverMod_10 : 37|1@1+ (1,0) [0|1] "" Host
 SG_ BATT_sensePackVoltError_10 : 34|1@1+ (1,0) [0|1] "" Host
 SG_ BATT_senseLoadVoltError_10 : 33|1@1+ (1,0) [0|1] "" Host
 SG_ BATT_loggerFull_10 : 62|1@1+ (1,0) [0|1] "" Host
 SG_ BATT_senseCurrentError_10 : 32|1@1+ (1,0) [0|1] "" Host
 SG_ BATT_senseBrickTempError_10 : 30|1@1+ (1,0) [0|1] "" Host
 SG_ BATT_resPackHigh_10 : 29|1@1+ (1,0) [0|1] "" Host
 SG_ BATT_ramOverUtilError_10 : 28|1@1+ (1,0) [0|1] "" Host
 SG_ BATT_powerPackInsufficient_10 : 27|1@1+ (1,0) [0|1] "" Host
 SG_ BATT_packCellSoftShort_10 : 26|1@1+ (1,0) [0|1] "" Host
 SG_ BATT_iOverHardware_10 : 24|1@1+ (1,0) [0|1] "" Host
 SG_ BATT_fetOverTemp_10 : 15|1@1+ (1,0) [0|1] "" Host
 SG_ BATT_iOverDischarge_10 : 14|1@1+ (1,0) [0|1] "" Host
 SG_ BATT_iOverCharge_10 : 13|1@1+ (1,0) [0|1] "" Host
 SG_ BATT_inverterDriveMIA_10 : 12|1@1+ (1,0) [0|1] "" Host
 SG_ BATT_iUnderCharge_10 : 11|1@1+ (1,0) [0|1] "" Host
 SG_ BATT_hostMIA_10 : 10|1@1+ (1,0) [0|1] "" Host
 SG_ BATT_fetDsgShorted_10 : 7|1@1+ (1,0) [0|1] "" Host
 SG_ BATT_fetDsgFailToClose_10 : 6|1@1+ (1,0) [0|1] "" Host
 SG_ BATT_capLow_10 : 5|1@1+ (1,0) [0|1] "" Host
 SG_ BATT_brickOverDischarge_10 : 4|1@1+ (1,0) [0|1] "" Host
 SG_ BATT_brickOverCharge_10 : 3|1@1+ (1,0) [0|1] "" Host
 SG_ BATT_bmsProcessorError_10 : 2|1@1+ (1,0) [0|1] "" Host
 SG_ BATT_bmsMemoryError_10 : 1|1@1+ (1,0) [0|1] "" Host
 SG_ BATT_afeError_10 : 0|1@1+ (1,0) [0|1] "" Host

CM_ BO_ 2571108352 "Message with flags from event matrix";
CM_ SG_ 2571108352 BATT_packModIdFault_0 "0 - Battery pack module ID okay (default)
1 - Battery pack module ID fault";
CM_ SG_ 2571108352 BATT_packModExitedFromBus_0 "0 - Battery pack modules OK (default)
1 - Battery pack module(s) exited from the bus during charge or drive";
CM_ SG_ 2571108352 BATT_packFetChgWelded_0 "0 - Battery pack module CHG FETs not welded (default)
1 - Battery pack module CHG FETs welded ";
CM_ SG_ 2571108352 BATT_packFetDsgWelded_0 "0 - Battery pack module DSG FETs not welded (default)
1 - Battery pack module DSG FETs welded ";
CM_ SG_ 2571108352 BATT_fetDsgShortedAux_0 "0 - FETs are operational (default)
1 - FET is shorted detected by auxiliary diagnostic";
CM_ SG_ 2571108352 BATT_fetChgShortedAux_0 "0 - FETs are operational (default)
1 - FET is shorted detected by auxiliary diagnostic";
CM_ SG_ 2571108352 BATT_prechargeFetFail_0 "0 - Precharge FET okay (default)
1 - Precharge FET failed";
CM_ SG_ 2571108352 BATT_abnormalResetReason_0 "0 - Reset reason okay (default)
1 - Abnormal reset reason";
CM_ SG_ 2571108352 BATT_prechargeTooSlow_0 "0 - Precharge okay (default)
1 - Precharge too slow";
CM_ SG_ 2571108352 BATT_prechargeTooFast_0 "0 - Precharge okay (default)
1 - Precharge too fast";
CM_ SG_ 2571108352 BATT_prechargeTimeout_0 "0 - Precharge okay (default)
1 - Precharge timeout";
CM_ SG_ 2571108352 BATT_fetChgShorted_0 "0 - FETs are operational (default)
1 - FET is shorted";
CM_ SG_ 2571108352 BATT_fetChgFailToClose_0 "0 - FETs are operational (default)
1 -  FET fail to close";
CM_ SG_ 2571108352 BATT_packModSelectFault_0 "0 - Battery pack module selection okay (default)
1 - Battery pack module selection fault";
CM_ SG_ 2571108352 BATT_packModConnectFault_0 "0 - Battery pack module connection okay (default)
1 - Battery pack module connection fault";
CM_ SG_ 2571108352 BATT_packModMIA_0 "0 - Battery pack modules not MIA (default)
1 - Battery pack module MIA";
CM_ SG_ 2571108352 BATT_packModImbalance_0 "0 - Battery pack modules balanced (default)
1 - Battery pack module imblance present";
CM_ SG_ 2571108352 BATT_afeFault_0 "0 - BMS AFE okay (default)
1 - BMS AFE fault";
CM_ SG_ 2571108352 BATT_chargerMIA_0 "0 - Charger communications okay (default)
1 - Charger MIA";
CM_ SG_ 2571108352 BATT_chargerError_0 "0 - Charger working as intended (default)
1 - Charger error";
CM_ SG_ 2571108352 BATT_vBrickUnderWar_0 "0 - Brick voltage okay (default)
1 - Brick undervoltage warning";
CM_ SG_ 2571108352 BATT_vBrickUnderSev_0 "0 - Brick voltage okay (default)
1 - Brick undervoltage severe";
CM_ SG_ 2571108352 BATT_vBrickUnderMod_0 "0 - Brick voltage okay (default)
1 - Brick undervoltage moderate";
CM_ SG_ 2571108352 BATT_vBrickOverWar_0 "0 - Brick voltage okay (default)
1 - Brick overvoltage warning";
CM_ SG_ 2571108352 BATT_vBrickOverSev_0 "0 - Brick voltage okay (default)
1 - Brick overvoltage severe";
CM_ SG_ 2571108352 BATT_vBrickOverMod_0 "0 - Brick voltage okay (default)
1 - Brick overvoltage moderate";
CM_ SG_ 2571108352 BATT_vBrickImbalance_0 "0 - Battery brick voltage okay (default)
1 - Battery brick voltage imbalance";
CM_ SG_ 2571108352 BATT_loggerAlmostFull_0 "0 - Logger not almost full (default)
1 - Logger almost full (section >= 80%) ";
CM_ SG_ 2571108352 BATT_tempModuleUnderWar_0 "0 - Battery temperature okay (default)
1 - Battery under temperature warning";
CM_ SG_ 2571108352 BATT_tempModuleUnderSev_0 "0 - Battery temperature okay (default)
1 - Battery under temperature severe";
CM_ SG_ 2571108352 BATT_tempModuleUnderMod_0 "0 - Battery temperature okay (default)
1 - Battery under temperature moderate";
CM_ SG_ 2571108352 BATT_tempModuleOverWar_0 "0 - Battery temperature okay (default)
1 - Battery over temperature warning";
CM_ SG_ 2571108352 BATT_tempModuleOverSev_0 "0 - Battery temperature okay (default)
1 - Battery over temperature severe";
CM_ SG_ 2571108352 BATT_tempModuleOverMod_0 "0 - Battery temperature okay (default)
1 - Battery over temperature moderate";
CM_ SG_ 2571108352 BATT_tempBrickImbalance_0 "0 - Brick temperatures are balanced (default)
1 - Brick temperatures are imbalanced";
CM_ SG_ 2571108352 BATT_taskLockupError_0 "0 - Tasks okay (default)
1 - Task lockup error";
CM_ SG_ 2571108352 BATT_tempAmbientOverWar_0 "0 - Ambient temperature okay (default)
1 - Ambient over temperature warning";
CM_ SG_ 2571108352 BATT_tempAmbientOverSev_0 "0 - Temperature okay (default)
1 - Ambient over temperature severe";
CM_ SG_ 2571108352 BATT_tempAmbientOverMod_0 "0 - Ambient temperature okay (default)
1 - Ambient over temparature moderate";
CM_ SG_ 2571108352 BATT_sensePackVoltError_0 "0 - Sensor okay (default)
1 - Sensor for pack voltage error";
CM_ SG_ 2571108352 BATT_senseLoadVoltError_0 "0 - Sensor okay (default)
1 - Sensor for load voltage error";
CM_ SG_ 2571108352 BATT_loggerFull_0 "0 - Logger not full (default)
1 - Logger full ";
CM_ SG_ 2571108352 BATT_senseCurrentError_0 "0 - Sensor okay (default)
1 - Sensor for current error";
CM_ SG_ 2571108352 BATT_senseBrickTempError_0 "0 - Sensor okay (default)
1 - Brick temperature sensor error";
CM_ SG_ 2571108352 BATT_resPackHigh_0 "0 - Battery pack resistance okay (default)
1 - Battery pack resistance high (High SOH-R)";
CM_ SG_ 2571108352 BATT_ramOverUtilError_0 "0 - RAM okay (default)
1 - RAM over utilization";
CM_ SG_ 2571108352 BATT_powerPackInsufficient_0 "0 - Battery pack power okay (default)
1 - Battery pack power insufficient";
CM_ SG_ 2571108352 BATT_packCellSoftShort_0 "0 - Battery back cells are okay (default)
1 - Battery pack cell soft short";
CM_ SG_ 2571108352 BATT_iOverHardware_0 "0 - Hardware current okay (default)
1 - Overcurrent in hardware";
CM_ SG_ 2571108352 BATT_fetOverTemp_0 "0 - FET temperature okay (default)
1 - Overtemp at FETs";
CM_ SG_ 2571108352 BATT_iOverDischarge_0 "0 - Discharge okay (default)
1 - Overcurrent during discharge";
CM_ SG_ 2571108352 BATT_iOverCharge_0 "0 - Charging okay (default)
1 - Overcurrent during charging";
CM_ SG_ 2571108352 BATT_inverterDriveMIA_0 "0 - Inverter drive present (default)
1 - Inverter drive MIA";
CM_ SG_ 2571108352 BATT_iUnderCharge_0 "0 - Normal charging (default)
1 -  Charging undercurrent (discharging)";
CM_ SG_ 2571108352 BATT_hostMIA_0 "0 - host communication open (default)
1 - host MIA";
CM_ SG_ 2571108352 BATT_fetDsgShorted_0 "0 - FETs are operational (default)
1 - FET is shorted";
CM_ SG_ 2571108352 BATT_fetDsgFailToClose_0 "0 - FETs are operational (default)
1 -  FET fail to close";
CM_ SG_ 2571108352 BATT_capLow_0 "0 - Battery capacity normal (SOH-C) (default)
1 - Low battery capacity (Low SOH-C)";
CM_ SG_ 2571108352 BATT_brickOverDischarge_0 "0 - Battery brick charge is normal (default)
1 - Battery brick is overdischarged";
CM_ SG_ 2571108352 BATT_brickOverCharge_0 "0 - Battery brick charge is normal (default)
1 - Battery brick is overcharged";
CM_ SG_ 2571108352 BATT_bmsProcessorError_0 "0 - No BMS processor failure (default)
1 - BMS processor failure";
CM_ SG_ 2571108352 BATT_bmsMemoryError_0 "0 - No BMS memory error
1 - BMS memory error";
CM_ SG_ 2571108352 BATT_afeError_0 "0 - No BMS AFE error (default)
1 - BMS AFE error";
CM_ BO_ 2571108353 "Message with flags from event matrix";
CM_ SG_ 2571108353 BATT_packModIdFault_1 "0 - Battery pack module ID okay (default)
1 - Battery pack module ID fault";
CM_ SG_ 2571108353 BATT_packModExitedFromBus_1 "0 - Battery pack modules OK (default)
1 - Battery pack module(s) exited from the bus during charge or drive";
CM_ SG_ 2571108353 BATT_packFetChgWelded_1 "0 - Battery pack module CHG FETs not welded (default)
1 - Battery pack module CHG FETs welded ";
CM_ SG_ 2571108353 BATT_packFetDsgWelded_1 "0 - Battery pack module DSG FETs not welded (default)
1 - Battery pack module DSG FETs welded ";
CM_ SG_ 2571108353 BATT_fetDsgShortedAux_1 "0 - FETs are operational (default)
1 - FET is shorted detected by auxiliary diagnostic";
CM_ SG_ 2571108353 BATT_fetChgShortedAux_1 "0 - FETs are operational (default)
1 - FET is shorted detected by auxiliary diagnostic";
CM_ SG_ 2571108353 BATT_prechargeFetFail_1 "0 - Precharge FET okay (default)
1 - Precharge FET failed";
CM_ SG_ 2571108353 BATT_abnormalResetReason_1 "0 - Reset reason okay (default)
1 - Abnormal reset reason";
CM_ SG_ 2571108353 BATT_prechargeTooSlow_1 "0 - Precharge okay (default)
1 - Precharge too slow";
CM_ SG_ 2571108353 BATT_prechargeTooFast_1 "0 - Precharge okay (default)
1 - Precharge too fast";
CM_ SG_ 2571108353 BATT_prechargeTimeout_1 "0 - Precharge okay (default)
1 - Precharge timeout";
CM_ SG_ 2571108353 BATT_fetChgShorted_1 "0 - FETs are operational (default)
1 - FET is shorted";
CM_ SG_ 2571108353 BATT_fetChgFailToClose_1 "0 - FETs are operational (default)
1 -  FET fail to close";
CM_ SG_ 2571108353 BATT_packModSelectFault_1 "0 - Battery pack module selection okay (default)
1 - Battery pack module selection fault";
CM_ SG_ 2571108353 BATT_packModConnectFault_1 "0 - Battery pack module connection okay (default)
1 - Battery pack module connection fault";
CM_ SG_ 2571108353 BATT_packModMIA_1 "0 - Battery pack modules not MIA (default)
1 - Battery pack module MIA";
CM_ SG_ 2571108353 BATT_packModImbalance_1 "0 - Battery pack modules balanced (default)
1 - Battery pack module imblance present";
CM_ SG_ 2571108353 BATT_afeFault_1 "0 - BMS AFE okay (default)
1 - BMS AFE fault";
CM_ SG_ 2571108353 BATT_chargerMIA_1 "0 - Charger communications okay (default)
1 - Charger MIA";
CM_ SG_ 2571108353 BATT_chargerError_1 "0 - Charger working as intended (default)
1 - Charger error";
CM_ SG_ 2571108353 BATT_vBrickUnderWar_1 "0 - Brick voltage okay (default)
1 - Brick undervoltage warning";
CM_ SG_ 2571108353 BATT_vBrickUnderSev_1 "0 - Brick voltage okay (default)
1 - Brick undervoltage severe";
CM_ SG_ 2571108353 BATT_vBrickUnderMod_1 "0 - Brick voltage okay (default)
1 - Brick undervoltage moderate";
CM_ SG_ 2571108353 BATT_vBrickOverWar_1 "0 - Brick voltage okay (default)
1 - Brick overvoltage warning";
CM_ SG_ 2571108353 BATT_vBrickOverSev_1 "0 - Brick voltage okay (default)
1 - Brick overvoltage severe";
CM_ SG_ 2571108353 BATT_vBrickOverMod_1 "0 - Brick voltage okay (default)
1 - Brick overvoltage moderate";
CM_ SG_ 2571108353 BATT_vBrickImbalance_1 "0 - Battery brick voltage okay (default)
1 - Battery brick voltage imbalance";
CM_ SG_ 2571108353 BATT_loggerAlmostFull_1 "0 - Logger not almost full (default)
1 - Logger almost full (section >= 80%) ";
CM_ SG_ 2571108353 BATT_tempModuleUnderWar_1 "0 - Battery temperature okay (default)
1 - Battery under temperature warning";
CM_ SG_ 2571108353 BATT_tempModuleUnderSev_1 "0 - Battery temperature okay (default)
1 - Battery under temperature severe";
CM_ SG_ 2571108353 BATT_tempModuleUnderMod_1 "0 - Battery temperature okay (default)
1 - Battery under temperature moderate";
CM_ SG_ 2571108353 BATT_tempModuleOverWar_1 "0 - Battery temperature okay (default)
1 - Battery over temperature warning";
CM_ SG_ 2571108353 BATT_tempModuleOverSev_1 "0 - Battery temperature okay (default)
1 - Battery over temperature severe";
CM_ SG_ 2571108353 BATT_tempModuleOverMod_1 "0 - Battery temperature okay (default)
1 - Battery over temperature moderate";
CM_ SG_ 2571108353 BATT_tempBrickImbalance_1 "0 - Brick temperatures are balanced (default)
1 - Brick temperatures are imbalanced";
CM_ SG_ 2571108353 BATT_taskLockupError_1 "0 - Tasks okay (default)
1 - Task lockup error";
CM_ SG_ 2571108353 BATT_tempAmbientOverWar_1 "0 - Ambient temperature okay (default)
1 - Ambient over temperature warning";
CM_ SG_ 2571108353 BATT_tempAmbientOverSev_1 "0 - Temperature okay (default)
1 - Ambient over temperature severe";
CM_ SG_ 2571108353 BATT_tempAmbientOverMod_1 "0 - Ambient temperature okay (default)
1 - Ambient over temparature moderate";
CM_ SG_ 2571108353 BATT_sensePackVoltError_1 "0 - Sensor okay (default)
1 - Sensor for pack voltage error";
CM_ SG_ 2571108353 BATT_senseLoadVoltError_1 "0 - Sensor okay (default)
1 - Sensor for load voltage error";
CM_ SG_ 2571108353 BATT_loggerFull_1 "0 - Logger not full (default)
1 - Logger full ";
CM_ SG_ 2571108353 BATT_senseCurrentError_1 "0 - Sensor okay (default)
1 - Sensor for current error";
CM_ SG_ 2571108353 BATT_senseBrickTempError_1 "0 - Sensor okay (default)
1 - Brick temperature sensor error";
CM_ SG_ 2571108353 BATT_resPackHigh_1 "0 - Battery pack resistance okay (default)
1 - Battery pack resistance high (High SOH-R)";
CM_ SG_ 2571108353 BATT_ramOverUtilError_1 "0 - RAM okay (default)
1 - RAM over utilization";
CM_ SG_ 2571108353 BATT_powerPackInsufficient_1 "0 - Battery pack power okay (default)
1 - Battery pack power insufficient";
CM_ SG_ 2571108353 BATT_packCellSoftShort_1 "0 - Battery back cells are okay (default)
1 - Battery pack cell soft short";
CM_ SG_ 2571108353 BATT_iOverHardware_1 "0 - Hardware current okay (default)
1 - Overcurrent in hardware";
CM_ SG_ 2571108353 BATT_fetOverTemp_1 "0 - FET temperature okay (default)
1 - Overtemp at FETs";
CM_ SG_ 2571108353 BATT_iOverDischarge_1 "0 - Discharge okay (default)
1 - Overcurrent during discharge";
CM_ SG_ 2571108353 BATT_iOverCharge_1 "0 - Charging okay (default)
1 - Overcurrent during charging";
CM_ SG_ 2571108353 BATT_inverterDriveMIA_1 "0 - Inverter drive present (default)
1 - Inverter drive MIA";
CM_ SG_ 2571108353 BATT_iUnderCharge_1 "0 - Normal charging (default)
1 -  Charging undercurrent (discharging)";
CM_ SG_ 2571108353 BATT_hostMIA_1 "0 - host communication open (default)
1 - host MIA";
CM_ SG_ 2571108353 BATT_fetDsgShorted_1 "0 - FETs are operational (default)
1 - FET is shorted";
CM_ SG_ 2571108353 BATT_fetDsgFailToClose_1 "0 - FETs are operational (default)
1 -  FET fail to close";
CM_ SG_ 2571108353 BATT_capLow_1 "0 - Battery capacity normal (SOH-C) (default)
1 - Low battery capacity (Low SOH-C)";
CM_ SG_ 2571108353 BATT_brickOverDischarge_1 "0 - Battery brick charge is normal (default)
1 - Battery brick is overdischarged";
CM_ SG_ 2571108353 BATT_brickOverCharge_1 "0 - Battery brick charge is normal (default)
1 - Battery brick is overcharged";
CM_ SG_ 2571108353 BATT_bmsProcessorError_1 "0 - No BMS processor failure (default)
1 - BMS processor failure";
CM_ SG_ 2571108353 BATT_bmsMemoryError_1 "0 - No BMS memory error
1 - BMS memory error";
CM_ SG_ 2571108353 BATT_afeError_1 "0 - No BMS AFE error (default)
1 - BMS AFE error";
CM_ BO_ 2571108354 "Message with flags from event matrix";
CM_ SG_ 2571108354 BATT_packModIdFault_2 "0 - Battery pack module ID okay (default)
1 - Battery pack module ID fault";
CM_ SG_ 2571108354 BATT_packModExitedFromBus_2 "0 - Battery pack modules OK (default)
1 - Battery pack module(s) exited from the bus during charge or drive";
CM_ SG_ 2571108354 BATT_packFetChgWelded_2 "0 - Battery pack module CHG FETs not welded (default)
1 - Battery pack module CHG FETs welded ";
CM_ SG_ 2571108354 BATT_packFetDsgWelded_2 "0 - Battery pack module DSG FETs not welded (default)
1 - Battery pack module DSG FETs welded ";
CM_ SG_ 2571108354 BATT_fetDsgShortedAux_2 "0 - FETs are operational (default)
1 - FET is shorted detected by auxiliary diagnostic";
CM_ SG_ 2571108354 BATT_fetChgShortedAux_2 "0 - FETs are operational (default)
1 - FET is shorted detected by auxiliary diagnostic";
CM_ SG_ 2571108354 BATT_prechargeFetFail_2 "0 - Precharge FET okay (default)
1 - Precharge FET failed";
CM_ SG_ 2571108354 BATT_abnormalResetReason_2 "0 - Reset reason okay (default)
1 - Abnormal reset reason";
CM_ SG_ 2571108354 BATT_prechargeTooSlow_2 "0 - Precharge okay (default)
1 - Precharge too slow";
CM_ SG_ 2571108354 BATT_prechargeTooFast_2 "0 - Precharge okay (default)
1 - Precharge too fast";
CM_ SG_ 2571108354 BATT_prechargeTimeout_2 "0 - Precharge okay (default)
1 - Precharge timeout";
CM_ SG_ 2571108354 BATT_fetChgShorted_2 "0 - FETs are operational (default)
1 - FET is shorted";
CM_ SG_ 2571108354 BATT_fetChgFailToClose_2 "0 - FETs are operational (default)
1 -  FET fail to close";
CM_ SG_ 2571108354 BATT_packModSelectFault_2 "0 - Battery pack module selection okay (default)
1 - Battery pack module selection fault";
CM_ SG_ 2571108354 BATT_packModConnectFault_2 "0 - Battery pack module connection okay (default)
1 - Battery pack module connection fault";
CM_ SG_ 2571108354 BATT_packModMIA_2 "0 - Battery pack modules not MIA (default)
1 - Battery pack module MIA";
CM_ SG_ 2571108354 BATT_packModImbalance_2 "0 - Battery pack modules balanced (default)
1 - Battery pack module imblance present";
CM_ SG_ 2571108354 BATT_afeFault_2 "0 - BMS AFE okay (default)
1 - BMS AFE fault";
CM_ SG_ 2571108354 BATT_chargerMIA_2 "0 - Charger communications okay (default)
1 - Charger MIA";
CM_ SG_ 2571108354 BATT_chargerError_2 "0 - Charger working as intended (default)
1 - Charger error";
CM_ SG_ 2571108354 BATT_vBrickUnderWar_2 "0 - Brick voltage okay (default)
1 - Brick undervoltage warning";
CM_ SG_ 2571108354 BATT_vBrickUnderSev_2 "0 - Brick voltage okay (default)
1 - Brick undervoltage severe";
CM_ SG_ 2571108354 BATT_vBrickUnderMod_2 "0 - Brick voltage okay (default)
1 - Brick undervoltage moderate";
CM_ SG_ 2571108354 BATT_vBrickOverWar_2 "0 - Brick voltage okay (default)
1 - Brick overvoltage warning";
CM_ SG_ 2571108354 BATT_vBrickOverSev_2 "0 - Brick voltage okay (default)
1 - Brick overvoltage severe";
CM_ SG_ 2571108354 BATT_vBrickOverMod_2 "0 - Brick voltage okay (default)
1 - Brick overvoltage moderate";
CM_ SG_ 2571108354 BATT_vBrickImbalance_2 "0 - Battery brick voltage okay (default)
1 - Battery brick voltage imbalance";
CM_ SG_ 2571108354 BATT_loggerAlmostFull_2 "0 - Logger not almost full (default)
1 - Logger almost full (section >= 80%) ";
CM_ SG_ 2571108354 BATT_tempModuleUnderWar_2 "0 - Battery temperature okay (default)
1 - Battery under temperature warning";
CM_ SG_ 2571108354 BATT_tempModuleUnderSev_2 "0 - Battery temperature okay (default)
1 - Battery under temperature severe";
CM_ SG_ 2571108354 BATT_tempModuleUnderMod_2 "0 - Battery temperature okay (default)
1 - Battery under temperature moderate";
CM_ SG_ 2571108354 BATT_tempModuleOverWar_2 "0 - Battery temperature okay (default)
1 - Battery over temperature warning";
CM_ SG_ 2571108354 BATT_tempModuleOverSev_2 "0 - Battery temperature okay (default)
1 - Battery over temperature severe";
CM_ SG_ 2571108354 BATT_tempModuleOverMod_2 "0 - Battery temperature okay (default)
1 - Battery over temperature moderate";
CM_ SG_ 2571108354 BATT_tempBrickImbalance_2 "0 - Brick temperatures are balanced (default)
1 - Brick temperatures are imbalanced";
CM_ SG_ 2571108354 BATT_taskLockupError_2 "0 - Tasks okay (default)
1 - Task lockup error";
CM_ SG_ 2571108354 BATT_tempAmbientOverWar_2 "0 - Ambient temperature okay (default)
1 - Ambient over temperature warning";
CM_ SG_ 2571108354 BATT_tempAmbientOverSev_2 "0 - Temperature okay (default)
1 - Ambient over temperature severe";
CM_ SG_ 2571108354 BATT_tempAmbientOverMod_2 "0 - Ambient temperature okay (default)
1 - Ambient over temparature moderate";
CM_ SG_ 2571108354 BATT_sensePackVoltError_2 "0 - Sensor okay (default)
1 - Sensor for pack voltage error";
CM_ SG_ 2571108354 BATT_senseLoadVoltError_2 "0 - Sensor okay (default)
1 - Sensor for load voltage error";
CM_ SG_ 2571108354 BATT_loggerFull_2 "0 - Logger not full (default)
1 - Logger full ";
CM_ SG_ 2571108354 BATT_senseCurrentError_2 "0 - Sensor okay (default)
1 - Sensor for current error";
CM_ SG_ 2571108354 BATT_senseBrickTempError_2 "0 - Sensor okay (default)
1 - Brick temperature sensor error";
CM_ SG_ 2571108354 BATT_resPackHigh_2 "0 - Battery pack resistance okay (default)
1 - Battery pack resistance high (High SOH-R)";
CM_ SG_ 2571108354 BATT_ramOverUtilError_2 "0 - RAM okay (default)
1 - RAM over utilization";
CM_ SG_ 2571108354 BATT_powerPackInsufficient_2 "0 - Battery pack power okay (default)
1 - Battery pack power insufficient";
CM_ SG_ 2571108354 BATT_packCellSoftShort_2 "0 - Battery back cells are okay (default)
1 - Battery pack cell soft short";
CM_ SG_ 2571108354 BATT_iOverHardware_2 "0 - Hardware current okay (default)
1 - Overcurrent in hardware";
CM_ SG_ 2571108354 BATT_fetOverTemp_2 "0 - FET temperature okay (default)
1 - Overtemp at FETs";
CM_ SG_ 2571108354 BATT_iOverDischarge_2 "0 - Discharge okay (default)
1 - Overcurrent during discharge";
CM_ SG_ 2571108354 BATT_iOverCharge_2 "0 - Charging okay (default)
1 - Overcurrent during charging";
CM_ SG_ 2571108354 BATT_inverterDriveMIA_2 "0 - Inverter drive present (default)
1 - Inverter drive MIA";
CM_ SG_ 2571108354 BATT_iUnderCharge_2 "0 - Normal charging (default)
1 -  Charging undercurrent (discharging)";
CM_ SG_ 2571108354 BATT_hostMIA_2 "0 - host communication open (default)
1 - host MIA";
CM_ SG_ 2571108354 BATT_fetDsgShorted_2 "0 - FETs are operational (default)
1 - FET is shorted";
CM_ SG_ 2571108354 BATT_fetDsgFailToClose_2 "0 - FETs are operational (default)
1 -  FET fail to close";
CM_ SG_ 2571108354 BATT_capLow_2 "0 - Battery capacity normal (SOH-C) (default)
1 - Low battery capacity (Low SOH-C)";
CM_ SG_ 2571108354 BATT_brickOverDischarge_2 "0 - Battery brick charge is normal (default)
1 - Battery brick is overdischarged";
CM_ SG_ 2571108354 BATT_brickOverCharge_2 "0 - Battery brick charge is normal (default)
1 - Battery brick is overcharged";
CM_ SG_ 2571108354 BATT_bmsProcessorError_2 "0 - No BMS processor failure (default)
1 - BMS processor failure";
CM_ SG_ 2571108354 BATT_bmsMemoryError_2 "0 - No BMS memory error
1 - BMS memory error";
CM_ SG_ 2571108354 BATT_afeError_2 "0 - No BMS AFE error (default)
1 - BMS AFE error";
CM_ BO_ 2571108355 "Message with flags from event matrix";
CM_ SG_ 2571108355 BATT_packModIdFault_3 "0 - Battery pack module ID okay (default)
1 - Battery pack module ID fault";
CM_ SG_ 2571108355 BATT_packModExitedFromBus_3 "0 - Battery pack modules OK (default)
1 - Battery pack module(s) exited from the bus during charge or drive";
CM_ SG_ 2571108355 BATT_packFetChgWelded_3 "0 - Battery pack module CHG FETs not welded (default)
1 - Battery pack module CHG FETs welded ";
CM_ SG_ 2571108355 BATT_packFetDsgWelded_3 "0 - Battery pack module DSG FETs not welded (default)
1 - Battery pack module DSG FETs welded ";
CM_ SG_ 2571108355 BATT_fetDsgShortedAux_3 "0 - FETs are operational (default)
1 - FET is shorted detected by auxiliary diagnostic";
CM_ SG_ 2571108355 BATT_fetChgShortedAux_3 "0 - FETs are operational (default)
1 - FET is shorted detected by auxiliary diagnostic";
CM_ SG_ 2571108355 BATT_prechargeFetFail_3 "0 - Precharge FET okay (default)
1 - Precharge FET failed";
CM_ SG_ 2571108355 BATT_abnormalResetReason_3 "0 - Reset reason okay (default)
1 - Abnormal reset reason";
CM_ SG_ 2571108355 BATT_prechargeTooSlow_3 "0 - Precharge okay (default)
1 - Precharge too slow";
CM_ SG_ 2571108355 BATT_prechargeTooFast_3 "0 - Precharge okay (default)
1 - Precharge too fast";
CM_ SG_ 2571108355 BATT_prechargeTimeout_3 "0 - Precharge okay (default)
1 - Precharge timeout";
CM_ SG_ 2571108355 BATT_fetChgShorted_3 "0 - FETs are operational (default)
1 - FET is shorted";
CM_ SG_ 2571108355 BATT_fetChgFailToClose_3 "0 - FETs are operational (default)
1 -  FET fail to close";
CM_ SG_ 2571108355 BATT_packModSelectFault_3 "0 - Battery pack module selection okay (default)
1 - Battery pack module selection fault";
CM_ SG_ 2571108355 BATT_packModConnectFault_3 "0 - Battery pack module connection okay (default)
1 - Battery pack module connection fault";
CM_ SG_ 2571108355 BATT_packModMIA_3 "0 - Battery pack modules not MIA (default)
1 - Battery pack module MIA";
CM_ SG_ 2571108355 BATT_packModImbalance_3 "0 - Battery pack modules balanced (default)
1 - Battery pack module imblance present";
CM_ SG_ 2571108355 BATT_afeFault_3 "0 - BMS AFE okay (default)
1 - BMS AFE fault";
CM_ SG_ 2571108355 BATT_chargerMIA_3 "0 - Charger communications okay (default)
1 - Charger MIA";
CM_ SG_ 2571108355 BATT_chargerError_3 "0 - Charger working as intended (default)
1 - Charger error";
CM_ SG_ 2571108355 BATT_vBrickUnderWar_3 "0 - Brick voltage okay (default)
1 - Brick undervoltage warning";
CM_ SG_ 2571108355 BATT_vBrickUnderSev_3 "0 - Brick voltage okay (default)
1 - Brick undervoltage severe";
CM_ SG_ 2571108355 BATT_vBrickUnderMod_3 "0 - Brick voltage okay (default)
1 - Brick undervoltage moderate";
CM_ SG_ 2571108355 BATT_vBrickOverWar_3 "0 - Brick voltage okay (default)
1 - Brick overvoltage warning";
CM_ SG_ 2571108355 BATT_vBrickOverSev_3 "0 - Brick voltage okay (default)
1 - Brick overvoltage severe";
CM_ SG_ 2571108355 BATT_vBrickOverMod_3 "0 - Brick voltage okay (default)
1 - Brick overvoltage moderate";
CM_ SG_ 2571108355 BATT_vBrickImbalance_3 "0 - Battery brick voltage okay (default)
1 - Battery brick voltage imbalance";
CM_ SG_ 2571108355 BATT_loggerAlmostFull_3 "0 - Logger not almost full (default)
1 - Logger almost full (section >= 80%) ";
CM_ SG_ 2571108355 BATT_tempModuleUnderWar_3 "0 - Battery temperature okay (default)
1 - Battery under temperature warning";
CM_ SG_ 2571108355 BATT_tempModuleUnderSev_3 "0 - Battery temperature okay (default)
1 - Battery under temperature severe";
CM_ SG_ 2571108355 BATT_tempModuleUnderMod_3 "0 - Battery temperature okay (default)
1 - Battery under temperature moderate";
CM_ SG_ 2571108355 BATT_tempModuleOverWar_3 "0 - Battery temperature okay (default)
1 - Battery over temperature warning";
CM_ SG_ 2571108355 BATT_tempModuleOverSev_3 "0 - Battery temperature okay (default)
1 - Battery over temperature severe";
CM_ SG_ 2571108355 BATT_tempModuleOverMod_3 "0 - Battery temperature okay (default)
1 - Battery over temperature moderate";
CM_ SG_ 2571108355 BATT_tempBrickImbalance_3 "0 - Brick temperatures are balanced (default)
1 - Brick temperatures are imbalanced";
CM_ SG_ 2571108355 BATT_taskLockupError_3 "0 - Tasks okay (default)
1 - Task lockup error";
CM_ SG_ 2571108355 BATT_tempAmbientOverWar_3 "0 - Ambient temperature okay (default)
1 - Ambient over temperature warning";
CM_ SG_ 2571108355 BATT_tempAmbientOverSev_3 "0 - Temperature okay (default)
1 - Ambient over temperature severe";
CM_ SG_ 2571108355 BATT_tempAmbientOverMod_3 "0 - Ambient temperature okay (default)
1 - Ambient over temparature moderate";
CM_ SG_ 2571108355 BATT_sensePackVoltError_3 "0 - Sensor okay (default)
1 - Sensor for pack voltage error";
CM_ SG_ 2571108355 BATT_senseLoadVoltError_3 "0 - Sensor okay (default)
1 - Sensor for load voltage error";
CM_ SG_ 2571108355 BATT_loggerFull_3 "0 - Logger not full (default)
1 - Logger full ";
CM_ SG_ 2571108355 BATT_senseCurrentError_3 "0 - Sensor okay (default)
1 - Sensor for current error";
CM_ SG_ 2571108355 BATT_senseBrickTempError_3 "0 - Sensor okay (default)
1 - Brick temperature sensor error";
CM_ SG_ 2571108355 BATT_resPackHigh_3 "0 - Battery pack resistance okay (default)
1 - Battery pack resistance high (High SOH-R)";
CM_ SG_ 2571108355 BATT_ramOverUtilError_3 "0 - RAM okay (default)
1 - RAM over utilization";
CM_ SG_ 2571108355 BATT_powerPackInsufficient_3 "0 - Battery pack power okay (default)
1 - Battery pack power insufficient";
CM_ SG_ 2571108355 BATT_packCellSoftShort_3 "0 - Battery back cells are okay (default)
1 - Battery pack cell soft short";
CM_ SG_ 2571108355 BATT_iOverHardware_3 "0 - Hardware current okay (default)
1 - Overcurrent in hardware";
CM_ SG_ 2571108355 BATT_fetOverTemp_3 "0 - FET temperature okay (default)
1 - Overtemp at FETs";
CM_ SG_ 2571108355 BATT_iOverDischarge_3 "0 - Discharge okay (default)
1 - Overcurrent during discharge";
CM_ SG_ 2571108355 BATT_iOverCharge_3 "0 - Charging okay (default)
1 - Overcurrent during charging";
CM_ SG_ 2571108355 BATT_inverterDriveMIA_3 "0 - Inverter drive present (default)
1 - Inverter drive MIA";
CM_ SG_ 2571108355 BATT_iUnderCharge_3 "0 - Normal charging (default)
1 -  Charging undercurrent (discharging)";
CM_ SG_ 2571108355 BATT_hostMIA_3 "0 - host communication open (default)
1 - host MIA";
CM_ SG_ 2571108355 BATT_fetDsgShorted_3 "0 - FETs are operational (default)
1 - FET is shorted";
CM_ SG_ 2571108355 BATT_fetDsgFailToClose_3 "0 - FETs are operational (default)
1 -  FET fail to close";
CM_ SG_ 2571108355 BATT_capLow_3 "0 - Battery capacity normal (SOH-C) (default)
1 - Low battery capacity (Low SOH-C)";
CM_ SG_ 2571108355 BATT_brickOverDischarge_3 "0 - Battery brick charge is normal (default)
1 - Battery brick is overdischarged";
CM_ SG_ 2571108355 BATT_brickOverCharge_3 "0 - Battery brick charge is normal (default)
1 - Battery brick is overcharged";
CM_ SG_ 2571108355 BATT_bmsProcessorError_3 "0 - No BMS processor failure (default)
1 - BMS processor failure";
CM_ SG_ 2571108355 BATT_bmsMemoryError_3 "0 - No BMS memory error
1 - BMS memory error";
CM_ SG_ 2571108355 BATT_afeError_3 "0 - No BMS AFE error (default)
1 - BMS AFE error";
CM_ BO_ 2571108356 "Message with flags from event matrix";
CM_ SG_ 2571108356 BATT_packModIdFault_4 "0 - Battery pack module ID okay (default)
1 - Battery pack module ID fault";
CM_ SG_ 2571108356 BATT_packModExitedFromBus_4 "0 - Battery pack modules OK (default)
1 - Battery pack module(s) exited from the bus during charge or drive";
CM_ SG_ 2571108356 BATT_packFetChgWelded_4 "0 - Battery pack module CHG FETs not welded (default)
1 - Battery pack module CHG FETs welded ";
CM_ SG_ 2571108356 BATT_packFetDsgWelded_4 "0 - Battery pack module DSG FETs not welded (default)
1 - Battery pack module DSG FETs welded ";
CM_ SG_ 2571108356 BATT_fetDsgShortedAux_4 "0 - FETs are operational (default)
1 - FET is shorted detected by auxiliary diagnostic";
CM_ SG_ 2571108356 BATT_fetChgShortedAux_4 "0 - FETs are operational (default)
1 - FET is shorted detected by auxiliary diagnostic";
CM_ SG_ 2571108356 BATT_prechargeFetFail_4 "0 - Precharge FET okay (default)
1 - Precharge FET failed";
CM_ SG_ 2571108356 BATT_abnormalResetReason_4 "0 - Reset reason okay (default)
1 - Abnormal reset reason";
CM_ SG_ 2571108356 BATT_prechargeTooSlow_4 "0 - Precharge okay (default)
1 - Precharge too slow";
CM_ SG_ 2571108356 BATT_prechargeTooFast_4 "0 - Precharge okay (default)
1 - Precharge too fast";
CM_ SG_ 2571108356 BATT_prechargeTimeout_4 "0 - Precharge okay (default)
1 - Precharge timeout";
CM_ SG_ 2571108356 BATT_fetChgShorted_4 "0 - FETs are operational (default)
1 - FET is shorted";
CM_ SG_ 2571108356 BATT_fetChgFailToClose_4 "0 - FETs are operational (default)
1 -  FET fail to close";
CM_ SG_ 2571108356 BATT_packModSelectFault_4 "0 - Battery pack module selection okay (default)
1 - Battery pack module selection fault";
CM_ SG_ 2571108356 BATT_packModConnectFault_4 "0 - Battery pack module connection okay (default)
1 - Battery pack module connection fault";
CM_ SG_ 2571108356 BATT_packModMIA_4 "0 - Battery pack modules not MIA (default)
1 - Battery pack module MIA";
CM_ SG_ 2571108356 BATT_packModImbalance_4 "0 - Battery pack modules balanced (default)
1 - Battery pack module imblance present";
CM_ SG_ 2571108356 BATT_afeFault_4 "0 - BMS AFE okay (default)
1 - BMS AFE fault";
CM_ SG_ 2571108356 BATT_chargerMIA_4 "0 - Charger communications okay (default)
1 - Charger MIA";
CM_ SG_ 2571108356 BATT_chargerError_4 "0 - Charger working as intended (default)
1 - Charger error";
CM_ SG_ 2571108356 BATT_vBrickUnderWar_4 "0 - Brick voltage okay (default)
1 - Brick undervoltage warning";
CM_ SG_ 2571108356 BATT_vBrickUnderSev_4 "0 - Brick voltage okay (default)
1 - Brick undervoltage severe";
CM_ SG_ 2571108356 BATT_vBrickUnderMod_4 "0 - Brick voltage okay (default)
1 - Brick undervoltage moderate";
CM_ SG_ 2571108356 BATT_vBrickOverWar_4 "0 - Brick voltage okay (default)
1 - Brick overvoltage warning";
CM_ SG_ 2571108356 BATT_vBrickOverSev_4 "0 - Brick voltage okay (default)
1 - Brick overvoltage severe";
CM_ SG_ 2571108356 BATT_vBrickOverMod_4 "0 - Brick voltage okay (default)
1 - Brick overvoltage moderate";
CM_ SG_ 2571108356 BATT_vBrickImbalance_4 "0 - Battery brick voltage okay (default)
1 - Battery brick voltage imbalance";
CM_ SG_ 2571108356 BATT_loggerAlmostFull_4 "0 - Logger not almost full (default)
1 - Logger almost full (section >= 80%) ";
CM_ SG_ 2571108356 BATT_tempModuleUnderWar_4 "0 - Battery temperature okay (default)
1 - Battery under temperature warning";
CM_ SG_ 2571108356 BATT_tempModuleUnderSev_4 "0 - Battery temperature okay (default)
1 - Battery under temperature severe";
CM_ SG_ 2571108356 BATT_tempModuleUnderMod_4 "0 - Battery temperature okay (default)
1 - Battery under temperature moderate";
CM_ SG_ 2571108356 BATT_tempModuleOverWar_4 "0 - Battery temperature okay (default)
1 - Battery over temperature warning";
CM_ SG_ 2571108356 BATT_tempModuleOverSev_4 "0 - Battery temperature okay (default)
1 - Battery over temperature severe";
CM_ SG_ 2571108356 BATT_tempModuleOverMod_4 "0 - Battery temperature okay (default)
1 - Battery over temperature moderate";
CM_ SG_ 2571108356 BATT_tempBrickImbalance_4 "0 - Brick temperatures are balanced (default)
1 - Brick temperatures are imbalanced";
CM_ SG_ 2571108356 BATT_taskLockupError_4 "0 - Tasks okay (default)
1 - Task lockup error";
CM_ SG_ 2571108356 BATT_tempAmbientOverWar_4 "0 - Ambient temperature okay (default)
1 - Ambient over temperature warning";
CM_ SG_ 2571108356 BATT_tempAmbientOverSev_4 "0 - Temperature okay (default)
1 - Ambient over temperature severe";
CM_ SG_ 2571108356 BATT_tempAmbientOverMod_4 "0 - Ambient temperature okay (default)
1 - Ambient over temparature moderate";
CM_ SG_ 2571108356 BATT_sensePackVoltError_4 "0 - Sensor okay (default)
1 - Sensor for pack voltage error";
CM_ SG_ 2571108356 BATT_senseLoadVoltError_4 "0 - Sensor okay (default)
1 - Sensor for load voltage error";
CM_ SG_ 2571108356 BATT_loggerFull_4 "0 - Logger not full (default)
1 - Logger full ";
CM_ SG_ 2571108356 BATT_senseCurrentError_4 "0 - Sensor okay (default)
1 - Sensor for current error";
CM_ SG_ 2571108356 BATT_senseBrickTempError_4 "0 - Sensor okay (default)
1 - Brick temperature sensor error";
CM_ SG_ 2571108356 BATT_resPackHigh_4 "0 - Battery pack resistance okay (default)
1 - Battery pack resistance high (High SOH-R)";
CM_ SG_ 2571108356 BATT_ramOverUtilError_4 "0 - RAM okay (default)
1 - RAM over utilization";
CM_ SG_ 2571108356 BATT_powerPackInsufficient_4 "0 - Battery pack power okay (default)
1 - Battery pack power insufficient";
CM_ SG_ 2571108356 BATT_packCellSoftShort_4 "0 - Battery back cells are okay (default)
1 - Battery pack cell soft short";
CM_ SG_ 2571108356 BATT_iOverHardware_4 "0 - Hardware current okay (default)
1 - Overcurrent in hardware";
CM_ SG_ 2571108356 BATT_fetOverTemp_4 "0 - FET temperature okay (default)
1 - Overtemp at FETs";
CM_ SG_ 2571108356 BATT_iOverDischarge_4 "0 - Discharge okay (default)
1 - Overcurrent during discharge";
CM_ SG_ 2571108356 BATT_iOverCharge_4 "0 - Charging okay (default)
1 - Overcurrent during charging";
CM_ SG_ 2571108356 BATT_inverterDriveMIA_4 "0 - Inverter drive present (default)
1 - Inverter drive MIA";
CM_ SG_ 2571108356 BATT_iUnderCharge_4 "0 - Normal charging (default)
1 -  Charging undercurrent (discharging)";
CM_ SG_ 2571108356 BATT_hostMIA_4 "0 - host communication open (default)
1 - host MIA";
CM_ SG_ 2571108356 BATT_fetDsgShorted_4 "0 - FETs are operational (default)
1 - FET is shorted";
CM_ SG_ 2571108356 BATT_fetDsgFailToClose_4 "0 - FETs are operational (default)
1 -  FET fail to close";
CM_ SG_ 2571108356 BATT_capLow_4 "0 - Battery capacity normal (SOH-C) (default)
1 - Low battery capacity (Low SOH-C)";
CM_ SG_ 2571108356 BATT_brickOverDischarge_4 "0 - Battery brick charge is normal (default)
1 - Battery brick is overdischarged";
CM_ SG_ 2571108356 BATT_brickOverCharge_4 "0 - Battery brick charge is normal (default)
1 - Battery brick is overcharged";
CM_ SG_ 2571108356 BATT_bmsProcessorError_4 "0 - No BMS processor failure (default)
1 - BMS processor failure";
CM_ SG_ 2571108356 BATT_bmsMemoryError_4 "0 - No BMS memory error
1 - BMS memory error";
CM_ SG_ 2571108356 BATT_afeError_4 "0 - No BMS AFE error (default)
1 - BMS AFE error";
CM_ BO_ 2571108357 "Message with flags from event matrix";
CM_ SG_ 2571108357 BATT_packModIdFault_5 "0 - Battery pack module ID okay (default)
1 - Battery pack module ID fault";
CM_ SG_ 2571108357 BATT_packModExitedFromBus_5 "0 - Battery pack modules OK (default)
1 - Battery pack module(s) exited from the bus during charge or drive";
CM_ SG_ 2571108357 BATT_packFetChgWelded_5 "0 - Battery pack module CHG FETs not welded (default)
1 - Battery pack module CHG FETs welded ";
CM_ SG_ 2571108357 BATT_packFetDsgWelded_5 "0 - Battery pack module DSG FETs not welded (default)
1 - Battery pack module DSG FETs welded ";
CM_ SG_ 2571108357 BATT_fetDsgShortedAux_5 "0 - FETs are operational (default)
1 - FET is shorted detected by auxiliary diagnostic";
CM_ SG_ 2571108357 BATT_fetChgShortedAux_5 "0 - FETs are operational (default)
1 - FET is shorted detected by auxiliary diagnostic";
CM_ SG_ 2571108357 BATT_prechargeFetFail_5 "0 - Precharge FET okay (default)
1 - Precharge FET failed";
CM_ SG_ 2571108357 BATT_abnormalResetReason_5 "0 - Reset reason okay (default)
1 - Abnormal reset reason";
CM_ SG_ 2571108357 BATT_prechargeTooSlow_5 "0 - Precharge okay (default)
1 - Precharge too slow";
CM_ SG_ 2571108357 BATT_prechargeTooFast_5 "0 - Precharge okay (default)
1 - Precharge too fast";
CM_ SG_ 2571108357 BATT_prechargeTimeout_5 "0 - Precharge okay (default)
1 - Precharge timeout";
CM_ SG_ 2571108357 BATT_fetChgShorted_5 "0 - FETs are operational (default)
1 - FET is shorted";
CM_ SG_ 2571108357 BATT_fetChgFailToClose_5 "0 - FETs are operational (default)
1 -  FET fail to close";
CM_ SG_ 2571108357 BATT_packModSelectFault_5 "0 - Battery pack module selection okay (default)
1 - Battery pack module selection fault";
CM_ SG_ 2571108357 BATT_packModConnectFault_5 "0 - Battery pack module connection okay (default)
1 - Battery pack module connection fault";
CM_ SG_ 2571108357 BATT_packModMIA_5 "0 - Battery pack modules not MIA (default)
1 - Battery pack module MIA";
CM_ SG_ 2571108357 BATT_packModImbalance_5 "0 - Battery pack modules balanced (default)
1 - Battery pack module imblance present";
CM_ SG_ 2571108357 BATT_afeFault_5 "0 - BMS AFE okay (default)
1 - BMS AFE fault";
CM_ SG_ 2571108357 BATT_chargerMIA_5 "0 - Charger communications okay (default)
1 - Charger MIA";
CM_ SG_ 2571108357 BATT_chargerError_5 "0 - Charger working as intended (default)
1 - Charger error";
CM_ SG_ 2571108357 BATT_vBrickUnderWar_5 "0 - Brick voltage okay (default)
1 - Brick undervoltage warning";
CM_ SG_ 2571108357 BATT_vBrickUnderSev_5 "0 - Brick voltage okay (default)
1 - Brick undervoltage severe";
CM_ SG_ 2571108357 BATT_vBrickUnderMod_5 "0 - Brick voltage okay (default)
1 - Brick undervoltage moderate";
CM_ SG_ 2571108357 BATT_vBrickOverWar_5 "0 - Brick voltage okay (default)
1 - Brick overvoltage warning";
CM_ SG_ 2571108357 BATT_vBrickOverSev_5 "0 - Brick voltage okay (default)
1 - Brick overvoltage severe";
CM_ SG_ 2571108357 BATT_vBrickOverMod_5 "0 - Brick voltage okay (default)
1 - Brick overvoltage moderate";
CM_ SG_ 2571108357 BATT_vBrickImbalance_5 "0 - Battery brick voltage okay (default)
1 - Battery brick voltage imbalance";
CM_ SG_ 2571108357 BATT_loggerAlmostFull_5 "0 - Logger not almost full (default)
1 - Logger almost full (section >= 80%) ";
CM_ SG_ 2571108357 BATT_tempModuleUnderWar_5 "0 - Battery temperature okay (default)
1 - Battery under temperature warning";
CM_ SG_ 2571108357 BATT_tempModuleUnderSev_5 "0 - Battery temperature okay (default)
1 - Battery under temperature severe";
CM_ SG_ 2571108357 BATT_tempModuleUnderMod_5 "0 - Battery temperature okay (default)
1 - Battery under temperature moderate";
CM_ SG_ 2571108357 BATT_tempModuleOverWar_5 "0 - Battery temperature okay (default)
1 - Battery over temperature warning";
CM_ SG_ 2571108357 BATT_tempModuleOverSev_5 "0 - Battery temperature okay (default)
1 - Battery over temperature severe";
CM_ SG_ 2571108357 BATT_tempModuleOverMod_5 "0 - Battery temperature okay (default)
1 - Battery over temperature moderate";
CM_ SG_ 2571108357 BATT_tempBrickImbalance_5 "0 - Brick temperatures are balanced (default)
1 - Brick temperatures are imbalanced";
CM_ SG_ 2571108357 BATT_taskLockupError_5 "0 - Tasks okay (default)
1 - Task lockup error";
CM_ SG_ 2571108357 BATT_tempAmbientOverWar_5 "0 - Ambient temperature okay (default)
1 - Ambient over temperature warning";
CM_ SG_ 2571108357 BATT_tempAmbientOverSev_5 "0 - Temperature okay (default)
1 - Ambient over temperature severe";
CM_ SG_ 2571108357 BATT_tempAmbientOverMod_5 "0 - Ambient temperature okay (default)
1 - Ambient over temparature moderate";
CM_ SG_ 2571108357 BATT_sensePackVoltError_5 "0 - Sensor okay (default)
1 - Sensor for pack voltage error";
CM_ SG_ 2571108357 BATT_senseLoadVoltError_5 "0 - Sensor okay (default)
1 - Sensor for load voltage error";
CM_ SG_ 2571108357 BATT_loggerFull_5 "0 - Logger not full (default)
1 - Logger full ";
CM_ SG_ 2571108357 BATT_senseCurrentError_5 "0 - Sensor okay (default)
1 - Sensor for current error";
CM_ SG_ 2571108357 BATT_senseBrickTempError_5 "0 - Sensor okay (default)
1 - Brick temperature sensor error";
CM_ SG_ 2571108357 BATT_resPackHigh_5 "0 - Battery pack resistance okay (default)
1 - Battery pack resistance high (High SOH-R)";
CM_ SG_ 2571108357 BATT_ramOverUtilError_5 "0 - RAM okay (default)
1 - RAM over utilization";
CM_ SG_ 2571108357 BATT_powerPackInsufficient_5 "0 - Battery pack power okay (default)
1 - Battery pack power insufficient";
CM_ SG_ 2571108357 BATT_packCellSoftShort_5 "0 - Battery back cells are okay (default)
1 - Battery pack cell soft short";
CM_ SG_ 2571108357 BATT_iOverHardware_5 "0 - Hardware current okay (default)
1 - Overcurrent in hardware";
CM_ SG_ 2571108357 BATT_fetOverTemp_5 "0 - FET temperature okay (default)
1 - Overtemp at FETs";
CM_ SG_ 2571108357 BATT_iOverDischarge_5 "0 - Discharge okay (default)
1 - Overcurrent during discharge";
CM_ SG_ 2571108357 BATT_iOverCharge_5 "0 - Charging okay (default)
1 - Overcurrent during charging";
CM_ SG_ 2571108357 BATT_inverterDriveMIA_5 "0 - Inverter drive present (default)
1 - Inverter drive MIA";
CM_ SG_ 2571108357 BATT_iUnderCharge_5 "0 - Normal charging (default)
1 -  Charging undercurrent (discharging)";
CM_ SG_ 2571108357 BATT_hostMIA_5 "0 - host communication open (default)
1 - host MIA";
CM_ SG_ 2571108357 BATT_fetDsgShorted_5 "0 - FETs are operational (default)
1 - FET is shorted";
CM_ SG_ 2571108357 BATT_fetDsgFailToClose_5 "0 - FETs are operational (default)
1 -  FET fail to close";
CM_ SG_ 2571108357 BATT_capLow_5 "0 - Battery capacity normal (SOH-C) (default)
1 - Low battery capacity (Low SOH-C)";
CM_ SG_ 2571108357 BATT_brickOverDischarge_5 "0 - Battery brick charge is normal (default)
1 - Battery brick is overdischarged";
CM_ SG_ 2571108357 BATT_brickOverCharge_5 "0 - Battery brick charge is normal (default)
1 - Battery brick is overcharged";
CM_ SG_ 2571108357 BATT_bmsProcessorError_5 "0 - No BMS processor failure (default)
1 - BMS processor failure";
CM_ SG_ 2571108357 BATT_bmsMemoryError_5 "0 - No BMS memory error
1 - BMS memory error";
CM_ SG_ 2571108357 BATT_afeError_5 "0 - No BMS AFE error (default)
1 - BMS AFE error";
CM_ BO_ 2571108358 "Message with flags from event matrix";
CM_ SG_ 2571108358 BATT_packModIdFault_6 "0 - Battery pack module ID okay (default)
1 - Battery pack module ID fault";
CM_ SG_ 2571108358 BATT_packModExitedFromBus_6 "0 - Battery pack modules OK (default)
1 - Battery pack module(s) exited from the bus during charge or drive";
CM_ SG_ 2571108358 BATT_packFetChgWelded_6 "0 - Battery pack module CHG FETs not welded (default)
1 - Battery pack module CHG FETs welded ";
CM_ SG_ 2571108358 BATT_packFetDsgWelded_6 "0 - Battery pack module DSG FETs not welded (default)
1 - Battery pack module DSG FETs welded ";
CM_ SG_ 2571108358 BATT_fetDsgShortedAux_6 "0 - FETs are operational (default)
1 - FET is shorted detected by auxiliary diagnostic";
CM_ SG_ 2571108358 BATT_fetChgShortedAux_6 "0 - FETs are operational (default)
1 - FET is shorted detected by auxiliary diagnostic";
CM_ SG_ 2571108358 BATT_prechargeFetFail_6 "0 - Precharge FET okay (default)
1 - Precharge FET failed";
CM_ SG_ 2571108358 BATT_abnormalResetReason_6 "0 - Reset reason okay (default)
1 - Abnormal reset reason";
CM_ SG_ 2571108358 BATT_prechargeTooSlow_6 "0 - Precharge okay (default)
1 - Precharge too slow";
CM_ SG_ 2571108358 BATT_prechargeTooFast_6 "0 - Precharge okay (default)
1 - Precharge too fast";
CM_ SG_ 2571108358 BATT_prechargeTimeout_6 "0 - Precharge okay (default)
1 - Precharge timeout";
CM_ SG_ 2571108358 BATT_fetChgShorted_6 "0 - FETs are operational (default)
1 - FET is shorted";
CM_ SG_ 2571108358 BATT_fetChgFailToClose_6 "0 - FETs are operational (default)
1 -  FET fail to close";
CM_ SG_ 2571108358 BATT_packModSelectFault_6 "0 - Battery pack module selection okay (default)
1 - Battery pack module selection fault";
CM_ SG_ 2571108358 BATT_packModConnectFault_6 "0 - Battery pack module connection okay (default)
1 - Battery pack module connection fault";
CM_ SG_ 2571108358 BATT_packModMIA_6 "0 - Battery pack modules not MIA (default)
1 - Battery pack module MIA";
CM_ SG_ 2571108358 BATT_packModImbalance_6 "0 - Battery pack modules balanced (default)
1 - Battery pack module imblance present";
CM_ SG_ 2571108358 BATT_afeFault_6 "0 - BMS AFE okay (default)
1 - BMS AFE fault";
CM_ SG_ 2571108358 BATT_chargerMIA_6 "0 - Charger communications okay (default)
1 - Charger MIA";
CM_ SG_ 2571108358 BATT_chargerError_6 "0 - Charger working as intended (default)
1 - Charger error";
CM_ SG_ 2571108358 BATT_vBrickUnderWar_6 "0 - Brick voltage okay (default)
1 - Brick undervoltage warning";
CM_ SG_ 2571108358 BATT_vBrickUnderSev_6 "0 - Brick voltage okay (default)
1 - Brick undervoltage severe";
CM_ SG_ 2571108358 BATT_vBrickUnderMod_6 "0 - Brick voltage okay (default)
1 - Brick undervoltage moderate";
CM_ SG_ 2571108358 BATT_vBrickOverWar_6 "0 - Brick voltage okay (default)
1 - Brick overvoltage warning";
CM_ SG_ 2571108358 BATT_vBrickOverSev_6 "0 - Brick voltage okay (default)
1 - Brick overvoltage severe";
CM_ SG_ 2571108358 BATT_vBrickOverMod_6 "0 - Brick voltage okay (default)
1 - Brick overvoltage moderate";
CM_ SG_ 2571108358 BATT_vBrickImbalance_6 "0 - Battery brick voltage okay (default)
1 - Battery brick voltage imbalance";
CM_ SG_ 2571108358 BATT_loggerAlmostFull_6 "0 - Logger not almost full (default)
1 - Logger almost full (section >= 80%) ";
CM_ SG_ 2571108358 BATT_tempModuleUnderWar_6 "0 - Battery temperature okay (default)
1 - Battery under temperature warning";
CM_ SG_ 2571108358 BATT_tempModuleUnderSev_6 "0 - Battery temperature okay (default)
1 - Battery under temperature severe";
CM_ SG_ 2571108358 BATT_tempModuleUnderMod_6 "0 - Battery temperature okay (default)
1 - Battery under temperature moderate";
CM_ SG_ 2571108358 BATT_tempModuleOverWar_6 "0 - Battery temperature okay (default)
1 - Battery over temperature warning";
CM_ SG_ 2571108358 BATT_tempModuleOverSev_6 "0 - Battery temperature okay (default)
1 - Battery over temperature severe";
CM_ SG_ 2571108358 BATT_tempModuleOverMod_6 "0 - Battery temperature okay (default)
1 - Battery over temperature moderate";
CM_ SG_ 2571108358 BATT_tempBrickImbalance_6 "0 - Brick temperatures are balanced (default)
1 - Brick temperatures are imbalanced";
CM_ SG_ 2571108358 BATT_taskLockupError_6 "0 - Tasks okay (default)
1 - Task lockup error";
CM_ SG_ 2571108358 BATT_tempAmbientOverWar_6 "0 - Ambient temperature okay (default)
1 - Ambient over temperature warning";
CM_ SG_ 2571108358 BATT_tempAmbientOverSev_6 "0 - Temperature okay (default)
1 - Ambient over temperature severe";
CM_ SG_ 2571108358 BATT_tempAmbientOverMod_6 "0 - Ambient temperature okay (default)
1 - Ambient over temparature moderate";
CM_ SG_ 2571108358 BATT_sensePackVoltError_6 "0 - Sensor okay (default)
1 - Sensor for pack voltage error";
CM_ SG_ 2571108358 BATT_senseLoadVoltError_6 "0 - Sensor okay (default)
1 - Sensor for load voltage error";
CM_ SG_ 2571108358 BATT_loggerFull_6 "0 - Logger not full (default)
1 - Logger full ";
CM_ SG_ 2571108358 BATT_senseCurrentError_6 "0 - Sensor okay (default)
1 - Sensor for current error";
CM_ SG_ 2571108358 BATT_senseBrickTempError_6 "0 - Sensor okay (default)
1 - Brick temperature sensor error";
CM_ SG_ 2571108358 BATT_resPackHigh_6 "0 - Battery pack resistance okay (default)
1 - Battery pack resistance high (High SOH-R)";
CM_ SG_ 2571108358 BATT_ramOverUtilError_6 "0 - RAM okay (default)
1 - RAM over utilization";
CM_ SG_ 2571108358 BATT_powerPackInsufficient_6 "0 - Battery pack power okay (default)
1 - Battery pack power insufficient";
CM_ SG_ 2571108358 BATT_packCellSoftShort_6 "0 - Battery back cells are okay (default)
1 - Battery pack cell soft short";
CM_ SG_ 2571108358 BATT_iOverHardware_6 "0 - Hardware current okay (default)
1 - Overcurrent in hardware";
CM_ SG_ 2571108358 BATT_fetOverTemp_6 "0 - FET temperature okay (default)
1 - Overtemp at FETs";
CM_ SG_ 2571108358 BATT_iOverDischarge_6 "0 - Discharge okay (default)
1 - Overcurrent during discharge";
CM_ SG_ 2571108358 BATT_iOverCharge_6 "0 - Charging okay (default)
1 - Overcurrent during charging";
CM_ SG_ 2571108358 BATT_inverterDriveMIA_6 "0 - Inverter drive present (default)
1 - Inverter drive MIA";
CM_ SG_ 2571108358 BATT_iUnderCharge_6 "0 - Normal charging (default)
1 -  Charging undercurrent (discharging)";
CM_ SG_ 2571108358 BATT_hostMIA_6 "0 - host communication open (default)
1 - host MIA";
CM_ SG_ 2571108358 BATT_fetDsgShorted_6 "0 - FETs are operational (default)
1 - FET is shorted";
CM_ SG_ 2571108358 BATT_fetDsgFailToClose_6 "0 - FETs are operational (default)
1 -  FET fail to close";
CM_ SG_ 2571108358 BATT_capLow_6 "0 - Battery capacity normal (SOH-C) (default)
1 - Low battery capacity (Low SOH-C)";
CM_ SG_ 2571108358 BATT_brickOverDischarge_6 "0 - Battery brick charge is normal (default)
1 - Battery brick is overdischarged";
CM_ SG_ 2571108358 BATT_brickOverCharge_6 "0 - Battery brick charge is normal (default)
1 - Battery brick is overcharged";
CM_ SG_ 2571108358 BATT_bmsProcessorError_6 "0 - No BMS processor failure (default)
1 - BMS processor failure";
CM_ SG_ 2571108358 BATT_bmsMemoryError_6 "0 - No BMS memory error
1 - BMS memory error";
CM_ SG_ 2571108358 BATT_afeError_6 "0 - No BMS AFE error (default)
1 - BMS AFE error";
CM_ BO_ 2571108359 "Message with flags from event matrix";
CM_ SG_ 2571108359 BATT_packModIdFault_7 "0 - Battery pack module ID okay (default)
1 - Battery pack module ID fault";
CM_ SG_ 2571108359 BATT_packModExitedFromBus_7 "0 - Battery pack modules OK (default)
1 - Battery pack module(s) exited from the bus during charge or drive";
CM_ SG_ 2571108359 BATT_packFetChgWelded_7 "0 - Battery pack module CHG FETs not welded (default)
1 - Battery pack module CHG FETs welded ";
CM_ SG_ 2571108359 BATT_packFetDsgWelded_7 "0 - Battery pack module DSG FETs not welded (default)
1 - Battery pack module DSG FETs welded ";
CM_ SG_ 2571108359 BATT_fetDsgShortedAux_7 "0 - FETs are operational (default)
1 - FET is shorted detected by auxiliary diagnostic";
CM_ SG_ 2571108359 BATT_fetChgShortedAux_7 "0 - FETs are operational (default)
1 - FET is shorted detected by auxiliary diagnostic";
CM_ SG_ 2571108359 BATT_prechargeFetFail_7 "0 - Precharge FET okay (default)
1 - Precharge FET failed";
CM_ SG_ 2571108359 BATT_abnormalResetReason_7 "0 - Reset reason okay (default)
1 - Abnormal reset reason";
CM_ SG_ 2571108359 BATT_prechargeTooSlow_7 "0 - Precharge okay (default)
1 - Precharge too slow";
CM_ SG_ 2571108359 BATT_prechargeTooFast_7 "0 - Precharge okay (default)
1 - Precharge too fast";
CM_ SG_ 2571108359 BATT_prechargeTimeout_7 "0 - Precharge okay (default)
1 - Precharge timeout";
CM_ SG_ 2571108359 BATT_fetChgShorted_7 "0 - FETs are operational (default)
1 - FET is shorted";
CM_ SG_ 2571108359 BATT_fetChgFailToClose_7 "0 - FETs are operational (default)
1 -  FET fail to close";
CM_ SG_ 2571108359 BATT_packModSelectFault_7 "0 - Battery pack module selection okay (default)
1 - Battery pack module selection fault";
CM_ SG_ 2571108359 BATT_packModConnectFault_7 "0 - Battery pack module connection okay (default)
1 - Battery pack module connection fault";
CM_ SG_ 2571108359 BATT_packModMIA_7 "0 - Battery pack modules not MIA (default)
1 - Battery pack module MIA";
CM_ SG_ 2571108359 BATT_packModImbalance_7 "0 - Battery pack modules balanced (default)
1 - Battery pack module imblance present";
CM_ SG_ 2571108359 BATT_afeFault_7 "0 - BMS AFE okay (default)
1 - BMS AFE fault";
CM_ SG_ 2571108359 BATT_chargerMIA_7 "0 - Charger communications okay (default)
1 - Charger MIA";
CM_ SG_ 2571108359 BATT_chargerError_7 "0 - Charger working as intended (default)
1 - Charger error";
CM_ SG_ 2571108359 BATT_vBrickUnderWar_7 "0 - Brick voltage okay (default)
1 - Brick undervoltage warning";
CM_ SG_ 2571108359 BATT_vBrickUnderSev_7 "0 - Brick voltage okay (default)
1 - Brick undervoltage severe";
CM_ SG_ 2571108359 BATT_vBrickUnderMod_7 "0 - Brick voltage okay (default)
1 - Brick undervoltage moderate";
CM_ SG_ 2571108359 BATT_vBrickOverWar_7 "0 - Brick voltage okay (default)
1 - Brick overvoltage warning";
CM_ SG_ 2571108359 BATT_vBrickOverSev_7 "0 - Brick voltage okay (default)
1 - Brick overvoltage severe";
CM_ SG_ 2571108359 BATT_vBrickOverMod_7 "0 - Brick voltage okay (default)
1 - Brick overvoltage moderate";
CM_ SG_ 2571108359 BATT_vBrickImbalance_7 "0 - Battery brick voltage okay (default)
1 - Battery brick voltage imbalance";
CM_ SG_ 2571108359 BATT_loggerAlmostFull_7 "0 - Logger not almost full (default)
1 - Logger almost full (section >= 80%) ";
CM_ SG_ 2571108359 BATT_tempModuleUnderWar_7 "0 - Battery temperature okay (default)
1 - Battery under temperature warning";
CM_ SG_ 2571108359 BATT_tempModuleUnderSev_7 "0 - Battery temperature okay (default)
1 - Battery under temperature severe";
CM_ SG_ 2571108359 BATT_tempModuleUnderMod_7 "0 - Battery temperature okay (default)
1 - Battery under temperature moderate";
CM_ SG_ 2571108359 BATT_tempModuleOverWar_7 "0 - Battery temperature okay (default)
1 - Battery over temperature warning";
CM_ SG_ 2571108359 BATT_tempModuleOverSev_7 "0 - Battery temperature okay (default)
1 - Battery over temperature severe";
CM_ SG_ 2571108359 BATT_tempModuleOverMod_7 "0 - Battery temperature okay (default)
1 - Battery over temperature moderate";
CM_ SG_ 2571108359 BATT_tempBrickImbalance_7 "0 - Brick temperatures are balanced (default)
1 - Brick temperatures are imbalanced";
CM_ SG_ 2571108359 BATT_taskLockupError_7 "0 - Tasks okay (default)
1 - Task lockup error";
CM_ SG_ 2571108359 BATT_tempAmbientOverWar_7 "0 - Ambient temperature okay (default)
1 - Ambient over temperature warning";
CM_ SG_ 2571108359 BATT_tempAmbientOverSev_7 "0 - Temperature okay (default)
1 - Ambient over temperature severe";
CM_ SG_ 2571108359 BATT_tempAmbientOverMod_7 "0 - Ambient temperature okay (default)
1 - Ambient over temparature moderate";
CM_ SG_ 2571108359 BATT_sensePackVoltError_7 "0 - Sensor okay (default)
1 - Sensor for pack voltage error";
CM_ SG_ 2571108359 BATT_senseLoadVoltError_7 "0 - Sensor okay (default)
1 - Sensor for load voltage error";
CM_ SG_ 2571108359 BATT_loggerFull_7 "0 - Logger not full (default)
1 - Logger full ";
CM_ SG_ 2571108359 BATT_senseCurrentError_7 "0 - Sensor okay (default)
1 - Sensor for current error";
CM_ SG_ 2571108359 BATT_senseBrickTempError_7 "0 - Sensor okay (default)
1 - Brick temperature sensor error";
CM_ SG_ 2571108359 BATT_resPackHigh_7 "0 - Battery pack resistance okay (default)
1 - Battery pack resistance high (High SOH-R)";
CM_ SG_ 2571108359 BATT_ramOverUtilError_7 "0 - RAM okay (default)
1 - RAM over utilization";
CM_ SG_ 2571108359 BATT_powerPackInsufficient_7 "0 - Battery pack power okay (default)
1 - Battery pack power insufficient";
CM_ SG_ 2571108359 BATT_packCellSoftShort_7 "0 - Battery back cells are okay (default)
1 - Battery pack cell soft short";
CM_ SG_ 2571108359 BATT_iOverHardware_7 "0 - Hardware current okay (default)
1 - Overcurrent in hardware";
CM_ SG_ 2571108359 BATT_fetOverTemp_7 "0 - FET temperature okay (default)
1 - Overtemp at FETs";
CM_ SG_ 2571108359 BATT_iOverDischarge_7 "0 - Discharge okay (default)
1 - Overcurrent during discharge";
CM_ SG_ 2571108359 BATT_iOverCharge_7 "0 - Charging okay (default)
1 - Overcurrent during charging";
CM_ SG_ 2571108359 BATT_inverterDriveMIA_7 "0 - Inverter drive present (default)
1 - Inverter drive MIA";
CM_ SG_ 2571108359 BATT_iUnderCharge_7 "0 - Normal charging (default)
1 -  Charging undercurrent (discharging)";
CM_ SG_ 2571108359 BATT_hostMIA_7 "0 - host communication open (default)
1 - host MIA";
CM_ SG_ 2571108359 BATT_fetDsgShorted_7 "0 - FETs are operational (default)
1 - FET is shorted";
CM_ SG_ 2571108359 BATT_fetDsgFailToClose_7 "0 - FETs are operational (default)
1 -  FET fail to close";
CM_ SG_ 2571108359 BATT_capLow_7 "0 - Battery capacity normal (SOH-C) (default)
1 - Low battery capacity (Low SOH-C)";
CM_ SG_ 2571108359 BATT_brickOverDischarge_7 "0 - Battery brick charge is normal (default)
1 - Battery brick is overdischarged";
CM_ SG_ 2571108359 BATT_brickOverCharge_7 "0 - Battery brick charge is normal (default)
1 - Battery brick is overcharged";
CM_ SG_ 2571108359 BATT_bmsProcessorError_7 "0 - No BMS processor failure (default)
1 - BMS processor failure";
CM_ SG_ 2571108359 BATT_bmsMemoryError_7 "0 - No BMS memory error
1 - BMS memory error";
CM_ SG_ 2571108359 BATT_afeError_7 "0 - No BMS AFE error (default)
1 - BMS AFE error";
CM_ BO_ 2571108360 "Message with flags from event matrix";
CM_ SG_ 2571108360 BATT_packModIdFault_8 "0 - Battery pack module ID okay (default)
1 - Battery pack module ID fault";
CM_ SG_ 2571108360 BATT_packModExitedFromBus_8 "0 - Battery pack modules OK (default)
1 - Battery pack module(s) exited from the bus during charge or drive";
CM_ SG_ 2571108360 BATT_packFetChgWelded_8 "0 - Battery pack module CHG FETs not welded (default)
1 - Battery pack module CHG FETs welded ";
CM_ SG_ 2571108360 BATT_packFetDsgWelded_8 "0 - Battery pack module DSG FETs not welded (default)
1 - Battery pack module DSG FETs welded ";
CM_ SG_ 2571108360 BATT_fetDsgShortedAux_8 "0 - FETs are operational (default)
1 - FET is shorted detected by auxiliary diagnostic";
CM_ SG_ 2571108360 BATT_fetChgShortedAux_8 "0 - FETs are operational (default)
1 - FET is shorted detected by auxiliary diagnostic";
CM_ SG_ 2571108360 BATT_prechargeFetFail_8 "0 - Precharge FET okay (default)
1 - Precharge FET failed";
CM_ SG_ 2571108360 BATT_abnormalResetReason_8 "0 - Reset reason okay (default)
1 - Abnormal reset reason";
CM_ SG_ 2571108360 BATT_prechargeTooSlow_8 "0 - Precharge okay (default)
1 - Precharge too slow";
CM_ SG_ 2571108360 BATT_prechargeTooFast_8 "0 - Precharge okay (default)
1 - Precharge too fast";
CM_ SG_ 2571108360 BATT_prechargeTimeout_8 "0 - Precharge okay (default)
1 - Precharge timeout";
CM_ SG_ 2571108360 BATT_fetChgShorted_8 "0 - FETs are operational (default)
1 - FET is shorted";
CM_ SG_ 2571108360 BATT_fetChgFailToClose_8 "0 - FETs are operational (default)
1 -  FET fail to close";
CM_ SG_ 2571108360 BATT_packModSelectFault_8 "0 - Battery pack module selection okay (default)
1 - Battery pack module selection fault";
CM_ SG_ 2571108360 BATT_packModConnectFault_8 "0 - Battery pack module connection okay (default)
1 - Battery pack module connection fault";
CM_ SG_ 2571108360 BATT_packModMIA_8 "0 - Battery pack modules not MIA (default)
1 - Battery pack module MIA";
CM_ SG_ 2571108360 BATT_packModImbalance_8 "0 - Battery pack modules balanced (default)
1 - Battery pack module imblance present";
CM_ SG_ 2571108360 BATT_afeFault_8 "0 - BMS AFE okay (default)
1 - BMS AFE fault";
CM_ SG_ 2571108360 BATT_chargerMIA_8 "0 - Charger communications okay (default)
1 - Charger MIA";
CM_ SG_ 2571108360 BATT_chargerError_8 "0 - Charger working as intended (default)
1 - Charger error";
CM_ SG_ 2571108360 BATT_vBrickUnderWar_8 "0 - Brick voltage okay (default)
1 - Brick undervoltage warning";
CM_ SG_ 2571108360 BATT_vBrickUnderSev_8 "0 - Brick voltage okay (default)
1 - Brick undervoltage severe";
CM_ SG_ 2571108360 BATT_vBrickUnderMod_8 "0 - Brick voltage okay (default)
1 - Brick undervoltage moderate";
CM_ SG_ 2571108360 BATT_vBrickOverWar_8 "0 - Brick voltage okay (default)
1 - Brick overvoltage warning";
CM_ SG_ 2571108360 BATT_vBrickOverSev_8 "0 - Brick voltage okay (default)
1 - Brick overvoltage severe";
CM_ SG_ 2571108360 BATT_vBrickOverMod_8 "0 - Brick voltage okay (default)
1 - Brick overvoltage moderate";
CM_ SG_ 2571108360 BATT_vBrickImbalance_8 "0 - Battery brick voltage okay (default)
1 - Battery brick voltage imbalance";
CM_ SG_ 2571108360 BATT_loggerAlmostFull_8 "0 - Logger not almost full (default)
1 - Logger almost full (section >= 80%) ";
CM_ SG_ 2571108360 BATT_tempModuleUnderWar_8 "0 - Battery temperature okay (default)
1 - Battery under temperature warning";
CM_ SG_ 2571108360 BATT_tempModuleUnderSev_8 "0 - Battery temperature okay (default)
1 - Battery under temperature severe";
CM_ SG_ 2571108360 BATT_tempModuleUnderMod_8 "0 - Battery temperature okay (default)
1 - Battery under temperature moderate";
CM_ SG_ 2571108360 BATT_tempModuleOverWar_8 "0 - Battery temperature okay (default)
1 - Battery over temperature warning";
CM_ SG_ 2571108360 BATT_tempModuleOverSev_8 "0 - Battery temperature okay (default)
1 - Battery over temperature severe";
CM_ SG_ 2571108360 BATT_tempModuleOverMod_8 "0 - Battery temperature okay (default)
1 - Battery over temperature moderate";
CM_ SG_ 2571108360 BATT_tempBrickImbalance_8 "0 - Brick temperatures are balanced (default)
1 - Brick temperatures are imbalanced";
CM_ SG_ 2571108360 BATT_taskLockupError_8 "0 - Tasks okay (default)
1 - Task lockup error";
CM_ SG_ 2571108360 BATT_tempAmbientOverWar_8 "0 - Ambient temperature okay (default)
1 - Ambient over temperature warning";
CM_ SG_ 2571108360 BATT_tempAmbientOverSev_8 "0 - Temperature okay (default)
1 - Ambient over temperature severe";
CM_ SG_ 2571108360 BATT_tempAmbientOverMod_8 "0 - Ambient temperature okay (default)
1 - Ambient over temparature moderate";
CM_ SG_ 2571108360 BATT_sensePackVoltError_8 "0 - Sensor okay (default)
1 - Sensor for pack voltage error";
CM_ SG_ 2571108360 BATT_senseLoadVoltError_8 "0 - Sensor okay (default)
1 - Sensor for load voltage error";
CM_ SG_ 2571108360 BATT_loggerFull_8 "0 - Logger not full (default)
1 - Logger full ";
CM_ SG_ 2571108360 BATT_senseCurrentError_8 "0 - Sensor okay (default)
1 - Sensor for current error";
CM_ SG_ 2571108360 BATT_senseBrickTempError_8 "0 - Sensor okay (default)
1 - Brick temperature sensor error";
CM_ SG_ 2571108360 BATT_resPackHigh_8 "0 - Battery pack resistance okay (default)
1 - Battery pack resistance high (High SOH-R)";
CM_ SG_ 2571108360 BATT_ramOverUtilError_8 "0 - RAM okay (default)
1 - RAM over utilization";
CM_ SG_ 2571108360 BATT_powerPackInsufficient_8 "0 - Battery pack power okay (default)
1 - Battery pack power insufficient";
CM_ SG_ 2571108360 BATT_packCellSoftShort_8 "0 - Battery back cells are okay (default)
1 - Battery pack cell soft short";
CM_ SG_ 2571108360 BATT_iOverHardware_8 "0 - Hardware current okay (default)
1 - Overcurrent in hardware";
CM_ SG_ 2571108360 BATT_fetOverTemp_8 "0 - FET temperature okay (default)
1 - Overtemp at FETs";
CM_ SG_ 2571108360 BATT_iOverDischarge_8 "0 - Discharge okay (default)
1 - Overcurrent during discharge";
CM_ SG_ 2571108360 BATT_iOverCharge_8 "0 - Charging okay (default)
1 - Overcurrent during charging";
CM_ SG_ 2571108360 BATT_inverterDriveMIA_8 "0 - Inverter drive present (default)
1 - Inverter drive MIA";
CM_ SG_ 2571108360 BATT_iUnderCharge_8 "0 - Normal charging (default)
1 -  Charging undercurrent (discharging)";
CM_ SG_ 2571108360 BATT_hostMIA_8 "0 - host communication open (default)
1 - host MIA";
CM_ SG_ 2571108360 BATT_fetDsgShorted_8 "0 - FETs are operational (default)
1 - FET is shorted";
CM_ SG_ 2571108360 BATT_fetDsgFailToClose_8 "0 - FETs are operational (default)
1 -  FET fail to close";
CM_ SG_ 2571108360 BATT_capLow_8 "0 - Battery capacity normal (SOH-C) (default)
1 - Low battery capacity (Low SOH-C)";
CM_ SG_ 2571108360 BATT_brickOverDischarge_8 "0 - Battery brick charge is normal (default)
1 - Battery brick is overdischarged";
CM_ SG_ 2571108360 BATT_brickOverCharge_8 "0 - Battery brick charge is normal (default)
1 - Battery brick is overcharged";
CM_ SG_ 2571108360 BATT_bmsProcessorError_8 "0 - No BMS processor failure (default)
1 - BMS processor failure";
CM_ SG_ 2571108360 BATT_bmsMemoryError_8 "0 - No BMS memory error
1 - BMS memory error";
CM_ SG_ 2571108360 BATT_afeError_8 "0 - No BMS AFE error (default)
1 - BMS AFE error";
CM_ BO_ 2571108361 "Message with flags from event matrix";
CM_ SG_ 2571108361 BATT_packModIdFault_9 "0 - Battery pack module ID okay (default)
1 - Battery pack module ID fault";
CM_ SG_ 2571108361 BATT_packModExitedFromBus_9 "0 - Battery pack modules OK (default)
1 - Battery pack module(s) exited from the bus during charge or drive";
CM_ SG_ 2571108361 BATT_packFetChgWelded_9 "0 - Battery pack module CHG FETs not welded (default)
1 - Battery pack module CHG FETs welded ";
CM_ SG_ 2571108361 BATT_packFetDsgWelded_9 "0 - Battery pack module DSG FETs not welded (default)
1 - Battery pack module DSG FETs welded ";
CM_ SG_ 2571108361 BATT_fetDsgShortedAux_9 "0 - FETs are operational (default)
1 - FET is shorted detected by auxiliary diagnostic";
CM_ SG_ 2571108361 BATT_fetChgShortedAux_9 "0 - FETs are operational (default)
1 - FET is shorted detected by auxiliary diagnostic";
CM_ SG_ 2571108361 BATT_prechargeFetFail_9 "0 - Precharge FET okay (default)
1 - Precharge FET failed";
CM_ SG_ 2571108361 BATT_abnormalResetReason_9 "0 - Reset reason okay (default)
1 - Abnormal reset reason";
CM_ SG_ 2571108361 BATT_prechargeTooSlow_9 "0 - Precharge okay (default)
1 - Precharge too slow";
CM_ SG_ 2571108361 BATT_prechargeTooFast_9 "0 - Precharge okay (default)
1 - Precharge too fast";
CM_ SG_ 2571108361 BATT_prechargeTimeout_9 "0 - Precharge okay (default)
1 - Precharge timeout";
CM_ SG_ 2571108361 BATT_fetChgShorted_9 "0 - FETs are operational (default)
1 - FET is shorted";
CM_ SG_ 2571108361 BATT_fetChgFailToClose_9 "0 - FETs are operational (default)
1 -  FET fail to close";
CM_ SG_ 2571108361 BATT_packModSelectFault_9 "0 - Battery pack module selection okay (default)
1 - Battery pack module selection fault";
CM_ SG_ 2571108361 BATT_packModConnectFault_9 "0 - Battery pack module connection okay (default)
1 - Battery pack module connection fault";
CM_ SG_ 2571108361 BATT_packModMIA_9 "0 - Battery pack modules not MIA (default)
1 - Battery pack module MIA";
CM_ SG_ 2571108361 BATT_packModImbalance_9 "0 - Battery pack modules balanced (default)
1 - Battery pack module imblance present";
CM_ SG_ 2571108361 BATT_afeFault_9 "0 - BMS AFE okay (default)
1 - BMS AFE fault";
CM_ SG_ 2571108361 BATT_chargerMIA_9 "0 - Charger communications okay (default)
1 - Charger MIA";
CM_ SG_ 2571108361 BATT_chargerError_9 "0 - Charger working as intended (default)
1 - Charger error";
CM_ SG_ 2571108361 BATT_vBrickUnderWar_9 "0 - Brick voltage okay (default)
1 - Brick undervoltage warning";
CM_ SG_ 2571108361 BATT_vBrickUnderSev_9 "0 - Brick voltage okay (default)
1 - Brick undervoltage severe";
CM_ SG_ 2571108361 BATT_vBrickUnderMod_9 "0 - Brick voltage okay (default)
1 - Brick undervoltage moderate";
CM_ SG_ 2571108361 BATT_vBrickOverWar_9 "0 - Brick voltage okay (default)
1 - Brick overvoltage warning";
CM_ SG_ 2571108361 BATT_vBrickOverSev_9 "0 - Brick voltage okay (default)
1 - Brick overvoltage severe";
CM_ SG_ 2571108361 BATT_vBrickOverMod_9 "0 - Brick voltage okay (default)
1 - Brick overvoltage moderate";
CM_ SG_ 2571108361 BATT_vBrickImbalance_9 "0 - Battery brick voltage okay (default)
1 - Battery brick voltage imbalance";
CM_ SG_ 2571108361 BATT_loggerAlmostFull_9 "0 - Logger not almost full (default)
1 - Logger almost full (section >= 80%) ";
CM_ SG_ 2571108361 BATT_tempModuleUnderWar_9 "0 - Battery temperature okay (default)
1 - Battery under temperature warning";
CM_ SG_ 2571108361 BATT_tempModuleUnderSev_9 "0 - Battery temperature okay (default)
1 - Battery under temperature severe";
CM_ SG_ 2571108361 BATT_tempModuleUnderMod_9 "0 - Battery temperature okay (default)
1 - Battery under temperature moderate";
CM_ SG_ 2571108361 BATT_tempModuleOverWar_9 "0 - Battery temperature okay (default)
1 - Battery over temperature warning";
CM_ SG_ 2571108361 BATT_tempModuleOverSev_9 "0 - Battery temperature okay (default)
1 - Battery over temperature severe";
CM_ SG_ 2571108361 BATT_tempModuleOverMod_9 "0 - Battery temperature okay (default)
1 - Battery over temperature moderate";
CM_ SG_ 2571108361 BATT_tempBrickImbalance_9 "0 - Brick temperatures are balanced (default)
1 - Brick temperatures are imbalanced";
CM_ SG_ 2571108361 BATT_taskLockupError_9 "0 - Tasks okay (default)
1 - Task lockup error";
CM_ SG_ 2571108361 BATT_tempAmbientOverWar_9 "0 - Ambient temperature okay (default)
1 - Ambient over temperature warning";
CM_ SG_ 2571108361 BATT_tempAmbientOverSev_9 "0 - Temperature okay (default)
1 - Ambient over temperature severe";
CM_ SG_ 2571108361 BATT_tempAmbientOverMod_9 "0 - Ambient temperature okay (default)
1 - Ambient over temparature moderate";
CM_ SG_ 2571108361 BATT_sensePackVoltError_9 "0 - Sensor okay (default)
1 - Sensor for pack voltage error";
CM_ SG_ 2571108361 BATT_senseLoadVoltError_9 "0 - Sensor okay (default)
1 - Sensor for load voltage error";
CM_ SG_ 2571108361 BATT_loggerFull_9 "0 - Logger not full (default)
1 - Logger full ";
CM_ SG_ 2571108361 BATT_senseCurrentError_9 "0 - Sensor okay (default)
1 - Sensor for current error";
CM_ SG_ 2571108361 BATT_senseBrickTempError_9 "0 - Sensor okay (default)
1 - Brick temperature sensor error";
CM_ SG_ 2571108361 BATT_resPackHigh_9 "0 - Battery pack resistance okay (default)
1 - Battery pack resistance high (High SOH-R)";
CM_ SG_ 2571108361 BATT_ramOverUtilError_9 "0 - RAM okay (default)
1 - RAM over utilization";
CM_ SG_ 2571108361 BATT_powerPackInsufficient_9 "0 - Battery pack power okay (default)
1 - Battery pack power insufficient";
CM_ SG_ 2571108361 BATT_packCellSoftShort_9 "0 - Battery back cells are okay (default)
1 - Battery pack cell soft short";
CM_ SG_ 2571108361 BATT_iOverHardware_9 "0 - Hardware current okay (default)
1 - Overcurrent in hardware";
CM_ SG_ 2571108361 BATT_fetOverTemp_9 "0 - FET temperature okay (default)
1 - Overtemp at FETs";
CM_ SG_ 2571108361 BATT_iOverDischarge_9 "0 - Discharge okay (default)
1 - Overcurrent during discharge";
CM_ SG_ 2571108361 BATT_iOverCharge_9 "0 - Charging okay (default)
1 - Overcurrent during charging";
CM_ SG_ 2571108361 BATT_inverterDriveMIA_9 "0 - Inverter drive present (default)
1 - Inverter drive MIA";
CM_ SG_ 2571108361 BATT_iUnderCharge_9 "0 - Normal charging (default)
1 -  Charging undercurrent (discharging)";
CM_ SG_ 2571108361 BATT_hostMIA_9 "0 - host communication open (default)
1 - host MIA";
CM_ SG_ 2571108361 BATT_fetDsgShorted_9 "0 - FETs are operational (default)
1 - FET is shorted";
CM_ SG_ 2571108361 BATT_fetDsgFailToClose_9 "0 - FETs are operational (default)
1 -  FET fail to close";
CM_ SG_ 2571108361 BATT_capLow_9 "0 - Battery capacity normal (SOH-C) (default)
1 - Low battery capacity (Low SOH-C)";
CM_ SG_ 2571108361 BATT_brickOverDischarge_9 "0 - Battery brick charge is normal (default)
1 - Battery brick is overdischarged";
CM_ SG_ 2571108361 BATT_brickOverCharge_9 "0 - Battery brick charge is normal (default)
1 - Battery brick is overcharged";
CM_ SG_ 2571108361 BATT_bmsProcessorError_9 "0 - No BMS processor failure (default)
1 - BMS processor failure";
CM_ SG_ 2571108361 BATT_bmsMemoryError_9 "0 - No BMS memory error
1 - BMS memory error";
CM_ SG_ 2571108361 BATT_afeError_9 "0 - No BMS AFE error (default)
1 - BMS AFE error";
CM_ BO_ 2571108362 "Message with flags from event matrix";
CM_ SG_ 2571108362 BATT_packModIdFault_10 "0 - Battery pack module ID okay (default)
1 - Battery pack module ID fault";
CM_ SG_ 2571108362 BATT_packModExitedFromBus_10 "0 - Battery pack modules OK (default)
1 - Battery pack module(s) exited from the bus during charge or drive";
CM_ SG_ 2571108362 BATT_packFetChgWelded_10 "0 - Battery pack module CHG FETs not welded (default)
1 - Battery pack module CHG FETs welded ";
CM_ SG_ 2571108362 BATT_packFetDsgWelded_10 "0 - Battery pack module DSG FETs not welded (default)
1 - Battery pack module DSG FETs welded ";
CM_ SG_ 2571108362 BATT_fetDsgShortedAux_10 "0 - FETs are operational (default)
1 - FET is shorted detected by auxiliary diagnostic";
CM_ SG_ 2571108362 BATT_fetChgShortedAux_10 "0 - FETs are operational (default)
1 - FET is shorted detected by auxiliary diagnostic";
CM_ SG_ 2571108362 BATT_prechargeFetFail_10 "0 - Precharge FET okay (default)
1 - Precharge FET failed";
CM_ SG_ 2571108362 BATT_abnormalResetReason_10 "0 - Reset reason okay (default)
1 - Abnormal reset reason";
CM_ SG_ 2571108362 BATT_prechargeTooSlow_10 "0 - Precharge okay (default)
1 - Precharge too slow";
CM_ SG_ 2571108362 BATT_prechargeTooFast_10 "0 - Precharge okay (default)
1 - Precharge too fast";
CM_ SG_ 2571108362 BATT_prechargeTimeout_10 "0 - Precharge okay (default)
1 - Precharge timeout";
CM_ SG_ 2571108362 BATT_fetChgShorted_10 "0 - FETs are operational (default)
1 - FET is shorted";
CM_ SG_ 2571108362 BATT_fetChgFailToClose_10 "0 - FETs are operational (default)
1 -  FET fail to close";
CM_ SG_ 2571108362 BATT_packModSelectFault_10 "0 - Battery pack module selection okay (default)
1 - Battery pack module selection fault";
CM_ SG_ 2571108362 BATT_packModConnectFault_10 "0 - Battery pack module connection okay (default)
1 - Battery pack module connection fault";
CM_ SG_ 2571108362 BATT_packModMIA_10 "0 - Battery pack modules not MIA (default)
1 - Battery pack module MIA";
CM_ SG_ 2571108362 BATT_packModImbalance_10 "0 - Battery pack modules balanced (default)
1 - Battery pack module imblance present";
CM_ SG_ 2571108362 BATT_afeFault_10 "0 - BMS AFE okay (default)
1 - BMS AFE fault";
CM_ SG_ 2571108362 BATT_chargerMIA_10 "0 - Charger communications okay (default)
1 - Charger MIA";
CM_ SG_ 2571108362 BATT_chargerError_10 "0 - Charger working as intended (default)
1 - Charger error";
CM_ SG_ 2571108362 BATT_vBrickUnderWar_10 "0 - Brick voltage okay (default)
1 - Brick undervoltage warning";
CM_ SG_ 2571108362 BATT_vBrickUnderSev_10 "0 - Brick voltage okay (default)
1 - Brick undervoltage severe";
CM_ SG_ 2571108362 BATT_vBrickUnderMod_10 "0 - Brick voltage okay (default)
1 - Brick undervoltage moderate";
CM_ SG_ 2571108362 BATT_vBrickOverWar_10 "0 - Brick voltage okay (default)
1 - Brick overvoltage warning";
CM_ SG_ 2571108362 BATT_vBrickOverSev_10 "0 - Brick voltage okay (default)
1 - Brick overvoltage severe";
CM_ SG_ 2571108362 BATT_vBrickOverMod_10 "0 - Brick voltage okay (default)
1 - Brick overvoltage moderate";
CM_ SG_ 2571108362 BATT_vBrickImbalance_10 "0 - Battery brick voltage okay (default)
1 - Battery brick voltage imbalance";
CM_ SG_ 2571108362 BATT_loggerAlmostFull_10 "0 - Logger not almost full (default)
1 - Logger almost full (section >= 80%) ";
CM_ SG_ 2571108362 BATT_tempModuleUnderWar_10 "0 - Battery temperature okay (default)
1 - Battery under temperature warning";
CM_ SG_ 2571108362 BATT_tempModuleUnderSev_10 "0 - Battery temperature okay (default)
1 - Battery under temperature severe";
CM_ SG_ 2571108362 BATT_tempModuleUnderMod_10 "0 - Battery temperature okay (default)
1 - Battery under temperature moderate";
CM_ SG_ 2571108362 BATT_tempModuleOverWar_10 "0 - Battery temperature okay (default)
1 - Battery over temperature warning";
CM_ SG_ 2571108362 BATT_tempModuleOverSev_10 "0 - Battery temperature okay (default)
1 - Battery over temperature severe";
CM_ SG_ 2571108362 BATT_tempModuleOverMod_10 "0 - Battery temperature okay (default)
1 - Battery over temperature moderate";
CM_ SG_ 2571108362 BATT_tempBrickImbalance_10 "0 - Brick temperatures are balanced (default)
1 - Brick temperatures are imbalanced";
CM_ SG_ 2571108362 BATT_taskLockupError_10 "0 - Tasks okay (default)
1 - Task lockup error";
CM_ SG_ 2571108362 BATT_tempAmbientOverWar_10 "0 - Ambient temperature okay (default)
1 - Ambient over temperature warning";
CM_ SG_ 2571108362 BATT_tempAmbientOverSev_10 "0 - Temperature okay (default)
1 - Ambient over temperature severe";
CM_ SG_ 2571108362 BATT_tempAmbientOverMod_10 "0 - Ambient temperature okay (default)
1 - Ambient over temparature moderate";
CM_ SG_ 2571108362 BATT_sensePackVoltError_10 "0 - Sensor okay (default)
1 - Sensor for pack voltage error";
CM_ SG_ 2571108362 BATT_senseLoadVoltError_10 "0 - Sensor okay (default)
1 - Sensor for load voltage error";
CM_ SG_ 2571108362 BATT_loggerFull_10 "0 - Logger not full (default)
1 - Logger full ";
CM_ SG_ 2571108362 BATT_senseCurrentError_10 "0 - Sensor okay (default)
1 - Sensor for current error";
CM_ SG_ 2571108362 BATT_senseBrickTempError_10 "0 - Sensor okay (default)
1 - Brick temperature sensor error";
CM_ SG_ 2571108362 BATT_resPackHigh_10 "0 - Battery pack resistance okay (default)
1 - Battery pack resistance high (High SOH-R)";
CM_ SG_ 2571108362 BATT_ramOverUtilError_10 "0 - RAM okay (default)
1 - RAM over utilization";
CM_ SG_ 2571108362 BATT_powerPackInsufficient_10 "0 - Battery pack power okay (default)
1 - Battery pack power insufficient";
CM_ SG_ 2571108362 BATT_packCellSoftShort_10 "0 - Battery back cells are okay (default)
1 - Battery pack cell soft short";
CM_ SG_ 2571108362 BATT_iOverHardware_10 "0 - Hardware current okay (default)
1 - Overcurrent in hardware";
CM_ SG_ 2571108362 BATT_fetOverTemp_10 "0 - FET temperature okay (default)
1 - Overtemp at FETs";
CM_ SG_ 2571108362 BATT_iOverDischarge_10 "0 - Discharge okay (default)
1 - Overcurrent during discharge";
CM_ SG_ 2571108362 BATT_iOverCharge_10 "0 - Charging okay (default)
1 - Overcurrent during charging";
CM_ SG_ 2571108362 BATT_inverterDriveMIA_10 "0 - Inverter drive present (default)
1 - Inverter drive MIA";
CM_ SG_ 2571108362 BATT_iUnderCharge_10 "0 - Normal charging (default)
1 -  Charging undercurrent (discharging)";
CM_ SG_ 2571108362 BATT_hostMIA_10 "0 - host communication open (default)
1 - host MIA";
CM_ SG_ 2571108362 BATT_fetDsgShorted_10 "0 - FETs are operational (default)
1 - FET is shorted";
CM_ SG_ 2571108362 BATT_fetDsgFailToClose_10 "0 - FETs are operational (default)
1 -  FET fail to close";
CM_ SG_ 2571108362 BATT_capLow_10 "0 - Battery capacity normal (SOH-C) (default)
1 - Low battery capacity (Low SOH-C)";
CM_ SG_ 2571108362 BATT_brickOverDischarge_10 "0 - Battery brick charge is normal (default)
1 - Battery brick is overdischarged";
CM_ SG_ 2571108362 BATT_brickOverCharge_10 "0 - Battery brick charge is normal (default)
1 - Battery brick is overcharged";
CM_ SG_ 2571108362 BATT_bmsProcessorError_10 "0 - No BMS processor failure (default)
1 - BMS processor failure";
CM_ SG_ 2571108362 BATT_bmsMemoryError_10 "0 - No BMS memory error
1 - BMS memory error";
CM_ SG_ 2571108362 BATT_afeError_10 "0 - No BMS AFE error (default)
1 - BMS AFE error";

BA_DEF_ BO_  "GenMsgDiag" ENUM "No","Yes";
BA_DEF_ BO_  "GenMsgInstanced" STRING ;
BA_DEF_ SG_  "GenSigType" ENUM "Extended","Diagnostic","Standard","Modified";
BA_DEF_ BO_  "GenMsgCycleTime" INT 0 0;
BA_DEF_ SG_  "GenSigSNA" INT 0 65535;
BA_DEF_ SG_  "Access" ENUM "r","rw";
BA_DEF_DEF_  "GenMsgDiag" "No";
BA_DEF_DEF_  "GenMsgInstanced" "No";
BA_DEF_DEF_  "GenSigType" "Standard";
BA_DEF_DEF_  "GenMsgCycleTime" 0;
BA_DEF_DEF_  "GenSigSNA" 0;
BA_DEF_DEF_  "Access" "r";
BA_ "GenMsgInstanced" BO_ 2571108352 "False";
BA_ "GenMsgInstanced" BO_ 2571108353 "False";
BA_ "GenMsgInstanced" BO_ 2571108354 "False";
BA_ "GenMsgInstanced" BO_ 2571108355 "False";
BA_ "GenMsgInstanced" BO_ 2571108356 "False";
BA_ "GenMsgInstanced" BO_ 2571108357 "False";
BA_ "GenMsgInstanced" BO_ 2571108358 "False";
BA_ "GenMsgInstanced" BO_ 2571108359 "False";
BA_ "GenMsgInstanced" BO_ 2571108360 "False";
BA_ "GenMsgInstanced" BO_ 2571108361 "False";
BA_ "GenMsgInstanced" BO_ 2571108362 "False";
BA_ "GenSigType" SG_ 2571108352 BATT_packModIdFault_0 1;
BA_ "GenSigType" SG_ 2571108352 BATT_packModExitedFromBus_0 1;
BA_ "GenSigType" SG_ 2571108352 BATT_packFetChgWelded_0 1;
BA_ "GenSigType" SG_ 2571108352 BATT_packFetDsgWelded_0 1;
BA_ "GenSigType" SG_ 2571108352 BATT_fetDsgShortedAux_0 1;
BA_ "GenSigType" SG_ 2571108352 BATT_fetChgShortedAux_0 1;
BA_ "GenSigType" SG_ 2571108352 BATT_prechargeFetFail_0 1;
BA_ "GenSigType" SG_ 2571108352 BATT_abnormalResetReason_0 1;
BA_ "GenSigType" SG_ 2571108352 BATT_prechargeTooSlow_0 1;
BA_ "GenSigType" SG_ 2571108352 BATT_prechargeTooFast_0 1;
BA_ "GenSigType" SG_ 2571108352 BATT_prechargeTimeout_0 1;
BA_ "GenSigType" SG_ 2571108352 BATT_fetChgShorted_0 1;
BA_ "GenSigType" SG_ 2571108352 BATT_fetChgFailToClose_0 1;
BA_ "GenSigType" SG_ 2571108352 BATT_packModSelectFault_0 1;
BA_ "GenSigType" SG_ 2571108352 BATT_packModConnectFault_0 1;
BA_ "GenSigType" SG_ 2571108352 BATT_packModMIA_0 1;
BA_ "GenSigType" SG_ 2571108352 BATT_packModImbalance_0 1;
BA_ "GenSigType" SG_ 2571108352 BATT_afeFault_0 1;
BA_ "GenSigType" SG_ 2571108352 BATT_chargerMIA_0 1;
BA_ "GenSigType" SG_ 2571108352 BATT_chargerError_0 1;
BA_ "GenSigType" SG_ 2571108352 BATT_vBrickUnderWar_0 1;
BA_ "GenSigType" SG_ 2571108352 BATT_vBrickUnderSev_0 1;
BA_ "GenSigType" SG_ 2571108352 BATT_vBrickUnderMod_0 1;
BA_ "GenSigType" SG_ 2571108352 BATT_vBrickOverWar_0 1;
BA_ "GenSigType" SG_ 2571108352 BATT_vBrickOverSev_0 1;
BA_ "GenSigType" SG_ 2571108352 BATT_vBrickOverMod_0 1;
BA_ "GenSigType" SG_ 2571108352 BATT_vBrickImbalance_0 1;
BA_ "GenSigType" SG_ 2571108352 BATT_loggerAlmostFull_0 1;
BA_ "GenSigType" SG_ 2571108352 BATT_tempModuleUnderWar_0 1;
BA_ "GenSigType" SG_ 2571108352 BATT_tempModuleUnderSev_0 1;
BA_ "GenSigType" SG_ 2571108352 BATT_tempModuleUnderMod_0 1;
BA_ "GenSigType" SG_ 2571108352 BATT_tempModuleOverWar_0 1;
BA_ "GenSigType" SG_ 2571108352 BATT_tempModuleOverSev_0 1;
BA_ "GenSigType" SG_ 2571108352 BATT_tempModuleOverMod_0 1;
BA_ "GenSigType" SG_ 2571108352 BATT_tempBrickImbalance_0 1;
BA_ "GenSigType" SG_ 2571108352 BATT_taskLockupError_0 1;
BA_ "GenSigType" SG_ 2571108352 BATT_tempAmbientOverWar_0 1;
BA_ "GenSigType" SG_ 2571108352 BATT_tempAmbientOverSev_0 1;
BA_ "GenSigType" SG_ 2571108352 BATT_tempAmbientOverMod_0 1;
BA_ "GenSigType" SG_ 2571108352 BATT_sensePackVoltError_0 1;
BA_ "GenSigType" SG_ 2571108352 BATT_senseLoadVoltError_0 1;
BA_ "GenSigType" SG_ 2571108352 BATT_loggerFull_0 1;
BA_ "GenSigType" SG_ 2571108352 BATT_senseCurrentError_0 1;
BA_ "GenSigType" SG_ 2571108352 BATT_senseBrickTempError_0 1;
BA_ "GenSigType" SG_ 2571108352 BATT_resPackHigh_0 1;
BA_ "GenSigType" SG_ 2571108352 BATT_ramOverUtilError_0 1;
BA_ "GenSigType" SG_ 2571108352 BATT_powerPackInsufficient_0 1;
BA_ "GenSigType" SG_ 2571108352 BATT_packCellSoftShort_0 1;
BA_ "GenSigType" SG_ 2571108352 BATT_iOverHardware_0 1;
BA_ "GenSigType" SG_ 2571108352 BATT_fetOverTemp_0 1;
BA_ "GenSigType" SG_ 2571108352 BATT_iOverDischarge_0 1;
BA_ "GenSigType" SG_ 2571108352 BATT_iOverCharge_0 1;
BA_ "GenSigType" SG_ 2571108352 BATT_inverterDriveMIA_0 1;
BA_ "GenSigType" SG_ 2571108352 BATT_iUnderCharge_0 1;
BA_ "GenSigType" SG_ 2571108352 BATT_hostMIA_0 1;
BA_ "GenSigType" SG_ 2571108352 BATT_fetDsgShorted_0 1;
BA_ "GenSigType" SG_ 2571108352 BATT_fetDsgFailToClose_0 1;
BA_ "GenSigType" SG_ 2571108352 BATT_capLow_0 1;
BA_ "GenSigType" SG_ 2571108352 BATT_brickOverDischarge_0 1;
BA_ "GenSigType" SG_ 2571108352 BATT_brickOverCharge_0 1;
BA_ "GenSigType" SG_ 2571108352 BATT_bmsProcessorError_0 1;
BA_ "GenSigType" SG_ 2571108352 BATT_bmsMemoryError_0 1;
BA_ "GenSigType" SG_ 2571108352 BATT_afeError_0 1;
BA_ "GenSigType" SG_ 2571108353 BATT_packModIdFault_1 1;
BA_ "GenSigType" SG_ 2571108353 BATT_packModExitedFromBus_1 1;
BA_ "GenSigType" SG_ 2571108353 BATT_packFetChgWelded_1 1;
BA_ "GenSigType" SG_ 2571108353 BATT_packFetDsgWelded_1 1;
BA_ "GenSigType" SG_ 2571108353 BATT_fetDsgShortedAux_1 1;
BA_ "GenSigType" SG_ 2571108353 BATT_abnormalResetReason_1 1;
BA_ "GenSigType" SG_ 2571108353 BATT_prechargeTooSlow_1 1;
BA_ "GenSigType" SG_ 2571108353 BATT_prechargeTooFast_1 1;
BA_ "GenSigType" SG_ 2571108353 BATT_prechargeTimeout_1 1;
BA_ "GenSigType" SG_ 2571108353 BATT_fetChgShorted_1 1;
BA_ "GenSigType" SG_ 2571108353 BATT_fetChgFailToClose_1 1;
BA_ "GenSigType" SG_ 2571108353 BATT_packModSelectFault_1 1;
BA_ "GenSigType" SG_ 2571108353 BATT_packModConnectFault_1 1;
BA_ "GenSigType" SG_ 2571108353 BATT_packModMIA_1 1;
BA_ "GenSigType" SG_ 2571108353 BATT_chargerMIA_1 1;
BA_ "GenSigType" SG_ 2571108353 BATT_chargerError_1 1;
BA_ "GenSigType" SG_ 2571108353 BATT_vBrickUnderWar_1 1;
BA_ "GenSigType" SG_ 2571108353 BATT_vBrickUnderSev_1 1;
BA_ "GenSigType" SG_ 2571108353 BATT_vBrickUnderMod_1 1;
BA_ "GenSigType" SG_ 2571108353 BATT_vBrickOverWar_1 1;
BA_ "GenSigType" SG_ 2571108353 BATT_vBrickOverSev_1 1;
BA_ "GenSigType" SG_ 2571108353 BATT_vBrickOverMod_1 1;
BA_ "GenSigType" SG_ 2571108353 BATT_vBrickImbalance_1 1;
BA_ "GenSigType" SG_ 2571108353 BATT_loggerAlmostFull_1 1;
BA_ "GenSigType" SG_ 2571108353 BATT_tempModuleUnderSev_1 1;
BA_ "GenSigType" SG_ 2571108353 BATT_tempModuleUnderMod_1 1;
BA_ "GenSigType" SG_ 2571108353 BATT_tempModuleOverWar_1 1;
BA_ "GenSigType" SG_ 2571108353 BATT_tempModuleOverSev_1 1;
BA_ "GenSigType" SG_ 2571108353 BATT_tempModuleOverMod_1 1;
BA_ "GenSigType" SG_ 2571108353 BATT_tempBrickImbalance_1 1;
BA_ "GenSigType" SG_ 2571108353 BATT_taskLockupError_1 1;
BA_ "GenSigType" SG_ 2571108353 BATT_tempAmbientOverWar_1 1;
BA_ "GenSigType" SG_ 2571108353 BATT_tempAmbientOverSev_1 1;
BA_ "GenSigType" SG_ 2571108353 BATT_tempAmbientOverMod_1 1;
BA_ "GenSigType" SG_ 2571108353 BATT_sensePackVoltError_1 1;
BA_ "GenSigType" SG_ 2571108353 BATT_senseLoadVoltError_1 1;
BA_ "GenSigType" SG_ 2571108353 BATT_loggerFull_1 1;
BA_ "GenSigType" SG_ 2571108353 BATT_senseCurrentError_1 1;
BA_ "GenSigType" SG_ 2571108353 BATT_senseBrickTempError_1 1;
BA_ "GenSigType" SG_ 2571108353 BATT_resPackHigh_1 1;
BA_ "GenSigType" SG_ 2571108353 BATT_ramOverUtilError_1 1;
BA_ "GenSigType" SG_ 2571108353 BATT_powerPackInsufficient_1 1;
BA_ "GenSigType" SG_ 2571108353 BATT_packCellSoftShort_1 1;
BA_ "GenSigType" SG_ 2571108353 BATT_iOverHardware_1 1;
BA_ "GenSigType" SG_ 2571108353 BATT_fetOverTemp_1 1;
BA_ "GenSigType" SG_ 2571108353 BATT_iOverDischarge_1 1;
BA_ "GenSigType" SG_ 2571108353 BATT_iOverCharge_1 1;
BA_ "GenSigType" SG_ 2571108353 BATT_inverterDriveMIA_1 1;
BA_ "GenSigType" SG_ 2571108353 BATT_iUnderCharge_1 1;
BA_ "GenSigType" SG_ 2571108353 BATT_hostMIA_1 1;
BA_ "GenSigType" SG_ 2571108353 BATT_fetDsgShorted_1 1;
BA_ "GenSigType" SG_ 2571108353 BATT_fetDsgFailToClose_1 1;
BA_ "GenSigType" SG_ 2571108353 BATT_capLow_1 1;
BA_ "GenSigType" SG_ 2571108353 BATT_brickOverDischarge_1 1;
BA_ "GenSigType" SG_ 2571108353 BATT_brickOverCharge_1 1;
BA_ "GenSigType" SG_ 2571108353 BATT_bmsProcessorError_1 1;
BA_ "GenSigType" SG_ 2571108353 BATT_bmsMemoryError_1 1;
BA_ "GenSigType" SG_ 2571108353 BATT_afeError_1 1;
BA_ "GenSigType" SG_ 2571108353 BATT_fetChgShortedAux_1 1;
BA_ "GenSigType" SG_ 2571108353 BATT_prechargeFetFail_1 1;
BA_ "GenSigType" SG_ 2571108353 BATT_packModImbalance_1 1;
BA_ "GenSigType" SG_ 2571108353 BATT_afeFault_1 1;
BA_ "GenSigType" SG_ 2571108353 BATT_tempModuleUnderWar_1 1;
BA_ "GenSigType" SG_ 2571108354 BATT_loggerAlmostFull_2 1;
BA_ "GenSigType" SG_ 2571108354 BATT_sensePackVoltError_2 1;
BA_ "GenSigType" SG_ 2571108354 BATT_loggerFull_2 1;
BA_ "GenSigType" SG_ 2571108354 BATT_senseCurrentError_2 1;
BA_ "GenSigType" SG_ 2571108354 BATT_ramOverUtilError_2 1;
BA_ "GenSigType" SG_ 2571108354 BATT_packCellSoftShort_2 1;
BA_ "GenSigType" SG_ 2571108354 BATT_iUnderCharge_2 1;
BA_ "GenSigType" SG_ 2571108354 BATT_capLow_2 1;
BA_ "GenSigType" SG_ 2571108354 BATT_packModIdFault_2 1;
BA_ "GenSigType" SG_ 2571108354 BATT_packModExitedFromBus_2 1;
BA_ "GenSigType" SG_ 2571108354 BATT_packFetChgWelded_2 1;
BA_ "GenSigType" SG_ 2571108354 BATT_packFetDsgWelded_2 1;
BA_ "GenSigType" SG_ 2571108354 BATT_fetDsgShortedAux_2 1;
BA_ "GenSigType" SG_ 2571108354 BATT_fetChgShortedAux_2 1;
BA_ "GenSigType" SG_ 2571108354 BATT_prechargeFetFail_2 1;
BA_ "GenSigType" SG_ 2571108354 BATT_abnormalResetReason_2 1;
BA_ "GenSigType" SG_ 2571108354 BATT_prechargeTooSlow_2 1;
BA_ "GenSigType" SG_ 2571108354 BATT_prechargeTooFast_2 1;
BA_ "GenSigType" SG_ 2571108354 BATT_prechargeTimeout_2 1;
BA_ "GenSigType" SG_ 2571108354 BATT_fetChgFailToClose_2 1;
BA_ "GenSigType" SG_ 2571108354 BATT_packModSelectFault_2 1;
BA_ "GenSigType" SG_ 2571108354 BATT_packModConnectFault_2 1;
BA_ "GenSigType" SG_ 2571108354 BATT_packModMIA_2 1;
BA_ "GenSigType" SG_ 2571108354 BATT_packModImbalance_2 1;
BA_ "GenSigType" SG_ 2571108354 BATT_afeFault_2 1;
BA_ "GenSigType" SG_ 2571108354 BATT_chargerMIA_2 1;
BA_ "GenSigType" SG_ 2571108354 BATT_chargerError_2 1;
BA_ "GenSigType" SG_ 2571108354 BATT_vBrickUnderWar_2 1;
BA_ "GenSigType" SG_ 2571108354 BATT_vBrickUnderSev_2 1;
BA_ "GenSigType" SG_ 2571108354 BATT_vBrickUnderMod_2 1;
BA_ "GenSigType" SG_ 2571108354 BATT_vBrickOverWar_2 1;
BA_ "GenSigType" SG_ 2571108354 BATT_vBrickOverSev_2 1;
BA_ "GenSigType" SG_ 2571108354 BATT_vBrickOverMod_2 1;
BA_ "GenSigType" SG_ 2571108354 BATT_fetChgShorted_2 1;
BA_ "GenSigType" SG_ 2571108354 BATT_vBrickImbalance_2 1;
BA_ "GenSigType" SG_ 2571108354 BATT_tempModuleUnderWar_2 1;
BA_ "GenSigType" SG_ 2571108354 BATT_tempModuleUnderSev_2 1;
BA_ "GenSigType" SG_ 2571108354 BATT_tempModuleUnderMod_2 1;
BA_ "GenSigType" SG_ 2571108354 BATT_tempModuleOverWar_2 1;
BA_ "GenSigType" SG_ 2571108354 BATT_tempModuleOverSev_2 1;
BA_ "GenSigType" SG_ 2571108354 BATT_tempModuleOverMod_2 1;
BA_ "GenSigType" SG_ 2571108354 BATT_tempBrickImbalance_2 1;
BA_ "GenSigType" SG_ 2571108354 BATT_taskLockupError_2 1;
BA_ "GenSigType" SG_ 2571108354 BATT_tempAmbientOverWar_2 1;
BA_ "GenSigType" SG_ 2571108354 BATT_tempAmbientOverSev_2 1;
BA_ "GenSigType" SG_ 2571108354 BATT_tempAmbientOverMod_2 1;
BA_ "GenSigType" SG_ 2571108354 BATT_senseLoadVoltError_2 1;
BA_ "GenSigType" SG_ 2571108354 BATT_resPackHigh_2 1;
BA_ "GenSigType" SG_ 2571108354 BATT_powerPackInsufficient_2 1;
BA_ "GenSigType" SG_ 2571108354 BATT_iOverHardware_2 1;
BA_ "GenSigType" SG_ 2571108354 BATT_senseBrickTempError_2 1;
BA_ "GenSigType" SG_ 2571108354 BATT_iOverDischarge_2 1;
BA_ "GenSigType" SG_ 2571108354 BATT_inverterDriveMIA_2 1;
BA_ "GenSigType" SG_ 2571108354 BATT_hostMIA_2 1;
BA_ "GenSigType" SG_ 2571108354 BATT_fetOverTemp_2 1;
BA_ "GenSigType" SG_ 2571108354 BATT_iOverCharge_2 1;
BA_ "GenSigType" SG_ 2571108354 BATT_fetDsgFailToClose_2 1;
BA_ "GenSigType" SG_ 2571108354 BATT_brickOverDischarge_2 1;
BA_ "GenSigType" SG_ 2571108354 BATT_bmsProcessorError_2 1;
BA_ "GenSigType" SG_ 2571108354 BATT_fetDsgShorted_2 1;
BA_ "GenSigType" SG_ 2571108354 BATT_afeError_2 1;
BA_ "GenSigType" SG_ 2571108354 BATT_brickOverCharge_2 1;
BA_ "GenSigType" SG_ 2571108354 BATT_bmsMemoryError_2 1;
BA_ "GenSigType" SG_ 2571108355 BATT_fetDsgShortedAux_3 1;
BA_ "GenSigType" SG_ 2571108355 BATT_fetChgShortedAux_3 1;
BA_ "GenSigType" SG_ 2571108355 BATT_prechargeFetFail_3 1;
BA_ "GenSigType" SG_ 2571108355 BATT_prechargeTimeout_3 1;
BA_ "GenSigType" SG_ 2571108355 BATT_fetChgFailToClose_3 1;
BA_ "GenSigType" SG_ 2571108355 BATT_vBrickUnderWar_3 1;
BA_ "GenSigType" SG_ 2571108355 BATT_vBrickUnderMod_3 1;
BA_ "GenSigType" SG_ 2571108355 BATT_vBrickOverSev_3 1;
BA_ "GenSigType" SG_ 2571108355 BATT_tempModuleUnderMod_3 1;
BA_ "GenSigType" SG_ 2571108355 BATT_tempBrickImbalance_3 1;
BA_ "GenSigType" SG_ 2571108355 BATT_tempAmbientOverWar_3 1;
BA_ "GenSigType" SG_ 2571108355 BATT_tempAmbientOverMod_3 1;
BA_ "GenSigType" SG_ 2571108355 BATT_packModExitedFromBus_3 1;
BA_ "GenSigType" SG_ 2571108355 BATT_packModIdFault_3 1;
BA_ "GenSigType" SG_ 2571108355 BATT_packFetDsgWelded_3 1;
BA_ "GenSigType" SG_ 2571108355 BATT_abnormalResetReason_3 1;
BA_ "GenSigType" SG_ 2571108355 BATT_packFetChgWelded_3 1;
BA_ "GenSigType" SG_ 2571108355 BATT_prechargeTooSlow_3 1;
BA_ "GenSigType" SG_ 2571108355 BATT_prechargeTooFast_3 1;
BA_ "GenSigType" SG_ 2571108355 BATT_fetChgShorted_3 1;
BA_ "GenSigType" SG_ 2571108355 BATT_packModSelectFault_3 1;
BA_ "GenSigType" SG_ 2571108355 BATT_packModConnectFault_3 1;
BA_ "GenSigType" SG_ 2571108355 BATT_packModMIA_3 1;
BA_ "GenSigType" SG_ 2571108355 BATT_packModImbalance_3 1;
BA_ "GenSigType" SG_ 2571108355 BATT_afeFault_3 1;
BA_ "GenSigType" SG_ 2571108355 BATT_chargerMIA_3 1;
BA_ "GenSigType" SG_ 2571108355 BATT_chargerError_3 1;
BA_ "GenSigType" SG_ 2571108355 BATT_vBrickUnderSev_3 1;
BA_ "GenSigType" SG_ 2571108355 BATT_vBrickOverWar_3 1;
BA_ "GenSigType" SG_ 2571108355 BATT_vBrickOverMod_3 1;
BA_ "GenSigType" SG_ 2571108355 BATT_loggerAlmostFull_3 1;
BA_ "GenSigType" SG_ 2571108355 BATT_tempModuleUnderWar_3 1;
BA_ "GenSigType" SG_ 2571108355 BATT_tempModuleUnderSev_3 1;
BA_ "GenSigType" SG_ 2571108355 BATT_tempModuleOverWar_3 1;
BA_ "GenSigType" SG_ 2571108355 BATT_vBrickImbalance_3 1;
BA_ "GenSigType" SG_ 2571108355 BATT_taskLockupError_3 1;
BA_ "GenSigType" SG_ 2571108355 BATT_tempAmbientOverSev_3 1;
BA_ "GenSigType" SG_ 2571108355 BATT_tempModuleOverSev_3 1;
BA_ "GenSigType" SG_ 2571108355 BATT_tempModuleOverMod_3 1;
BA_ "GenSigType" SG_ 2571108355 BATT_sensePackVoltError_3 1;
BA_ "GenSigType" SG_ 2571108355 BATT_senseLoadVoltError_3 1;
BA_ "GenSigType" SG_ 2571108355 BATT_loggerFull_3 1;
BA_ "GenSigType" SG_ 2571108355 BATT_senseCurrentError_3 1;
BA_ "GenSigType" SG_ 2571108355 BATT_senseBrickTempError_3 1;
BA_ "GenSigType" SG_ 2571108355 BATT_resPackHigh_3 1;
BA_ "GenSigType" SG_ 2571108355 BATT_ramOverUtilError_3 1;
BA_ "GenSigType" SG_ 2571108355 BATT_powerPackInsufficient_3 1;
BA_ "GenSigType" SG_ 2571108355 BATT_packCellSoftShort_3 1;
BA_ "GenSigType" SG_ 2571108355 BATT_iOverHardware_3 1;
BA_ "GenSigType" SG_ 2571108355 BATT_fetOverTemp_3 1;
BA_ "GenSigType" SG_ 2571108355 BATT_iOverDischarge_3 1;
BA_ "GenSigType" SG_ 2571108355 BATT_iOverCharge_3 1;
BA_ "GenSigType" SG_ 2571108355 BATT_inverterDriveMIA_3 1;
BA_ "GenSigType" SG_ 2571108355 BATT_iUnderCharge_3 1;
BA_ "GenSigType" SG_ 2571108355 BATT_hostMIA_3 1;
BA_ "GenSigType" SG_ 2571108355 BATT_fetDsgShorted_3 1;
BA_ "GenSigType" SG_ 2571108355 BATT_fetDsgFailToClose_3 1;
BA_ "GenSigType" SG_ 2571108355 BATT_capLow_3 1;
BA_ "GenSigType" SG_ 2571108355 BATT_brickOverDischarge_3 1;
BA_ "GenSigType" SG_ 2571108355 BATT_brickOverCharge_3 1;
BA_ "GenSigType" SG_ 2571108355 BATT_bmsProcessorError_3 1;
BA_ "GenSigType" SG_ 2571108355 BATT_bmsMemoryError_3 1;
BA_ "GenSigType" SG_ 2571108355 BATT_afeError_3 1;
BA_ "GenSigType" SG_ 2571108356 BATT_packModIdFault_4 1;
BA_ "GenSigType" SG_ 2571108356 BATT_packModExitedFromBus_4 1;
BA_ "GenSigType" SG_ 2571108356 BATT_packFetChgWelded_4 1;
BA_ "GenSigType" SG_ 2571108356 BATT_packFetDsgWelded_4 1;
BA_ "GenSigType" SG_ 2571108356 BATT_fetDsgShortedAux_4 1;
BA_ "GenSigType" SG_ 2571108356 BATT_fetChgShortedAux_4 1;
BA_ "GenSigType" SG_ 2571108356 BATT_prechargeFetFail_4 1;
BA_ "GenSigType" SG_ 2571108356 BATT_abnormalResetReason_4 1;
BA_ "GenSigType" SG_ 2571108356 BATT_prechargeTooSlow_4 1;
BA_ "GenSigType" SG_ 2571108356 BATT_prechargeTooFast_4 1;
BA_ "GenSigType" SG_ 2571108356 BATT_prechargeTimeout_4 1;
BA_ "GenSigType" SG_ 2571108356 BATT_fetChgShorted_4 1;
BA_ "GenSigType" SG_ 2571108356 BATT_fetChgFailToClose_4 1;
BA_ "GenSigType" SG_ 2571108356 BATT_packModSelectFault_4 1;
BA_ "GenSigType" SG_ 2571108356 BATT_packModConnectFault_4 1;
BA_ "GenSigType" SG_ 2571108356 BATT_packModMIA_4 1;
BA_ "GenSigType" SG_ 2571108356 BATT_packModImbalance_4 1;
BA_ "GenSigType" SG_ 2571108356 BATT_afeFault_4 1;
BA_ "GenSigType" SG_ 2571108356 BATT_chargerMIA_4 1;
BA_ "GenSigType" SG_ 2571108356 BATT_chargerError_4 1;
BA_ "GenSigType" SG_ 2571108356 BATT_vBrickUnderWar_4 1;
BA_ "GenSigType" SG_ 2571108356 BATT_vBrickUnderSev_4 1;
BA_ "GenSigType" SG_ 2571108356 BATT_vBrickUnderMod_4 1;
BA_ "GenSigType" SG_ 2571108356 BATT_vBrickOverWar_4 1;
BA_ "GenSigType" SG_ 2571108356 BATT_vBrickOverSev_4 1;
BA_ "GenSigType" SG_ 2571108356 BATT_vBrickOverMod_4 1;
BA_ "GenSigType" SG_ 2571108356 BATT_vBrickImbalance_4 1;
BA_ "GenSigType" SG_ 2571108356 BATT_loggerAlmostFull_4 1;
BA_ "GenSigType" SG_ 2571108356 BATT_tempModuleUnderWar_4 1;
BA_ "GenSigType" SG_ 2571108356 BATT_tempModuleUnderSev_4 1;
BA_ "GenSigType" SG_ 2571108356 BATT_tempModuleUnderMod_4 1;
BA_ "GenSigType" SG_ 2571108356 BATT_tempModuleOverWar_4 1;
BA_ "GenSigType" SG_ 2571108356 BATT_tempModuleOverSev_4 1;
BA_ "GenSigType" SG_ 2571108356 BATT_tempModuleOverMod_4 1;
BA_ "GenSigType" SG_ 2571108356 BATT_tempBrickImbalance_4 1;
BA_ "GenSigType" SG_ 2571108356 BATT_taskLockupError_4 1;
BA_ "GenSigType" SG_ 2571108356 BATT_tempAmbientOverWar_4 1;
BA_ "GenSigType" SG_ 2571108356 BATT_tempAmbientOverSev_4 1;
BA_ "GenSigType" SG_ 2571108356 BATT_tempAmbientOverMod_4 1;
BA_ "GenSigType" SG_ 2571108356 BATT_sensePackVoltError_4 1;
BA_ "GenSigType" SG_ 2571108356 BATT_senseLoadVoltError_4 1;
BA_ "GenSigType" SG_ 2571108356 BATT_loggerFull_4 1;
BA_ "GenSigType" SG_ 2571108356 BATT_senseCurrentError_4 1;
BA_ "GenSigType" SG_ 2571108356 BATT_senseBrickTempError_4 1;
BA_ "GenSigType" SG_ 2571108356 BATT_resPackHigh_4 1;
BA_ "GenSigType" SG_ 2571108356 BATT_ramOverUtilError_4 1;
BA_ "GenSigType" SG_ 2571108356 BATT_powerPackInsufficient_4 1;
BA_ "GenSigType" SG_ 2571108356 BATT_packCellSoftShort_4 1;
BA_ "GenSigType" SG_ 2571108356 BATT_iOverHardware_4 1;
BA_ "GenSigType" SG_ 2571108356 BATT_fetOverTemp_4 1;
BA_ "GenSigType" SG_ 2571108356 BATT_iOverDischarge_4 1;
BA_ "GenSigType" SG_ 2571108356 BATT_iOverCharge_4 1;
BA_ "GenSigType" SG_ 2571108356 BATT_inverterDriveMIA_4 1;
BA_ "GenSigType" SG_ 2571108356 BATT_iUnderCharge_4 1;
BA_ "GenSigType" SG_ 2571108356 BATT_hostMIA_4 1;
BA_ "GenSigType" SG_ 2571108356 BATT_fetDsgShorted_4 1;
BA_ "GenSigType" SG_ 2571108356 BATT_fetDsgFailToClose_4 1;
BA_ "GenSigType" SG_ 2571108356 BATT_capLow_4 1;
BA_ "GenSigType" SG_ 2571108356 BATT_brickOverDischarge_4 1;
BA_ "GenSigType" SG_ 2571108356 BATT_brickOverCharge_4 1;
BA_ "GenSigType" SG_ 2571108356 BATT_bmsProcessorError_4 1;
BA_ "GenSigType" SG_ 2571108356 BATT_bmsMemoryError_4 1;
BA_ "GenSigType" SG_ 2571108356 BATT_afeError_4 1;
BA_ "GenSigType" SG_ 2571108357 BATT_packModIdFault_5 1;
BA_ "GenSigType" SG_ 2571108357 BATT_packModExitedFromBus_5 1;
BA_ "GenSigType" SG_ 2571108357 BATT_packFetChgWelded_5 1;
BA_ "GenSigType" SG_ 2571108357 BATT_packFetDsgWelded_5 1;
BA_ "GenSigType" SG_ 2571108357 BATT_fetDsgShortedAux_5 1;
BA_ "GenSigType" SG_ 2571108357 BATT_fetChgShortedAux_5 1;
BA_ "GenSigType" SG_ 2571108357 BATT_prechargeFetFail_5 1;
BA_ "GenSigType" SG_ 2571108357 BATT_abnormalResetReason_5 1;
BA_ "GenSigType" SG_ 2571108357 BATT_prechargeTooSlow_5 1;
BA_ "GenSigType" SG_ 2571108357 BATT_prechargeTooFast_5 1;
BA_ "GenSigType" SG_ 2571108357 BATT_prechargeTimeout_5 1;
BA_ "GenSigType" SG_ 2571108357 BATT_fetChgShorted_5 1;
BA_ "GenSigType" SG_ 2571108357 BATT_fetChgFailToClose_5 1;
BA_ "GenSigType" SG_ 2571108357 BATT_packModSelectFault_5 1;
BA_ "GenSigType" SG_ 2571108357 BATT_packModConnectFault_5 1;
BA_ "GenSigType" SG_ 2571108357 BATT_packModMIA_5 1;
BA_ "GenSigType" SG_ 2571108357 BATT_packModImbalance_5 1;
BA_ "GenSigType" SG_ 2571108357 BATT_afeFault_5 1;
BA_ "GenSigType" SG_ 2571108357 BATT_chargerMIA_5 1;
BA_ "GenSigType" SG_ 2571108357 BATT_chargerError_5 1;
BA_ "GenSigType" SG_ 2571108357 BATT_vBrickUnderWar_5 1;
BA_ "GenSigType" SG_ 2571108357 BATT_vBrickUnderSev_5 1;
BA_ "GenSigType" SG_ 2571108357 BATT_vBrickUnderMod_5 1;
BA_ "GenSigType" SG_ 2571108357 BATT_vBrickOverWar_5 1;
BA_ "GenSigType" SG_ 2571108357 BATT_vBrickOverSev_5 1;
BA_ "GenSigType" SG_ 2571108357 BATT_vBrickOverMod_5 1;
BA_ "GenSigType" SG_ 2571108357 BATT_vBrickImbalance_5 1;
BA_ "GenSigType" SG_ 2571108357 BATT_loggerAlmostFull_5 1;
BA_ "GenSigType" SG_ 2571108357 BATT_tempModuleUnderWar_5 1;
BA_ "GenSigType" SG_ 2571108357 BATT_tempModuleUnderSev_5 1;
BA_ "GenSigType" SG_ 2571108357 BATT_tempModuleUnderMod_5 1;
BA_ "GenSigType" SG_ 2571108357 BATT_tempModuleOverWar_5 1;
BA_ "GenSigType" SG_ 2571108357 BATT_tempModuleOverSev_5 1;
BA_ "GenSigType" SG_ 2571108357 BATT_tempModuleOverMod_5 1;
BA_ "GenSigType" SG_ 2571108357 BATT_tempBrickImbalance_5 1;
BA_ "GenSigType" SG_ 2571108357 BATT_taskLockupError_5 1;
BA_ "GenSigType" SG_ 2571108357 BATT_tempAmbientOverWar_5 1;
BA_ "GenSigType" SG_ 2571108357 BATT_tempAmbientOverSev_5 1;
BA_ "GenSigType" SG_ 2571108357 BATT_tempAmbientOverMod_5 1;
BA_ "GenSigType" SG_ 2571108357 BATT_sensePackVoltError_5 1;
BA_ "GenSigType" SG_ 2571108357 BATT_senseLoadVoltError_5 1;
BA_ "GenSigType" SG_ 2571108357 BATT_loggerFull_5 1;
BA_ "GenSigType" SG_ 2571108357 BATT_senseCurrentError_5 1;
BA_ "GenSigType" SG_ 2571108357 BATT_senseBrickTempError_5 1;
BA_ "GenSigType" SG_ 2571108357 BATT_resPackHigh_5 1;
BA_ "GenSigType" SG_ 2571108357 BATT_ramOverUtilError_5 1;
BA_ "GenSigType" SG_ 2571108357 BATT_powerPackInsufficient_5 1;
BA_ "GenSigType" SG_ 2571108357 BATT_packCellSoftShort_5 1;
BA_ "GenSigType" SG_ 2571108357 BATT_iOverHardware_5 1;
BA_ "GenSigType" SG_ 2571108357 BATT_fetOverTemp_5 1;
BA_ "GenSigType" SG_ 2571108357 BATT_iOverDischarge_5 1;
BA_ "GenSigType" SG_ 2571108357 BATT_iOverCharge_5 1;
BA_ "GenSigType" SG_ 2571108357 BATT_inverterDriveMIA_5 1;
BA_ "GenSigType" SG_ 2571108357 BATT_iUnderCharge_5 1;
BA_ "GenSigType" SG_ 2571108357 BATT_hostMIA_5 1;
BA_ "GenSigType" SG_ 2571108357 BATT_fetDsgShorted_5 1;
BA_ "GenSigType" SG_ 2571108357 BATT_fetDsgFailToClose_5 1;
BA_ "GenSigType" SG_ 2571108357 BATT_capLow_5 1;
BA_ "GenSigType" SG_ 2571108357 BATT_brickOverDischarge_5 1;
BA_ "GenSigType" SG_ 2571108357 BATT_brickOverCharge_5 1;
BA_ "GenSigType" SG_ 2571108357 BATT_bmsProcessorError_5 1;
BA_ "GenSigType" SG_ 2571108357 BATT_bmsMemoryError_5 1;
BA_ "GenSigType" SG_ 2571108357 BATT_afeError_5 1;
BA_ "GenSigType" SG_ 2571108358 BATT_packModIdFault_6 1;
BA_ "GenSigType" SG_ 2571108358 BATT_packModExitedFromBus_6 1;
BA_ "GenSigType" SG_ 2571108358 BATT_packFetChgWelded_6 1;
BA_ "GenSigType" SG_ 2571108358 BATT_packFetDsgWelded_6 1;
BA_ "GenSigType" SG_ 2571108358 BATT_fetDsgShortedAux_6 1;
BA_ "GenSigType" SG_ 2571108358 BATT_fetChgShortedAux_6 1;
BA_ "GenSigType" SG_ 2571108358 BATT_prechargeFetFail_6 1;
BA_ "GenSigType" SG_ 2571108358 BATT_abnormalResetReason_6 1;
BA_ "GenSigType" SG_ 2571108358 BATT_prechargeTooSlow_6 1;
BA_ "GenSigType" SG_ 2571108358 BATT_prechargeTooFast_6 1;
BA_ "GenSigType" SG_ 2571108358 BATT_prechargeTimeout_6 1;
BA_ "GenSigType" SG_ 2571108358 BATT_fetChgShorted_6 1;
BA_ "GenSigType" SG_ 2571108358 BATT_fetChgFailToClose_6 1;
BA_ "GenSigType" SG_ 2571108358 BATT_packModSelectFault_6 1;
BA_ "GenSigType" SG_ 2571108358 BATT_packModConnectFault_6 1;
BA_ "GenSigType" SG_ 2571108358 BATT_packModMIA_6 1;
BA_ "GenSigType" SG_ 2571108358 BATT_packModImbalance_6 1;
BA_ "GenSigType" SG_ 2571108358 BATT_afeFault_6 1;
BA_ "GenSigType" SG_ 2571108358 BATT_chargerMIA_6 1;
BA_ "GenSigType" SG_ 2571108358 BATT_chargerError_6 1;
BA_ "GenSigType" SG_ 2571108358 BATT_vBrickUnderWar_6 1;
BA_ "GenSigType" SG_ 2571108358 BATT_vBrickUnderSev_6 1;
BA_ "GenSigType" SG_ 2571108358 BATT_vBrickUnderMod_6 1;
BA_ "GenSigType" SG_ 2571108358 BATT_vBrickOverWar_6 1;
BA_ "GenSigType" SG_ 2571108358 BATT_vBrickOverSev_6 1;
BA_ "GenSigType" SG_ 2571108358 BATT_vBrickOverMod_6 1;
BA_ "GenSigType" SG_ 2571108358 BATT_vBrickImbalance_6 1;
BA_ "GenSigType" SG_ 2571108358 BATT_loggerAlmostFull_6 1;
BA_ "GenSigType" SG_ 2571108358 BATT_tempModuleUnderWar_6 1;
BA_ "GenSigType" SG_ 2571108358 BATT_tempModuleUnderSev_6 1;
BA_ "GenSigType" SG_ 2571108358 BATT_tempModuleUnderMod_6 1;
BA_ "GenSigType" SG_ 2571108358 BATT_tempModuleOverWar_6 1;
BA_ "GenSigType" SG_ 2571108358 BATT_tempModuleOverSev_6 1;
BA_ "GenSigType" SG_ 2571108358 BATT_tempModuleOverMod_6 1;
BA_ "GenSigType" SG_ 2571108358 BATT_tempBrickImbalance_6 1;
BA_ "GenSigType" SG_ 2571108358 BATT_taskLockupError_6 1;
BA_ "GenSigType" SG_ 2571108358 BATT_tempAmbientOverWar_6 1;
BA_ "GenSigType" SG_ 2571108358 BATT_tempAmbientOverSev_6 1;
BA_ "GenSigType" SG_ 2571108358 BATT_tempAmbientOverMod_6 1;
BA_ "GenSigType" SG_ 2571108358 BATT_sensePackVoltError_6 1;
BA_ "GenSigType" SG_ 2571108358 BATT_senseLoadVoltError_6 1;
BA_ "GenSigType" SG_ 2571108358 BATT_loggerFull_6 1;
BA_ "GenSigType" SG_ 2571108358 BATT_senseCurrentError_6 1;
BA_ "GenSigType" SG_ 2571108358 BATT_senseBrickTempError_6 1;
BA_ "GenSigType" SG_ 2571108358 BATT_resPackHigh_6 1;
BA_ "GenSigType" SG_ 2571108358 BATT_ramOverUtilError_6 1;
BA_ "GenSigType" SG_ 2571108358 BATT_powerPackInsufficient_6 1;
BA_ "GenSigType" SG_ 2571108358 BATT_packCellSoftShort_6 1;
BA_ "GenSigType" SG_ 2571108358 BATT_iOverHardware_6 1;
BA_ "GenSigType" SG_ 2571108358 BATT_fetOverTemp_6 1;
BA_ "GenSigType" SG_ 2571108358 BATT_iOverDischarge_6 1;
BA_ "GenSigType" SG_ 2571108358 BATT_iOverCharge_6 1;
BA_ "GenSigType" SG_ 2571108358 BATT_inverterDriveMIA_6 1;
BA_ "GenSigType" SG_ 2571108358 BATT_iUnderCharge_6 1;
BA_ "GenSigType" SG_ 2571108358 BATT_hostMIA_6 1;
BA_ "GenSigType" SG_ 2571108358 BATT_fetDsgShorted_6 1;
BA_ "GenSigType" SG_ 2571108358 BATT_fetDsgFailToClose_6 1;
BA_ "GenSigType" SG_ 2571108358 BATT_capLow_6 1;
BA_ "GenSigType" SG_ 2571108358 BATT_brickOverDischarge_6 1;
BA_ "GenSigType" SG_ 2571108358 BATT_brickOverCharge_6 1;
BA_ "GenSigType" SG_ 2571108358 BATT_bmsProcessorError_6 1;
BA_ "GenSigType" SG_ 2571108358 BATT_bmsMemoryError_6 1;
BA_ "GenSigType" SG_ 2571108358 BATT_afeError_6 1;
BA_ "GenSigType" SG_ 2571108359 BATT_packModIdFault_7 1;
BA_ "GenSigType" SG_ 2571108359 BATT_packModExitedFromBus_7 1;
BA_ "GenSigType" SG_ 2571108359 BATT_packFetChgWelded_7 1;
BA_ "GenSigType" SG_ 2571108359 BATT_packFetDsgWelded_7 1;
BA_ "GenSigType" SG_ 2571108359 BATT_fetDsgShortedAux_7 1;
BA_ "GenSigType" SG_ 2571108359 BATT_fetChgShortedAux_7 1;
BA_ "GenSigType" SG_ 2571108359 BATT_prechargeFetFail_7 1;
BA_ "GenSigType" SG_ 2571108359 BATT_abnormalResetReason_7 1;
BA_ "GenSigType" SG_ 2571108359 BATT_prechargeTooSlow_7 1;
BA_ "GenSigType" SG_ 2571108359 BATT_prechargeTooFast_7 1;
BA_ "GenSigType" SG_ 2571108359 BATT_prechargeTimeout_7 1;
BA_ "GenSigType" SG_ 2571108359 BATT_fetChgShorted_7 1;
BA_ "GenSigType" SG_ 2571108359 BATT_fetChgFailToClose_7 1;
BA_ "GenSigType" SG_ 2571108359 BATT_packModSelectFault_7 1;
BA_ "GenSigType" SG_ 2571108359 BATT_packModConnectFault_7 1;
BA_ "GenSigType" SG_ 2571108359 BATT_packModMIA_7 1;
BA_ "GenSigType" SG_ 2571108359 BATT_packModImbalance_7 1;
BA_ "GenSigType" SG_ 2571108359 BATT_afeFault_7 1;
BA_ "GenSigType" SG_ 2571108359 BATT_chargerMIA_7 1;
BA_ "GenSigType" SG_ 2571108359 BATT_chargerError_7 1;
BA_ "GenSigType" SG_ 2571108359 BATT_vBrickUnderWar_7 1;
BA_ "GenSigType" SG_ 2571108359 BATT_vBrickUnderSev_7 1;
BA_ "GenSigType" SG_ 2571108359 BATT_vBrickUnderMod_7 1;
BA_ "GenSigType" SG_ 2571108359 BATT_vBrickOverWar_7 1;
BA_ "GenSigType" SG_ 2571108359 BATT_vBrickOverSev_7 1;
BA_ "GenSigType" SG_ 2571108359 BATT_vBrickOverMod_7 1;
BA_ "GenSigType" SG_ 2571108359 BATT_vBrickImbalance_7 1;
BA_ "GenSigType" SG_ 2571108359 BATT_loggerAlmostFull_7 1;
BA_ "GenSigType" SG_ 2571108359 BATT_tempModuleUnderWar_7 1;
BA_ "GenSigType" SG_ 2571108359 BATT_tempModuleUnderSev_7 1;
BA_ "GenSigType" SG_ 2571108359 BATT_tempModuleUnderMod_7 1;
BA_ "GenSigType" SG_ 2571108359 BATT_tempModuleOverWar_7 1;
BA_ "GenSigType" SG_ 2571108359 BATT_tempModuleOverSev_7 1;
BA_ "GenSigType" SG_ 2571108359 BATT_tempModuleOverMod_7 1;
BA_ "GenSigType" SG_ 2571108359 BATT_tempBrickImbalance_7 1;
BA_ "GenSigType" SG_ 2571108359 BATT_taskLockupError_7 1;
BA_ "GenSigType" SG_ 2571108359 BATT_tempAmbientOverWar_7 1;
BA_ "GenSigType" SG_ 2571108359 BATT_tempAmbientOverSev_7 1;
BA_ "GenSigType" SG_ 2571108359 BATT_tempAmbientOverMod_7 1;
BA_ "GenSigType" SG_ 2571108359 BATT_sensePackVoltError_7 1;
BA_ "GenSigType" SG_ 2571108359 BATT_senseLoadVoltError_7 1;
BA_ "GenSigType" SG_ 2571108359 BATT_senseBrickTempError_7 1;
BA_ "GenSigType" SG_ 2571108359 BATT_ramOverUtilError_7 1;
BA_ "GenSigType" SG_ 2571108359 BATT_packCellSoftShort_7 1;
BA_ "GenSigType" SG_ 2571108359 BATT_fetOverTemp_7 1;
BA_ "GenSigType" SG_ 2571108359 BATT_iOverDischarge_7 1;
BA_ "GenSigType" SG_ 2571108359 BATT_iOverHardware_7 1;
BA_ "GenSigType" SG_ 2571108359 BATT_fetDsgShorted_7 1;
BA_ "GenSigType" SG_ 2571108359 BATT_capLow_7 1;
BA_ "GenSigType" SG_ 2571108359 BATT_brickOverCharge_7 1;
BA_ "GenSigType" SG_ 2571108359 BATT_hostMIA_7 1;
BA_ "GenSigType" SG_ 2571108359 BATT_bmsMemoryError_7 1;
BA_ "GenSigType" SG_ 2571108359 BATT_brickOverDischarge_7 1;
BA_ "GenSigType" SG_ 2571108359 BATT_bmsProcessorError_7 1;
BA_ "GenSigType" SG_ 2571108359 BATT_loggerFull_7 1;
BA_ "GenSigType" SG_ 2571108359 BATT_senseCurrentError_7 1;
BA_ "GenSigType" SG_ 2571108359 BATT_resPackHigh_7 1;
BA_ "GenSigType" SG_ 2571108359 BATT_powerPackInsufficient_7 1;
BA_ "GenSigType" SG_ 2571108359 BATT_iOverCharge_7 1;
BA_ "GenSigType" SG_ 2571108359 BATT_inverterDriveMIA_7 1;
BA_ "GenSigType" SG_ 2571108359 BATT_iUnderCharge_7 1;
BA_ "GenSigType" SG_ 2571108359 BATT_fetDsgFailToClose_7 1;
BA_ "GenSigType" SG_ 2571108359 BATT_afeError_7 1;
BA_ "GenSigType" SG_ 2571108360 BATT_packFetChgWelded_8 1;
BA_ "GenSigType" SG_ 2571108360 BATT_packFetDsgWelded_8 1;
BA_ "GenSigType" SG_ 2571108360 BATT_fetDsgShortedAux_8 1;
BA_ "GenSigType" SG_ 2571108360 BATT_packModIdFault_8 1;
BA_ "GenSigType" SG_ 2571108360 BATT_prechargeTooSlow_8 1;
BA_ "GenSigType" SG_ 2571108360 BATT_prechargeTooFast_8 1;
BA_ "GenSigType" SG_ 2571108360 BATT_prechargeTimeout_8 1;
BA_ "GenSigType" SG_ 2571108360 BATT_packModMIA_8 1;
BA_ "GenSigType" SG_ 2571108360 BATT_chargerMIA_8 1;
BA_ "GenSigType" SG_ 2571108360 BATT_packModSelectFault_8 1;
BA_ "GenSigType" SG_ 2571108360 BATT_vBrickUnderWar_8 1;
BA_ "GenSigType" SG_ 2571108360 BATT_afeFault_8 1;
BA_ "GenSigType" SG_ 2571108360 BATT_vBrickOverSev_8 1;
BA_ "GenSigType" SG_ 2571108360 BATT_vBrickUnderMod_8 1;
BA_ "GenSigType" SG_ 2571108360 BATT_vBrickOverWar_8 1;
BA_ "GenSigType" SG_ 2571108360 BATT_tempModuleUnderSev_8 1;
BA_ "GenSigType" SG_ 2571108360 BATT_tempModuleUnderMod_8 1;
BA_ "GenSigType" SG_ 2571108360 BATT_tempModuleOverWar_8 1;
BA_ "GenSigType" SG_ 2571108360 BATT_loggerAlmostFull_8 1;
BA_ "GenSigType" SG_ 2571108360 BATT_tempBrickImbalance_8 1;
BA_ "GenSigType" SG_ 2571108360 BATT_tempAmbientOverWar_8 1;
BA_ "GenSigType" SG_ 2571108360 BATT_sensePackVoltError_8 1;
BA_ "GenSigType" SG_ 2571108360 BATT_senseLoadVoltError_8 1;
BA_ "GenSigType" SG_ 2571108360 BATT_loggerFull_8 1;
BA_ "GenSigType" SG_ 2571108360 BATT_senseCurrentError_8 1;
BA_ "GenSigType" SG_ 2571108360 BATT_resPackHigh_8 1;
BA_ "GenSigType" SG_ 2571108360 BATT_powerPackInsufficient_8 1;
BA_ "GenSigType" SG_ 2571108360 BATT_iOverHardware_8 1;
BA_ "GenSigType" SG_ 2571108360 BATT_iOverDischarge_8 1;
BA_ "GenSigType" SG_ 2571108360 BATT_iOverCharge_8 1;
BA_ "GenSigType" SG_ 2571108360 BATT_inverterDriveMIA_8 1;
BA_ "GenSigType" SG_ 2571108360 BATT_hostMIA_8 1;
BA_ "GenSigType" SG_ 2571108360 BATT_fetDsgShorted_8 1;
BA_ "GenSigType" SG_ 2571108360 BATT_fetDsgFailToClose_8 1;
BA_ "GenSigType" SG_ 2571108360 BATT_brickOverDischarge_8 1;
BA_ "GenSigType" SG_ 2571108360 BATT_brickOverCharge_8 1;
BA_ "GenSigType" SG_ 2571108360 BATT_bmsProcessorError_8 1;
BA_ "GenSigType" SG_ 2571108360 BATT_packModExitedFromBus_8 1;
BA_ "GenSigType" SG_ 2571108360 BATT_fetChgShortedAux_8 1;
BA_ "GenSigType" SG_ 2571108360 BATT_prechargeFetFail_8 1;
BA_ "GenSigType" SG_ 2571108360 BATT_abnormalResetReason_8 1;
BA_ "GenSigType" SG_ 2571108360 BATT_fetChgShorted_8 1;
BA_ "GenSigType" SG_ 2571108360 BATT_fetChgFailToClose_8 1;
BA_ "GenSigType" SG_ 2571108360 BATT_packModConnectFault_8 1;
BA_ "GenSigType" SG_ 2571108360 BATT_packModImbalance_8 1;
BA_ "GenSigType" SG_ 2571108360 BATT_chargerError_8 1;
BA_ "GenSigType" SG_ 2571108360 BATT_vBrickUnderSev_8 1;
BA_ "GenSigType" SG_ 2571108360 BATT_vBrickOverMod_8 1;
BA_ "GenSigType" SG_ 2571108360 BATT_vBrickImbalance_8 1;
BA_ "GenSigType" SG_ 2571108360 BATT_tempModuleUnderWar_8 1;
BA_ "GenSigType" SG_ 2571108360 BATT_tempModuleOverSev_8 1;
BA_ "GenSigType" SG_ 2571108360 BATT_tempModuleOverMod_8 1;
BA_ "GenSigType" SG_ 2571108360 BATT_taskLockupError_8 1;
BA_ "GenSigType" SG_ 2571108360 BATT_tempAmbientOverSev_8 1;
BA_ "GenSigType" SG_ 2571108360 BATT_tempAmbientOverMod_8 1;
BA_ "GenSigType" SG_ 2571108360 BATT_senseBrickTempError_8 1;
BA_ "GenSigType" SG_ 2571108360 BATT_ramOverUtilError_8 1;
BA_ "GenSigType" SG_ 2571108360 BATT_packCellSoftShort_8 1;
BA_ "GenSigType" SG_ 2571108360 BATT_fetOverTemp_8 1;
BA_ "GenSigType" SG_ 2571108360 BATT_iUnderCharge_8 1;
BA_ "GenSigType" SG_ 2571108360 BATT_capLow_8 1;
BA_ "GenSigType" SG_ 2571108360 BATT_bmsMemoryError_8 1;
BA_ "GenSigType" SG_ 2571108360 BATT_afeError_8 1;
BA_ "GenSigType" SG_ 2571108361 BATT_packModIdFault_9 1;
BA_ "GenSigType" SG_ 2571108361 BATT_packModExitedFromBus_9 1;
BA_ "GenSigType" SG_ 2571108361 BATT_packFetChgWelded_9 1;
BA_ "GenSigType" SG_ 2571108361 BATT_fetDsgShortedAux_9 1;
BA_ "GenSigType" SG_ 2571108361 BATT_fetChgShortedAux_9 1;
BA_ "GenSigType" SG_ 2571108361 BATT_prechargeTooSlow_9 1;
BA_ "GenSigType" SG_ 2571108361 BATT_prechargeTooFast_9 1;
BA_ "GenSigType" SG_ 2571108361 BATT_prechargeTimeout_9 1;
BA_ "GenSigType" SG_ 2571108361 BATT_fetChgShorted_9 1;
BA_ "GenSigType" SG_ 2571108361 BATT_packModSelectFault_9 1;
BA_ "GenSigType" SG_ 2571108361 BATT_packModConnectFault_9 1;
BA_ "GenSigType" SG_ 2571108361 BATT_packModImbalance_9 1;
BA_ "GenSigType" SG_ 2571108361 BATT_afeFault_9 1;
BA_ "GenSigType" SG_ 2571108361 BATT_chargerMIA_9 1;
BA_ "GenSigType" SG_ 2571108361 BATT_chargerError_9 1;
BA_ "GenSigType" SG_ 2571108361 BATT_vBrickUnderWar_9 1;
BA_ "GenSigType" SG_ 2571108361 BATT_vBrickUnderSev_9 1;
BA_ "GenSigType" SG_ 2571108361 BATT_vBrickUnderMod_9 1;
BA_ "GenSigType" SG_ 2571108361 BATT_vBrickOverWar_9 1;
BA_ "GenSigType" SG_ 2571108361 BATT_vBrickOverSev_9 1;
BA_ "GenSigType" SG_ 2571108361 BATT_vBrickOverMod_9 1;
BA_ "GenSigType" SG_ 2571108361 BATT_vBrickImbalance_9 1;
BA_ "GenSigType" SG_ 2571108361 BATT_loggerAlmostFull_9 1;
BA_ "GenSigType" SG_ 2571108361 BATT_tempModuleUnderWar_9 1;
BA_ "GenSigType" SG_ 2571108361 BATT_tempModuleUnderSev_9 1;
BA_ "GenSigType" SG_ 2571108361 BATT_tempModuleUnderMod_9 1;
BA_ "GenSigType" SG_ 2571108361 BATT_tempModuleOverWar_9 1;
BA_ "GenSigType" SG_ 2571108361 BATT_tempModuleOverSev_9 1;
BA_ "GenSigType" SG_ 2571108361 BATT_tempModuleOverMod_9 1;
BA_ "GenSigType" SG_ 2571108361 BATT_tempBrickImbalance_9 1;
BA_ "GenSigType" SG_ 2571108361 BATT_taskLockupError_9 1;
BA_ "GenSigType" SG_ 2571108361 BATT_tempAmbientOverWar_9 1;
BA_ "GenSigType" SG_ 2571108361 BATT_tempAmbientOverSev_9 1;
BA_ "GenSigType" SG_ 2571108361 BATT_tempAmbientOverMod_9 1;
BA_ "GenSigType" SG_ 2571108361 BATT_sensePackVoltError_9 1;
BA_ "GenSigType" SG_ 2571108361 BATT_senseLoadVoltError_9 1;
BA_ "GenSigType" SG_ 2571108361 BATT_senseCurrentError_9 1;
BA_ "GenSigType" SG_ 2571108361 BATT_senseBrickTempError_9 1;
BA_ "GenSigType" SG_ 2571108361 BATT_resPackHigh_9 1;
BA_ "GenSigType" SG_ 2571108361 BATT_iOverCharge_9 1;
BA_ "GenSigType" SG_ 2571108361 BATT_iUnderCharge_9 1;
BA_ "GenSigType" SG_ 2571108361 BATT_fetDsgShorted_9 1;
BA_ "GenSigType" SG_ 2571108361 BATT_capLow_9 1;
BA_ "GenSigType" SG_ 2571108361 BATT_brickOverCharge_9 1;
BA_ "GenSigType" SG_ 2571108361 BATT_bmsMemoryError_9 1;
BA_ "GenSigType" SG_ 2571108361 BATT_packFetDsgWelded_9 1;
BA_ "GenSigType" SG_ 2571108361 BATT_prechargeFetFail_9 1;
BA_ "GenSigType" SG_ 2571108361 BATT_abnormalResetReason_9 1;
BA_ "GenSigType" SG_ 2571108361 BATT_fetChgFailToClose_9 1;
BA_ "GenSigType" SG_ 2571108361 BATT_packModMIA_9 1;
BA_ "GenSigType" SG_ 2571108361 BATT_loggerFull_9 1;
BA_ "GenSigType" SG_ 2571108361 BATT_ramOverUtilError_9 1;
BA_ "GenSigType" SG_ 2571108361 BATT_powerPackInsufficient_9 1;
BA_ "GenSigType" SG_ 2571108361 BATT_packCellSoftShort_9 1;
BA_ "GenSigType" SG_ 2571108361 BATT_iOverHardware_9 1;
BA_ "GenSigType" SG_ 2571108361 BATT_fetOverTemp_9 1;
BA_ "GenSigType" SG_ 2571108361 BATT_iOverDischarge_9 1;
BA_ "GenSigType" SG_ 2571108361 BATT_inverterDriveMIA_9 1;
BA_ "GenSigType" SG_ 2571108361 BATT_hostMIA_9 1;
BA_ "GenSigType" SG_ 2571108361 BATT_fetDsgFailToClose_9 1;
BA_ "GenSigType" SG_ 2571108361 BATT_brickOverDischarge_9 1;
BA_ "GenSigType" SG_ 2571108361 BATT_bmsProcessorError_9 1;
BA_ "GenSigType" SG_ 2571108361 BATT_afeError_9 1;
BA_ "GenSigType" SG_ 2571108362 BATT_prechargeFetFail_10 1;
BA_ "GenSigType" SG_ 2571108362 BATT_packModExitedFromBus_10 1;
BA_ "GenSigType" SG_ 2571108362 BATT_packFetChgWelded_10 1;
BA_ "GenSigType" SG_ 2571108362 BATT_packFetDsgWelded_10 1;
BA_ "GenSigType" SG_ 2571108362 BATT_prechargeTimeout_10 1;
BA_ "GenSigType" SG_ 2571108362 BATT_fetChgFailToClose_10 1;
BA_ "GenSigType" SG_ 2571108362 BATT_prechargeTooSlow_10 1;
BA_ "GenSigType" SG_ 2571108362 BATT_prechargeTooFast_10 1;
BA_ "GenSigType" SG_ 2571108362 BATT_fetChgShorted_10 1;
BA_ "GenSigType" SG_ 2571108362 BATT_packModSelectFault_10 1;
BA_ "GenSigType" SG_ 2571108362 BATT_packModConnectFault_10 1;
BA_ "GenSigType" SG_ 2571108362 BATT_packModMIA_10 1;
BA_ "GenSigType" SG_ 2571108362 BATT_packModImbalance_10 1;
BA_ "GenSigType" SG_ 2571108362 BATT_afeFault_10 1;
BA_ "GenSigType" SG_ 2571108362 BATT_chargerMIA_10 1;
BA_ "GenSigType" SG_ 2571108362 BATT_chargerError_10 1;
BA_ "GenSigType" SG_ 2571108362 BATT_vBrickUnderWar_10 1;
BA_ "GenSigType" SG_ 2571108362 BATT_vBrickUnderSev_10 1;
BA_ "GenSigType" SG_ 2571108362 BATT_vBrickUnderMod_10 1;
BA_ "GenSigType" SG_ 2571108362 BATT_vBrickOverWar_10 1;
BA_ "GenSigType" SG_ 2571108362 BATT_vBrickOverSev_10 1;
BA_ "GenSigType" SG_ 2571108362 BATT_vBrickOverMod_10 1;
BA_ "GenSigType" SG_ 2571108362 BATT_vBrickImbalance_10 1;
BA_ "GenSigType" SG_ 2571108362 BATT_loggerAlmostFull_10 1;
BA_ "GenSigType" SG_ 2571108362 BATT_tempModuleUnderWar_10 1;
BA_ "GenSigType" SG_ 2571108362 BATT_tempModuleUnderSev_10 1;
BA_ "GenSigType" SG_ 2571108362 BATT_tempModuleUnderMod_10 1;
BA_ "GenSigType" SG_ 2571108362 BATT_tempModuleOverWar_10 1;
BA_ "GenSigType" SG_ 2571108362 BATT_tempModuleOverSev_10 1;
BA_ "GenSigType" SG_ 2571108362 BATT_tempModuleOverMod_10 1;
BA_ "GenSigType" SG_ 2571108362 BATT_tempBrickImbalance_10 1;
BA_ "GenSigType" SG_ 2571108362 BATT_taskLockupError_10 1;
BA_ "GenSigType" SG_ 2571108362 BATT_tempAmbientOverWar_10 1;
BA_ "GenSigType" SG_ 2571108362 BATT_tempAmbientOverSev_10 1;
BA_ "GenSigType" SG_ 2571108362 BATT_tempAmbientOverMod_10 1;
BA_ "GenSigType" SG_ 2571108362 BATT_sensePackVoltError_10 1;
BA_ "GenSigType" SG_ 2571108362 BATT_senseLoadVoltError_10 1;
BA_ "GenSigType" SG_ 2571108362 BATT_loggerFull_10 1;
BA_ "GenSigType" SG_ 2571108362 BATT_senseCurrentError_10 1;
BA_ "GenSigType" SG_ 2571108362 BATT_senseBrickTempError_10 1;
BA_ "GenSigType" SG_ 2571108362 BATT_resPackHigh_10 1;
BA_ "GenSigType" SG_ 2571108362 BATT_ramOverUtilError_10 1;
BA_ "GenSigType" SG_ 2571108362 BATT_powerPackInsufficient_10 1;
BA_ "GenSigType" SG_ 2571108362 BATT_packCellSoftShort_10 1;
BA_ "GenSigType" SG_ 2571108362 BATT_iOverHardware_10 1;
BA_ "GenSigType" SG_ 2571108362 BATT_fetOverTemp_10 1;
BA_ "GenSigType" SG_ 2571108362 BATT_iOverDischarge_10 1;
BA_ "GenSigType" SG_ 2571108362 BATT_iOverCharge_10 1;
BA_ "GenSigType" SG_ 2571108362 BATT_inverterDriveMIA_10 1;
BA_ "GenSigType" SG_ 2571108362 BATT_iUnderCharge_10 1;
BA_ "GenSigType" SG_ 2571108362 BATT_hostMIA_10 1;
BA_ "GenSigType" SG_ 2571108362 BATT_fetDsgShorted_10 1;
BA_ "GenSigType" SG_ 2571108362 BATT_fetDsgFailToClose_10 1;
BA_ "GenSigType" SG_ 2571108362 BATT_capLow_10 1;
BA_ "GenSigType" SG_ 2571108362 BATT_brickOverDischarge_10 1;
BA_ "GenSigType" SG_ 2571108362 BATT_brickOverCharge_10 1;
BA_ "GenSigType" SG_ 2571108362 BATT_bmsProcessorError_10 1;
BA_ "GenSigType" SG_ 2571108362 BATT_bmsMemoryError_10 1;
BA_ "GenSigType" SG_ 2571108362 BATT_afeError_10 1;
BA_ "GenSigType" SG_ 2571108362 BATT_packModIdFault_10 1;
BA_ "GenSigType" SG_ 2571108362 BATT_fetDsgShortedAux_10 1;
BA_ "GenSigType" SG_ 2571108362 BATT_fetChgShortedAux_10 1;
BA_ "GenSigType" SG_ 2571108362 BATT_abnormalResetReason_10 1;
